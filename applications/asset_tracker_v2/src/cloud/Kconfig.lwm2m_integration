## applications/asset_tracker_v2/src/cloud/Kconfig.lwm2m_integration
```kconfig
#
# Copyright (c) 2021 Nordic Semiconductor
#
# SPDX-License-Identifier: LicenseRef-Nordic-5-Clause
#

module = LWM2M_INTEGRATION
module-prompt = "LwM2M integration"
orsource "../../../../subsys/net/lib/Kconfig.cloud_$(CLOUD_SERVICE_SELECTOR)"

config $(module)
	bool
	prompt "LwM2M integration layer" if !CLOUD_SERVICE_MUTUAL_EXCLUSIVE

if LWM2M_INTEGRATION

menu "LwM2M integration library"

config LWM2M_INTEGRATION_ENDPOINT_NAME
	string "LwM2M endpoint name"
	default "eu.iot.avsystem.cloud"

config LWM2M_INTEGRATION_ENDPOINT_PREFIX
	string "LwM2M endpoint prefix"
	default "urn:imei:"

config LWM2M_INTEGRATION_TLS_TAG
	int "LwM2M TLS tag"
	default 35724861

config LWM2M_INTEGRATION_BOOTSTRAP_TLS_TAG
	int "LwM2M TLS bootstrap tag"
	default 35724862

config LWM2M_INTEGRATION_PSK
	string "LwM2M PSK"
	default "PSK-DUMMY"

endmenu

endif # LWM2M_INTEGRATION
```

## applications/asset_tracker_v2/src/codec/Kconfig
```kconfig
#
# Copyright (c) 2021 Nordic Semiconductor
#
# SPDX-License-Identifier: LicenseRef-Nordic-5-Clause
#

config CLOUD_CODEC_LWM2M_PATH_LIST_ENTRIES_MAX
	int "Maximum size of path list"
	default LWM2M_COMPOSITE_PATH_LIST_SIZE if LWM2M
	default 1
	help
	  Maximum number of entries in the path list constructed when writing to objects.

config CLOUD_CODEC_LWM2M_PATH_ENTRY_SIZE_MAX
	int "Size of each path list entry"
	default 12 if LWM2M
	default 1
	help
	  Maximum size of a lwm2m path entry

config CLOUD_CODEC_APN_LEN_MAX
	int "Maximum length of APN"
	default 30
	help
	  Maximum length of APN (Access Point Name).

config CLOUD_CODEC_MANUFACTURER
	string "Manufacturer name"
	default "Nordic Semiconductor ASA"

module = CLOUD_CODEC
module-str = Cloud codec
source "subsys/logging/Kconfig.template.log_config"
```

## applications/asset_tracker_v2/src/modules/Kconfig.data_module
```kconfig
#
# Copyright (c) 2021 Nordic Semiconductor
#
# SPDX-License-Identifier: LicenseRef-Nordic-5-Clause
#

menuconfig DATA_MODULE
	bool "Data module"
	select DATE_TIME
	default y

if DATA_MODULE

config DATA_SEND_ALL_DEVICE_CONFIGURATIONS
	bool "Encode and send all device configurations regardless if they have changed or not"
	help
	  If this option is disabled the data module will only include device configuration values
	  that have changed from the last configuration update. This is to save costs related to
	  data transfers and to lower the device's overall current consumption due to less CPU and
	  radio-activity.

config DATA_THREAD_STACK_SIZE
	int "Data module thread stack size"
	default 5248 if NRF_CLOUD_AGPS
	default 3200

config DATA_GNSS_BUFFER_COUNT
	int "Number of GNSS data ringbuffer entries"
	range 1 100
	default 10
	help
	  Currently, the range for ringbuffer entries is limited to a minimum of 1 and a
	  maximum of 100. A minimum of 1 is set to make sure that the application builds with the
	  current implementation of the data module. The buffers are essentially arrays of a
	  certain data type and arrays cannot be compiled with a count of 0.
	  The Kconfig range statement requires that a maximum value is also set.
	  The maximum value of 100 is an arbitrary number that can be increased if desired.
	  Note that when increasing the maximum count of a buffer there is no guarantee beyond
	  using the default values that there is enough heap memory to successfully encode
	  enqueued entries into a JSON object string.

config DATA_SENSOR_BUFFER_COUNT
	int "Number of sensor data ringbuffer entries"
	range 1 100
	default 10

config DATA_MODEM_DYNAMIC_BUFFER_COUNT
	int "Number of dynamic modem data ringbuffer entries"
	range 1 100
	default 3

config DATA_UI_BUFFER_COUNT
	int "Number of UI data ringbuffer entries"
	range 1 100
	default 3

config DATA_IMPACT_BUFFER_COUNT
	int "Number of impact data ringbuffer entries"
	range 1 100
	default 1

config DATA_BATTERY_BUFFER_COUNT
	int "Number of battery data ringbuffer entries"
	range 1 100
	default 3

config DATA_GNSS_BUFFER_STORE
	bool "Store GNSS data received from the location module"
	default y

config DATA_SENSOR_BUFFER_STORE
	bool "Store environmental sensor data received from the sensor module"
	default y

config DATA_DYNAMIC_MODEM_BUFFER_STORE
	bool "Store dynamic modem data received from the modem module"
	default y

config DATA_BATTERY_BUFFER_STORE
	bool "Store battery data received from the modem module"
	default y

config DATA_UI_BUFFER_STORE
	bool "Store UI data received from the UI module"
	default y

choice DATA_DEVICE_MODE
	prompt "Device mode"
	default DATA_DEVICE_MODE_PASSIVE if BOARD_THINGY91_NRF9160_NS
	default DATA_DEVICE_MODE_ACTIVE
	help
	  The device can be in either active or passive mode.
	  In active mode the device samples and sends data at regular intervals set by
	  CONFIG_DATA_ACTIVE_TIMEOUT_SECONDS.
	  In passive mode the device samples and sends data only if movement has been detected and
	  the movement resolution timer set by CONFIG_DATA_MOVEMENT_RESOLUTION_SECONDS has
	  expired.

config DATA_DEVICE_MODE_ACTIVE
	bool "Active mode"

config DATA_DEVICE_MODE_PASSIVE
	bool "Passive mode"

endchoice # DATA_DEVICE_MODE #

config DATA_ACTIVE_TIMEOUT_SECONDS
	int "Default active wait timeout in seconds"
	default 120
	help
	  Number of seconds between sampling/publication in active mode.

config DATA_MOVEMENT_RESOLUTION_SECONDS
	int "Default movement resolution in seconds"
	default 120
	help
	  Number of seconds between each time movement can trigger sampling/publication in passive
	  mode.

config DATA_MOVEMENT_TIMEOUT_SECONDS
	int "Default movement timeout in seconds"
	default 3600
	help
	  Number of seconds between each sampling/publication in passive mode regardless of
	  movement. Used as a fail-safe to ensure updates even if the device is not moving for
	  longer durations.

config DATA_ACCELEROMETER_ACT_THRESHOLD
	int "Default accelerometer activity threshold in m/s²"
	default 4
	help
	  Minimum absolute value in m/s² that is considered movement in passive mode.

config DATA_ACCELEROMETER_INACT_THRESHOLD
	int "Default accelerometer inactivity threshold in m/s²"
	default 4
	help
	  Maximum absolute value in m/s² that is considered stillness in passive mode.

config DATA_ACCELEROMETER_INACT_TIMEOUT_SECONDS
	int "Default accelerometer inactivity timeout in seconds"
	default 60
	help
	  Minimum time for lack of movement to be considered stillness in passive mode.

config DATA_LOCATION_TIMEOUT_SECONDS
	int "Default location timeout"
	default 300
	help
	  Timeout for completing a location request. This value should be large enough
	  so that the location retrieval can find the location in various conditions.
	  This can be considered more of a safeguard rather than the deadline
	  when the operation must be completed. Hence this value can be larger than the
	  sampling interval.

config DATA_SAMPLE_GNSS_DEFAULT
	bool "Include GNSS in sample requests"
	default y
	help
	  If this configuration is enabled the application will by default include GNSS data in
	  sample requests sent to other modules. This configuration can be overwritten by changing
	  the application's real-time configuration using the cloud-side state.

config DATA_SAMPLE_NEIGHBOR_CELLS_DEFAULT
	bool "Include neighbor cells in sample requests"
	default y
	help
	  If this configuration is enabled the application will by default include neighbor cell
	  data in sample requests sent to other modules. This configuration can be overwritten by
	  changing the application's real-time configuration using the cloud-side state.

endif # DATA_MODULE

module = DATA_MODULE
module-str = Data module
source "subsys/logging/Kconfig.template.log_config"
```

## applications/asset_tracker_v2/src/modules/Kconfig.display
```kconfig
#
# Copyright (c) 2021 Nordic Semiconductor
#
# SPDX-License-Identifier: LicenseRef-Nordic-5-Clause
#

module = DISPLAY
module-str = Display module
source "subsys/logging/Kconfig.template.log_config"
```

## applications/asset_tracker_v2/src/qos/Kconfig
```kconfig
#
# Copyright (c) 2021 Nordic Semiconductor
#
# SPDX-License-Identifier: LicenseRef-Nordic-5-Clause
#

menuconfig QOS
	bool "Application watchdog"
	default y

if QOS

choice QOS_PERIODIC_BACKOFF_PERIOD
	prompt "Periodice backoff period"
	default QOS_PERIODIC_BACKOFF_PERIOD_NORMAL

config QOS_PENDING_MESSAGES_MAX
	int "Maximum amount of pending messages"
	default 10

endif # QOS

module = QOS
module-str = QoS
source "subsys/logging/Kconfig.template.log_config"
```

## applications/asset_tracker_v2/tests/application_module/testcase.yaml
```yaml
tests:
  asset_tracker_v2.application_module_test.tester:
    platform_allow: native_posix nrf9160dk_nrf9160_ns
    integration_platforms:
      - native_posix
      - nrf9160dk_nrf9160_ns
    tags: application_module
```

## lib/nrf_modem_lib/nrf91_connectivity/Kconfig
```kconfig
# Copyright (c) 2023 Nordic Semiconductor
#
# SPDX-License-Identifier: LicenseRef-Nordic-5-Clause
#

menuconfig NRF91_CONNECTIVITY
	bool "nRF91 Connectivity"
	select PDN
	select PDN_ESM_STRERROR
	select LTE_LINK_CONTROL
	depends on NET_SOCKETS_OFFLOAD
	help
	  Library used to provide connectivity for nRF91 based boards via Zephyr network management.

if NRF91_CONNECTIVITY

config NRF91_CONNECTIVITY_WORKQUEUE_STACK_SIZE
	int "Workqueue stack size"
	default 1024
	help
	  Stack size of the internal workqueue.

config NRF91_CONNECTIVITY_CONNECT_TIMEOUT_SECONDS
	int "Connect timeout in seconds"
	default 0
	help
	  Time period in seconds that that the library will try to establish an LTE connection,
	  before timing out. The connect timeout can be updated by calling
	  conn_mgr_if_set_timeout(). Default value is 0 (timeout disabled).
	  When the timeout is disabled, the library relies solely on the modem's internal
	  connection handling to upkeep the connection.

config NRF91_CONNECTIVITY_CONNECTION_PERSISTENCE
	bool "Connection persistency"
	default y
	help
	  Persistent connection. If the connection is lost the modem will try to reconnect
	  it self without the need for explicit calls to the network interface.
	  Persistence can be updated run-time by calling conn_mgr_if_set_flag() with
	  CONN_MGR_IF_PERSISTENT as flag parameter.

# Disable Duplicate Address Detection (DAD) for IPv6 due to not working
# properly for offloaded interfaces.
config NET_IPV6_NBR_CACHE
	default n

config NET_IPV6_MLD
	default n

endif # NRF91_CONNECTIVITY

module = NRF91_CONNECTIVITY
module-str = nRF91 NET L2
source "subsys/logging/Kconfig.template.log_config"
```

## lib/qos/Kconfig
```kconfig
#
# Copyright (c) 2022 Nordic Semiconductor
#
# SPDX-License-Identifier: LicenseRef-Nordic-5-Clause
#

menuconfig QOS
	bool "QoS library"

if QOS

config QOS_PENDING_MESSAGES_MAX
	int "Maximum amount of pending messages"
	default 20

config QOS_MESSAGE_NOTIFIED_COUNT_MAX
	int "Maximum number of times to resend a message"
	default 20

endif # QOS

module = QOS
module-str = QoS
source "subsys/logging/Kconfig.template.log_config"
```

## samples/net/mqtt/src/modules/encoder/Kconfig.encoder
```kconfig
#
# Copyright (c) 2023 Nordic Semiconductor
#
# SPDX-License-Identifier: LicenseRef-Nordic-5-Clause
#

menuconfig MQTT_SAMPLE_ENCODER
	bool "Encoder"
	select CJSON_LIB
	select NANOPB
	select ZCBOR
	default y

if MQTT_SAMPLE_ENCODER

choice MQTT_SAMPLE_ENCODER_FORMAT_JSON
	prompt "Serialization format"
	default MQTT_SAMPLE_ENCODER_FORMAT_JSON

config MQTT_SAMPLE_ENCODER_FORMAT_JSON
	bool "JSON"

config MQTT_SAMPLE_ENCODER_FORMAT_PROTOBUF
	bool "Protobuf"

config MQTT_SAMPLE_ENCODER_FORMAT_CBOR
	bool "CBOR"

endchoice

module = MQTT_SAMPLE_ENCODER
module-str = Encoder
source "subsys/logging/Kconfig.template.log_config"

endif # MQTT_SAMPLE_ENCODER
```

## samples/net/mqtt/src/modules/network/Kconfig.network
```kconfig
#
# Copyright (c) 2022 Nordic Semiconductor
#
# SPDX-License-Identifier: LicenseRef-Nordic-5-Clause
#

menuconfig MQTT_SAMPLE_NETWORK
	bool "Network"
	default y

if MQTT_SAMPLE_NETWORK

endif # MQTT_SAMPLE_NETWORK

module = MQTT_SAMPLE_NETWORK
module-str = Network
source "subsys/logging/Kconfig.template.log_config"
```

## samples/net/mqtt/src/modules/sampler/Kconfig.sampler
```kconfig
#
# Copyright (c) 2022 Nordic Semiconductor
#
# SPDX-License-Identifier: LicenseRef-Nordic-5-Clause
#

menuconfig MQTT_SAMPLE_SAMPLER
	bool "Sampler"
	default y

if MQTT_SAMPLE_SAMPLER

endif # MQTT_SAMPLE_SAMPLER

module = MQTT_SAMPLE_SAMPLER
module-str = Sampler
source "subsys/logging/Kconfig.template.log_config"
```

## samples/net/mqtt/src/modules/timer/Kconfig.timer
```kconfig
#
# Copyright (c) 2022 Nordic Semiconductor
#
# SPDX-License-Identifier: LicenseRef-Nordic-5-Clause
#

menuconfig MQTT_SAMPLE_TIMER
	bool "Timer"
	default y

if MQTT_SAMPLE_TIMER

endif # MQTT_SAMPLE_TIMER

module = MQTT_SAMPLE_TIMER
module-str = Timer
source "subsys/logging/Kconfig.template.log_config"
```

## samples/net/mqtt/src/modules/transport/Kconfig.transport
```kconfig
#
# Copyright (c) 2022 Nordic Semiconductor
#
# SPDX-License-Identifier: LicenseRef-Nordic-5-Clause
#

menuconfig MQTT_SAMPLE_TRANSPORT
	bool "Transport"
	default y

if MQTT_SAMPLE_TRANSPORT

endif # MQTT_SAMPLE_TRANSPORT

module = MQTT_SAMPLE_TRANSPORT
module-str = Transport
source "subsys/logging/Kconfig.template.log_config"
```

## subsys/net/lib/Kconfig.cloud_choice
```kconfig
choice CLOUD_SERVICE

config $(module)
	bool
	prompt "$(module-prompt)"
	select $(module)_choice

endchoice

module := $(module)_choice
```

## subsys/net/lib/modem_init_handler/Kconfig
```kconfig
#
# Copyright (c) 2019 Nordic Semiconductor ASA
#
# SPDX-License-Identifier: LicenseRef-Nordic-5-Clause
#

menuconfig MODEM_INIT_HANDLER
	bool "FOTA Utils"
	depends on NRF_MODEM_LIB
	help
	  Library that handles the return value from initialization of the nRF Modem library.
	  The library will perform a reboot if modem DFU was successful.
	  It will also call the required functions that are related to specific FOTA libraries
	  beforehand. This library is not compatible with full modem FOTA.

if MODEM_INIT_HANDLER

module=MODEM_INIT_HANDLER
module-dep=LOG
module-str=Modem initialization handler
source "${ZEPHYR_BASE}/subsys/logging/Kconfig.template.log_config"

endif # MODEM_INIT_HANDLER
```

## subsys/net/lib/nrf_cloud/Kconfig.nrf_cloud_coap
```kconfig
# Copyright (c) 2023 Nordic Semiconductor
#
# SPDX-License-Identifier: LicenseRef-Nordic-5-Clause
#

menuconfig NRF_CLOUD_COAP
	bool "nRF Cloud COAP"
	select CJSON_LIB
	select ZCBOR
	select COAP
	select COAP_EXTENDED_OPTIONS_LEN
	select COAP_CLIENT
	select EXPERIMENTAL

if NRF_CLOUD_COAP

config NRF_CLOUD_COAP_SERVER_HOSTNAME
	string "CoAP server hostname"
	default "coap.dev.nrfcloud.com"

config NRF_CLOUD_COAP_SEC_TAG
	int "Security tag in which to store credentials"
	default NRF_CLOUD_SEC_TAG

config NRF_CLOUD_COAP_THREAD_STACK_SIZE
	int "Stack size for CoAP reception thread"
	default 4096

config NRF_CLOUD_COAP_SERVER_PORT
	int "CoAP server port"
	default 5684

config NRF_CLOUD_COAP_RESPONSE_TIMEOUT_MS
	int "Number of ms to wait for a response from the CoAP server"
	default 30000

module = NRF_CLOUD_COAP
module-str = nRF Cloud COAP
source "subsys/logging/Kconfig.template.log_config"

endif # NRF_CLOUD_COAP
```
