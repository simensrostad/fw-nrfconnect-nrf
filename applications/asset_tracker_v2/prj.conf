## CMakeLists.txt
```
#
# Copyright (c) 2021 Nordic Semiconductor ASA
#
# SPDX-License-Identifier: LicenseRef-Nordic-5-Clause
#

cmake_minimum_required(VERSION 3.20.0)

find_package(Zephyr REQUIRED HINTS $ENV{ZEPHYR_BASE})
project(asset_tracker_v2)

# NORDIC SDK APP START
target_sources(app PRIVATE src/main.c)
# NORDIC SDK APP END

# Include source directory
target_include_directories(app PRIVATE src)
target_include_directories(app PRIVATE include/${BOARD}/)
zephyr_include_directories_ifdef(CONFIG_MEMFAULT configuration/memfault)

# Application directories
add_subdirectory(src/modules)
add_subdirectory(src/events)
add_subdirectory(src/codec)

add_subdirectory_ifdef(CONFIG_CLOUD_MODULE src/cloud)
add_subdirectory_ifdef(CONFIG_SENSOR_MODULE src/ext_sensors)
add_subdirectory_ifdef(CONFIG_WATCHDOG_APPLICATION src/watchdog)
```

## Kconfig
```
#
# Copyright (c) 2021 Nordic Semiconductor ASA
#
# SPDX-License-Identifier: LicenseRef-Nordic-5-Clause
#

# Asset Tracker v2 requires UART_INTERRUPT_DRIVEN to be enabled when SERIAL is used in order to
# receive AT Commands.
config UART_INTERRUPT_DRIVEN
	default y if SERIAL

# Asset Tracker v2 requires the default logging mode as LOG_MODE_IMMEDIATE because
# a) LOG_MODE_DEFERRED does not print floating point numbers.
#	 See : https://github.com/zephyrproject-rtos/zephyr/issues/18351
# b) Using LOG2_MODE_DEFERRED results in missing logs in certain situations. Ref: NCSIDB-630
choice LOG_MODE
	default LOG_MODE_IMMEDIATE
endchoice

menu "Asset Tracker v2"

config ASSET_TRACKER_V2_APP_VERSION
	string "Asset Tracker application firmware version"
	default "0.0.0-development"

config ASSET_TRACKER_V2_APP_VERSION_MAX_LEN
	int "Maximum length of the application firmware version"
	default 150

rsource "src/modules/Kconfig.modules_common"
rsource "src/modules/Kconfig.app_module"
rsource "src/modules/Kconfig.cloud_module"
rsource "src/modules/Kconfig.data_module"
rsource "src/modules/Kconfig.gnss_module"
rsource "src/modules/Kconfig.modem_module"
rsource "src/modules/Kconfig.sensor_module"
rsource "src/modules/Kconfig.ui_module"
rsource "src/modules/Kconfig.util_module"
rsource "src/modules/Kconfig.led_module"
rsource "src/modules/Kconfig.debug_module"

rsource "src/cloud/Kconfig"
rsource "src/codec/Kconfig"
rsource "src/watchdog/Kconfig"
rsource "src/events/Kconfig"

endmenu

menu "Zephyr Kernel"
source "Kconfig.zephyr"
endmenu

module = APPLICATION_MODULE
module-str = Application module
source "subsys/logging/Kconfig.template.log_config"
```

## sample.yaml
```
sample:
  name: Asset Tracker v2 Application
common:
  integration_platforms:
    - nrf9160dk_nrf9160_ns
    - thingy91_nrf9160_ns
tests:
  applications.asset_tracker_v2.nrf_cloud-agps:
    build_only: true
    platform_allow: nrf9160dk_nrf9160_ns thingy91_nrf9160_ns
    extra_args: OVERLAY_CONFIG="overlay-nrf_cloud.conf;overlay-agps.conf"
    tags: ci_build
  applications.asset_tracker_v2.nrf_cloud-pgps:
    build_only: true
    platform_allow: nrf9160dk_nrf9160_ns thingy91_nrf9160_ns
    extra_args: OVERLAY_CONFIG="overlay-nrf_cloud.conf;overlay-pgps.conf"
    tags: ci_build
  applications.asset_tracker_v2.aws-agps:
    build_only: true
    platform_allow: nrf9160dk_nrf9160_ns thingy91_nrf9160_ns
    extra_configs:
      - CONFIG_AWS_IOT_BROKER_HOST_NAME="example-hostname.aws.com"
    extra_args: OVERLAY_CONFIG="overlay-aws.conf;overlay-agps.conf"
    tags: ci_build
  applications.asset_tracker_v2.aws-pgps:
    build_only: true
    platform_allow: nrf9160dk_nrf9160_ns thingy91_nrf9160_ns
    extra_configs:
      - CONFIG_AWS_IOT_BROKER_HOST_NAME="example-hostname.aws.com"
    extra_args: OVERLAY_CONFIG="overlay-aws.conf;overlay-pgps.conf"
    tags: ci_build
  applications.asset_tracker_v2.aws-all:
    build_only: true
    platform_allow: nrf9160dk_nrf9160_ns thingy91_nrf9160_ns
    extra_configs:
      - CONFIG_AWS_IOT_BROKER_HOST_NAME="example-hostname.aws.com"
      - CONFIG_MEMFAULT_NCS_PROJECT_KEY="PROJECTKEY"
    extra_args: OVERLAY_CONFIG="overlay-aws.conf;overlay-agps.conf;overlay-pgps.conf;overlay-debug.conf;overlay-memfault.conf;overlay-carrier.conf"
    tags: ci_build
  applications.asset_tracker_v2.azure:
    build_only: true
    platform_allow: nrf9160dk_nrf9160_ns thingy91_nrf9160_ns
    extra_configs:
      - CONFIG_AZURE_IOT_HUB_DPS_HOSTNAME="global.azure-devices-provisioning.net"
      - CONFIG_AZURE_IOT_HUB_DPS_ID_SCOPE="IDSCOPE"
    extra_args: OVERLAY_CONFIG="overlay-azure.conf"
    tags: ci_build
  applications.asset_tracker_v2.debug:
    build_only: true
    build_on_all: true
    platform_allow: nrf9160dk_nrf9160ns thingy91_nrf9160ns
    extra_configs:
      - CONFIG_AWS_IOT_BROKER_HOST_NAME="example-hostname.aws.com"
    extra_args: OVERLAY_CONFIG="overlay-nrf_cloud.conf;overlay-debug.conf"
    tags: ci_build
  applications.asset_tracker_v2.debug-memfault:
    build_only: true
    build_on_all: true
    platform_allow: nrf9160dk_nrf9160ns thingy91_nrf9160ns
    extra_args: OVERLAY_CONFIG="overlay-nrf_cloud.conf;overlay-debug.conf;overlay-memfault.conf"
    tags: ci_build
  applications.asset_tracker_v2.low_power:
    build_only: true
    build_on_all: true
    platform_allow: nrf9160dk_nrf9160ns thingy91_nrf9160ns
    extra_args: OVERLAY_CONFIG="overlay-nrf_cloud.conf;overlay-low_power.conf"
    tags: ci_build
```

## prj.conf
```kconfig
#
# Copyright (c) 2021 Nordic Semiconductor ASA
#
# SPDX-License-Identifier: LicenseRef-Nordic-5-Clause
#

# General config
CONFIG_PICOLIBC=y
CONFIG_ASSERT=y
CONFIG_REBOOT=y
CONFIG_FPU=y

# Heap and stacks
CONFIG_HEAP_MEM_POOL_SIZE=47250
CONFIG_MAIN_STACK_SIZE=2048
CONFIG_SYSTEM_WORKQUEUE_STACK_SIZE=4096
CONFIG_HW_STACK_PROTECTION=y
# Increase AT monitor heap size to be able to fit both neighbor cell measurement
# and other AT notifications that may come in rapid succession.
CONFIG_AT_MONITOR_HEAP_SIZE=1024

# Logging
CONFIG_LOG=y
CONFIG_LOG_MODE_DEFERRED=y

# nRF modem library
CONFIG_NRF_MODEM_LIB=y
CONFIG_NRF_MODEM_LIB_ON_FAULT_APPLICATION_SPECIFIC=y

# AT Host library - Used to send AT commands directy from an UART terminal and to allow
#		    integration with nRF Connect for Desktop LTE Link monitor application.
CONFIG_AT_HOST_LIBRARY=y

# Network
CONFIG_NETWORKING=y
CONFIG_NET_NATIVE=n
CONFIG_NET_SOCKETS=y
CONFIG_NET_SOCKETS_OFFLOAD=y
CONFIG_NET_IPV6=y
CONFIG_NET_IPV4=y

# LTE link control
CONFIG_LTE_NETWORK_MODE_LTE_M_GPS=y
## Power saving timers.
### 320 hours PSM.
CONFIG_LTE_PSM_REQ=y
CONFIG_LTE_PSM_REQ_RPTAU="11000001"
### 20 seconds active time.
CONFIG_LTE_PSM_REQ_RAT="00001010"

# Settings - Used to store real-time device configuration to flash.
CONFIG_SETTINGS=y
CONFIG_SETTINGS_FCB=y
CONFIG_FCB=y

# FOTA
CONFIG_FOTA_DOWNLOAD=y
CONFIG_DFU_TARGET=y
CONFIG_DOWNLOAD_CLIENT=y
CONFIG_DOWNLOAD_CLIENT_HTTP_FRAG_SIZE_1024=y
CONFIG_DOWNLOAD_CLIENT_STACK_SIZE=4096
CONFIG_DOWNLOAD_CLIENT_BUF_SIZE=2300
CONFIG_DOWNLOAD_CLIENT_MAX_HOSTNAME_SIZE=128

# Flash - Used in FOTA, settings and storage for P-GPS.
CONFIG_FLASH=y
CONFIG_FLASH_PAGE_LAYOUT=y
CONFIG_FLASH_MAP=y
CONFIG_STREAM_FLASH=y
CONFIG_MPU_ALLOW_FLASH_WRITE=y

# MCUBOOT
CONFIG_BOOTLOADER_MCUBOOT=y
CONFIG_IMG_MANAGER=y
CONFIG_MCUBOOT_IMG_MANAGER=y
CONFIG_IMG_ERASE_PROGRESSIVELY=y
CONFIG_SECURE_BOOT=y
CONFIG_BUILD_S1_VARIANT=y

# Watchdog
CONFIG_WATCHDOG_APPLICATION=y

# Application Event Manager
CONFIG_APP_EVENT_MANAGER=y
CONFIG_APP_EVENT_MANAGER_LOG_EVENT_TYPE=n

# cJSON - Used in cloud data encoding.
CONFIG_CJSON_LIB=y

# CAF - Common Application Framework
CONFIG_CAF=y
CONFIG_LED=y
CONFIG_CAF_LEDS=y
CONFIG_CAF_INIT_LOG_LED_READY_EVENTS=n
CONFIG_CAF_INIT_LOG_LED_EVENTS=n
CONFIG_CAF_INIT_LOG_MODULE_STATE_EVENTS=n

# Location related configuration
CONFIG_LOCATION=y
CONFIG_LOCATION_REQUEST_DEFAULT_METHOD_FIRST_GNSS=y
CONFIG_LOCATION_REQUEST_DEFAULT_METHOD_SECOND_CELLULAR=y
CONFIG_LOCATION_REQUEST_DEFAULT_GNSS_TIMEOUT=90000
CONFIG_LOCATION_REQUEST_DEFAULT_CELLULAR_TIMEOUT=11000
CONFIG_LOCATION_DATA_DETAILS=y
CONFIG_LOCATION_LOG_LEVEL_WRN=y

# Default cloud transport service
CONFIG_NRF_CLOUD_MQTT=y
CONFIG_HW_ID_LIBRARY=y
CONFIG_HW_ID_LIBRARY_SOURCE_IMEI=y

# Set the device mode to active, for Thingy:91 the default mode is the passive mode.
# Which means that data sending triggers on activity from the accelerometer.
# To force sequential updates, independent of activity, we set the device to active mode.
CONFIG_DATA_DEVICE_MODE_ACTIVE=y

# Sample data every 900 seconds
CONFIG_DATA_ACTIVE_TIMEOUT_SECONDS=900

# Size of the sensor buffer.
CONFIG_DATA_SENSOR_BUFFER_COUNT=5
```

## overlay-aws.conf
```kconfig
#
# Copyright (c) 2021 Nordic Semiconductor ASA
#
# SPDX-License-Identifier: LicenseRef-Nordic-5-Clause
#

CONFIG_AWS_IOT=y
CONFIG_AWS_IOT_TOPIC_UPDATE_DELTA_SUBSCRIBE=y
CONFIG_AWS_IOT_TOPIC_GET_REJECTED_SUBSCRIBE=y
CONFIG_AWS_IOT_AUTO_DEVICE_SHADOW_REQUEST=y
CONFIG_AWS_IOT_MQTT_RX_TX_BUFFER_LEN=2048
CONFIG_AWS_IOT_APP_SUBSCRIPTION_LIST_COUNT=3
CONFIG_AWS_IOT_CLIENT_ID_APP=y

# Options that must be configured in order to establish a connection.
CONFIG_AWS_IOT_SEC_TAG=42
CONFIG_AWS_IOT_BROKER_HOST_NAME="awdawd"

CONFIG_CLOUD_CLIENT_ID_USE_CUSTOM=y
CONFIG_CLOUD_CLIENT_ID="awdawd"

# MQTT Transport library
# Maximum specified MQTT keepalive timeout for AWS IoT is 1200 seconds.
CONFIG_MQTT_KEEPALIVE=1200
```

## overlay-azure.conf
```kconfig
#
# Copyright (c) 2021 Nordic Semiconductor ASA
#
# SPDX-License-Identifier: LicenseRef-Nordic-5-Clause
#

CONFIG_AZURE_IOT_HUB=y
CONFIG_AZURE_IOT_HUB_DPS=y
CONFIG_AZURE_IOT_HUB_AUTO_DEVICE_TWIN_REQUEST=y
CONFIG_AZURE_IOT_HUB_DEVICE_ID_APP=y
CONFIG_AZURE_IOT_HUB_MQTT_PAYLOAD_BUFFER_LEN=2048
CONFIG_AZURE_IOT_HUB_MQTT_RX_TX_BUFFER_LEN=2048
CONFIG_AZURE_IOT_HUB_TOPIC_PROPERTY_BAG_PREFIX=n
CONFIG_AZURE_IOT_HUB_STACK_SIZE=4096
CONFIG_AZURE_FOTA=y
CONFIG_AZURE_FOTA_TLS=y

# Azure IoT Hub options that must be configured in order to establish a connection.
CONFIG_AZURE_IOT_HUB_DPS_HOSTNAME="global.azure-devices-provisioning.net"
CONFIG_AZURE_IOT_HUB_DPS_ID_SCOPE=""
CONFIG_AZURE_IOT_HUB_SEC_TAG=11
CONFIG_AZURE_FOTA_SEC_TAG=11

# MQTT Transport library
# Maximum specified MQTT keepalive timeout for Azure IoT Hub is 1177 seconds.
CONFIG_MQTT_KEEPALIVE=1177
CONFIG_MQTT_CLEAN_SESSION=y
```

## overlay-debug.conf
```kconfig
#
# Copyright (c) 2021 Nordic Semiconductor ASA
#
# SPDX-License-Identifier: LicenseRef-Nordic-5-Clause
#

# Forces a maximal log level for all modules.
# Modules saturates their specified level if it is greater than this option,
# otherwise they use the level specified by this option instead of their default
# or whatever was manually set. Levels are:
#
# 0 OFF, logging is turned off
# 1 ERROR, maximal level set to LOG_LEVEL_ERR
# 2 WARNING, maximal level set to LOG_LEVEL_WRN
# 3 INFO, maximal level set to LOG_LEVEL_INFO
# 4 DEBUG, maximal level set to LOG_LEVEL_DBG
CONFIG_LOG_MAX_LEVEL=4

# Increase log buffer size to prevent logs being dropped.
CONFIG_LOG_BUFFER_SIZE=2048

# Module debug configurations.
CONFIG_APPLICATION_MODULE_LOG_LEVEL_DBG=y
CONFIG_CLOUD_MODULE_LOG_LEVEL_DBG=y
CONFIG_DATA_MODULE_LOG_LEVEL_DBG=y
CONFIG_LOCATION_MODULE_LOG_LEVEL_DBG=y
CONFIG_MODEM_MODULE_LOG_LEVEL_DBG=y
CONFIG_SENSOR_MODULE_LOG_LEVEL_DBG=y
CONFIG_UI_MODULE_LOG_LEVEL_DBG=y
CONFIG_UTIL_MODULE_LOG_LEVEL_DBG=y
CONFIG_DEBUG_MODULE_LOG_LEVEL_DBG=y

# Cloud integration layer debug logging
CONFIG_CLOUD_INTEGRATION_LOG_LEVEL_DBG=y

# Application Watchdog debug logging
CONFIG_WATCHDOG_LOG_LEVEL_DBG=y

# Cloud codec debug logging
CONFIG_CLOUD_CODEC_LOG_LEVEL_DBG=y

# Location library
CONFIG_LOCATION_LOG_LEVEL_DBG=y

# nRF Cloud
CONFIG_NRF_CLOUD_LOG_LEVEL_DBG=y

# Date time
CONFIG_DATE_TIME_LOG_LEVEL_DBG=y

# Settings
CONFIG_SETTINGS_LOG_LEVEL_DBG=y

# Flash
CONFIG_STREAM_FLASH_LOG_LEVEL_DBG=y

# Debug module
CONFIG_DEBUG_MODULE=y

# QoS library
CONFIG_QOS_LOG_LEVEL_DBG=y

CONFIG_AWS_FOTA_LOG_LEVEL_DBG=y
```

## overlay-full_modem_fota.conf
```kconfig
#
# Copyright (c) 2022 Nordic Semiconductor ASA
#
# SPDX-License-Identifier: LicenseRef-Nordic-5-Clause
#

# Full Modem FOTA
CONFIG_NRF_CLOUD_FOTA_FULL_MODEM_UPDATE=y
CONFIG_MAIN_STACK_SIZE=2048
# Disable AT host library as it's incompatible with the FMFU's requirement
# to initialize the modem library
CONFIG_AT_HOST_LIBRARY=n
CONFIG_NRF_MODEM_LIB_SYS_INIT=n
CONFIG_MODEM_INIT_HANDLER=n
CONFIG_SPI=y
CONFIG_SPI_NOR=y
```

## overlay-lwm2m.conf
```kconfig
CONFIG_LWM2M_INTEGRATION=y
CONFIG_LWM2M=y
CONFIG_LWM2M_DTLS_SUPPORT=y
CONFIG_LWM2M_PEER_PORT=5684
CONFIG_LWM2M_SECURITY_KEY_SIZE=33
CONFIG_LWM2M_RD_CLIENT_ENDPOINT_NAME_MAX_LENGTH=50
CONFIG_LWM2M_INTEGRATION_PSK="000102030405060708090a0b0c0d0e0f"
CONFIG_LWM2M_RW_SENML_JSON_SUPPORT=y
CONFIG_BASE64=y

# extend CoAP retry timing to 10 seconds for LTE/LTE-M
CONFIG_COAP_INIT_ACK_TIMEOUT_MS=15000

# Enable CoAP extended option length
CONFIG_COAP_EXTENDED_OPTIONS_LEN=y
CONFIG_COAP_EXTENDED_OPTIONS_LEN_VALUE=40

CONFIG_LWM2M_COAP_BLOCK_SIZE=512
CONFIG_LWM2M_ENGINE_MAX_OBSERVER=15
CONFIG_LWM2M_ENGINE_MAX_MESSAGES=15
CONFIG_LWM2M_ENGINE_MAX_PENDING=15
CONFIG_LWM2M_ENGINE_MAX_REPLIES=15
CONFIG_LWM2M_ENGINE_DEFAULT_LIFETIME=30

CONFIG_LWM2M_DNS_SUPPORT=y
CONFIG_LWM2M_RW_JSON_SUPPORT=n
CONFIG_LWM2M_IPSO_SUPPORT=y

# IPSO v1.1
CONFIG_LWM2M_IPSO_TEMP_SENSOR_VERSION_1_1=y
CONFIG_LWM2M_IPSO_HUMIDITY_SENSOR_VERSION_1_1=y
# CONFIG_LWM2M_IPSO_GENERIC_SENSOR_VERSION_1_1=y
# CONFIG_LWM2M_IPSO_PRESSURE_SENSOR_VERSION_1_1=y
# CONFIG_LWM2M_IPSO_PUSH_BUTTON_VERSION_1_1=y
# CONFIG_LWM2M_IPSO_ACCELEROMETER_VERSION_1_1=y
# CONFIG_LWM2M_IPSO_APP_COLOUR_SENSOR_VERSION_1_1=y

# Zephyr LwM2M standard objects
CONFIG_LWM2M_CONN_MON_OBJ_SUPPORT=y
CONFIG_LWM2M_LOCATION_OBJ_SUPPORT=y
# CONFIG_LWM2M_IPSO_HUMIDITY_SENSOR=y
# CONFIG_LWM2M_IPSO_TEMP_SENSOR=y
CONFIG_NRF_MODEM_LIB_TRACE_ENABLED=y
CONFIG_MODEM_SEND_ALL_SAMPLED_DATA=y
CONFIG_LWM2M_CONN_MON_BEARER_MAX=2
```

## overlay-pgps.conf
```kconfig
#
# Copyright (c) 2021 Nordic Semiconductor ASA
#
# SPDX-License-Identifier: LicenseRef-Nordic-5-Clause
#

CONFIG_NRF_CLOUD_PGPS=y
# Turn off auto-requesting of P-GPS data upon initialization of the P-GPS library.
# Requesting of P-GPS data is handled explicitly by the application.
CONFIG_NRF_CLOUD_PGPS_REQUEST_ALL_UPON_INIT=n
CONFIG_NRF_CLOUD_PGPS_REQUEST_MISSING_UPON_INIT=n
```

## src/main.c
```c
/*
 * Copyright (c) 2021 Nordic Semiconductor ASA
 *
 * SPDX-License-Identifier: LicenseRef-Nordic-5-Clause
 */

#include <zephyr/kernel.h>
#include <stdio.h>
#include <string.h>
#include <stdlib.h>
#include <app_event_manager.h>
#include <modem/nrf_modem_lib.h>
#include <zephyr/sys/reboot.h>
#include <net/nrf_cloud.h>

/* Module name is used by the Application Event Manager macros in this file */
#define MODULE main
#include <caf/events/module_state_event.h>

#include "modules_common.h"
#include "events/app_module_event.h"
#include "events/cloud_module_event.h"
#include "events/data_module_event.h"
#include "events/sensor_module_event.h"
#include "events/util_module_event.h"
#include "events/modem_module_event.h"

#include <zephyr/logging/log.h>
#include <zephyr/logging/log_ctrl.h>

LOG_MODULE_REGISTER(MODULE, CONFIG_APPLICATION_MODULE_LOG_LEVEL);

/* Message structure. Events from other modules are converted to messages
 * in the Application Event Manager handler, and then queued up in the message queue
 * for processing in the main thread.
 */
struct app_msg_data {
	union {
		struct cloud_module_event cloud;
		struct sensor_module_event sensor;
		struct data_module_event data;
		struct util_module_event util;
		struct modem_module_event modem;
		struct app_module_event app;
	} module;
};

/* Application module super states. */
static enum state_type {
	STATE_INIT,
	STATE_RUNNING,
	STATE_SHUTDOWN
} state;

/* Application sub states. The application can be in either active or passive
 * mode.
 *
 * Active mode: Sensor data and GNSS position is acquired at a configured
 *		interval and sent to cloud.
 *
 * Passive mode: Sensor data and GNSS position is acquired when movement is
 *		 detected, or after the configured movement timeout occurs.
 */
static enum sub_state_type {
	SUB_STATE_ACTIVE_MODE,
	SUB_STATE_PASSIVE_MODE,
} sub_state;

/* Internal copy of the device configuration. */
static struct cloud_data_cfg app_cfg;

/* Variable that keeps track whether modem static data has been successfully sampled by the
 * modem module. Modem static data does not change and only needs to be sampled and sent to cloud
 * once.
 */
static bool modem_static_sampled;

/* Variable that is set high whenever a sample request is ongoing. */
static bool sample_request_ongoing;

/* Variable that is set high whenever the device is considered active (under movement). */
static bool activity;

/* Timer callback used to signal when timeout has occurred both in active
 * and passive mode.
 */
static void data_sample_timer_handler(struct k_timer *timer);

/* Application module message queue. */
#define APP_QUEUE_ENTRY_COUNT		10
#define APP_QUEUE_BYTE_ALIGNMENT	4

/* Data fetching timeouts */
#define DATA_FETCH_TIMEOUT_DEFAULT 2

K_MSGQ_DEFINE(msgq_app, sizeof(struct app_msg_data), APP_QUEUE_ENTRY_COUNT,
	      APP_QUEUE_BYTE_ALIGNMENT);

/* Data sample timer used in active mode. */
K_TIMER_DEFINE(data_sample_timer, data_sample_timer_handler, NULL);

/* Movement timer used to detect movement timeouts in passive mode. */
K_TIMER_DEFINE(movement_timeout_timer, data_sample_timer_handler, NULL);

/* Movement resolution timer decides the period after movement that consecutive
 * movements are ignored and do not cause data collection. This is used to
 * lower power consumption by limiting how often GNSS search is performed and
 * data is sent on air.
 */
K_TIMER_DEFINE(movement_resolution_timer, NULL, NULL);

/* Module data structure to hold information of the application module, which
 * opens up for using convenience functions available for modules.
 */
static struct module_data self = {
	.name = "app",
	.msg_q = &msgq_app,
	.supports_shutdown = true,
};

/* Convenience functions used in internal state handling. */
static char *state2str(enum state_type new_state)
{
	switch (new_state) {
	case STATE_INIT:
		return "STATE_INIT";
	case STATE_RUNNING:
		return "STATE_RUNNING";
	case STATE_SHUTDOWN:
		return "STATE_SHUTDOWN";
	default:
		return "Unknown";
	}
}

static char *sub_state2str(enum sub_state_type new_state)
{
	switch (new_state) {
	case SUB_STATE_ACTIVE_MODE:
		return "SUB_STATE_ACTIVE_MODE";
	case SUB_STATE_PASSIVE_MODE:
		return "SUB_STATE_PASSIVE_MODE";
	default:
		return "Unknown";
	}
}

static void state_set(enum state_type new_state)
{
	if (new_state == state) {
		LOG_DBG("State: %s", state2str(state));
		return;
	}

	LOG_DBG("State transition %s --> %s",
		state2str(state),
		state2str(new_state));

	state = new_state;
}

static void sub_state_set(enum sub_state_type new_state)
{
	if (new_state == sub_state) {
		LOG_DBG("Sub state: %s", sub_state2str(sub_state));
		return;
	}

	LOG_DBG("Sub state transition %s --> %s",
		sub_state2str(sub_state),
		sub_state2str(new_state));

	sub_state = new_state;
}

/* Check the return code from nRF modem library initialization to ensure that
 * the modem is rebooted if a modem firmware update is ready to be applied or
 * an error condition occurred during firmware update or library initialization.
 */
static void modem_init(void)
{
	int ret = nrf_modem_lib_init(NORMAL_MODE);

	/* Handle return values relating to modem firmware update */
	switch (ret) {
	case 0:
		/* Initialization successful, no action required. */
		return;
	case NRF_MODEM_DFU_RESULT_OK:
		LOG_DBG("MODEM UPDATE OK. Will run new modem firmware after reboot");
		break;
	case NRF_MODEM_DFU_RESULT_UUID_ERROR:
	case NRF_MODEM_DFU_RESULT_AUTH_ERROR:
		LOG_ERR("MODEM UPDATE ERROR %d. Will run old firmware", ret);
		break;
	case NRF_MODEM_DFU_RESULT_HARDWARE_ERROR:
	case NRF_MODEM_DFU_RESULT_INTERNAL_ERROR:
		LOG_ERR("MODEM UPDATE FATAL ERROR %d. Modem failure", ret);
		break;
	case NRF_MODEM_DFU_RESULT_VOLTAGE_LOW:
		LOG_ERR("MODEM UPDATE CANCELLED %d.", ret);
		LOG_ERR("Please reboot once you have sufficient power for the DFU");
		break;
	default:
		/* All non-zero return codes other than DFU result codes are
		 * considered irrecoverable and a reboot is needed.
		 */
		LOG_ERR("nRF modem lib initialization failed, error: %d", ret);
		break;
	}

#if defined(CONFIG_NRF_CLOUD_FOTA)
	/* Ignore return value, rebooting below */
	(void)nrf_cloud_fota_pending_job_validate(NULL);
#endif
	LOG_DBG("Rebooting...");
	LOG_PANIC();
	sys_reboot(SYS_REBOOT_COLD);
}

/* Application Event Manager handler. Puts event data into messages and adds them to the
 * application message queue.
 */
static bool app_event_handler(const struct app_event_header *aeh)
{
	struct app_msg_data msg = {0};
	bool enqueue_msg = false;

	if (is_cloud_module_event(aeh)) {
		struct cloud_module_event *evt = cast_cloud_module_event(aeh);

		msg.module.cloud = *evt;
		enqueue_msg = true;
	}

	if (is_app_module_event(aeh)) {
		struct app_module_event *evt = cast_app_module_event(aeh);

		msg.module.app = *evt;
		enqueue_msg = true;
	}

	if (is_data_module_event(aeh)) {
		struct data_module_event *evt = cast_data_module_event(aeh);

		msg.module.data = *evt;
		enqueue_msg = true;
	}

	if (is_sensor_module_event(aeh)) {
		struct sensor_module_event *evt = cast_sensor_module_event(aeh);

		msg.module.sensor = *evt;
		enqueue_msg = true;
	}

	if (is_util_module_event(aeh)) {
		struct util_module_event *evt = cast_util_module_event(aeh);

		msg.module.util = *evt;
		enqueue_msg = true;
	}

	if (is_modem_module_event(aeh)) {
		struct modem_module_event *evt = cast_modem_module_event(aeh);

		msg.module.modem = *evt;
		enqueue_msg = true;
	}

	if (enqueue_msg) {
		int err = module_enqueue_msg(&self, &msg);

		if (err) {
			LOG_ERR("Message could not be enqueued");
			SEND_ERROR(app, APP_EVT_ERROR, err);
		}
	}

	return false;
}

static void data_sample_timer_handler(struct k_timer *timer)
{
	ARG_UNUSED(timer);

	/* Cancel if a previous sample request has not completed or the device is not under
	 * activity in passive mode.
	 */
	if (sample_request_ongoing || ((sub_state == SUB_STATE_PASSIVE_MODE) && !activity)) {
		return;
	}

	SEND_EVENT(app, APP_EVT_DATA_GET_ALL);
}

/* Static module functions. */
static void passive_mode_timers_start_all(void)
{
	LOG_DBG("Device mode: Passive");
	LOG_DBG("Start movement timeout: %d seconds interval", app_cfg.movement_timeout);

	LOG_DBG("%d seconds until movement can trigger a new data sample/publication",
		app_cfg.movement_resolution);

	k_timer_start(&data_sample_timer,
		      K_SECONDS(app_cfg.movement_resolution),
		      K_SECONDS(app_cfg.movement_resolution));

	k_timer_start(&movement_resolution_timer,
		      K_SECONDS(app_cfg.movement_resolution),
		      K_SECONDS(0));

	k_timer_start(&movement_timeout_timer,
		      K_SECONDS(app_cfg.movement_timeout),
		      K_SECONDS(app_cfg.movement_timeout));
}

static void active_mode_timers_start_all(void)
{
	LOG_DBG("Device mode: Active");
	LOG_DBG("Start data sample timer: %d seconds interval", app_cfg.active_wait_timeout);

	k_timer_start(&data_sample_timer,
		      K_SECONDS(app_cfg.active_wait_timeout),
		      K_SECONDS(app_cfg.active_wait_timeout));

	k_timer_stop(&movement_resolution_timer);
	k_timer_stop(&movement_timeout_timer);
}

static void activity_event_handle(enum sensor_module_event_type sensor_event)
{
	__ASSERT(((sensor_event == SENSOR_EVT_MOVEMENT_ACTIVITY_DETECTED) ||
		  (sensor_event == SENSOR_EVT_MOVEMENT_INACTIVITY_DETECTED)),
		  "Unknown event");

	activity = (sensor_event == SENSOR_EVT_MOVEMENT_ACTIVITY_DETECTED) ? true : false;

	if (sample_request_ongoing) {
		LOG_DBG("Sample request ongoing, abort request.");
		return;
	}

	if ((sensor_event == SENSOR_EVT_MOVEMENT_ACTIVITY_DETECTED) &&
	    (k_timer_remaining_get(&movement_resolution_timer) != 0)) {
		LOG_DBG("Movement resolution timer has not expired, abort request.");
		return;
	}

	SEND_EVENT(app, APP_EVT_DATA_GET_ALL);
	passive_mode_timers_start_all();
}

static void data_get(void)
{
	struct app_module_event *app_module_event = new_app_module_event();

	__ASSERT(app_module_event, "Not enough heap left to allocate event");

	size_t count = 0;

	/* Set a low sample timeout. If location is requested, the sample timeout
	 * will be increased to accommodate the location request.
	 */
	app_module_event->timeout = DATA_FETCH_TIMEOUT_DEFAULT;

	/* Specify which data that is to be included in the transmission. */
	app_module_event->data_list[count++] = APP_DATA_MODEM_DYNAMIC;
	app_module_event->data_list[count++] = APP_DATA_BATTERY;
	app_module_event->data_list[count++] = APP_DATA_ENVIRONMENTAL;

	if (!modem_static_sampled) {
		app_module_event->data_list[count++] = APP_DATA_MODEM_STATIC;
	}

	if (!app_cfg.no_data.neighbor_cell || !app_cfg.no_data.gnss || !app_cfg.no_data.wifi) {
		app_module_event->data_list[count++] = APP_DATA_LOCATION;

		/* Set application module timeout when location sampling is requested.
		 * This is selected to be long enough so that most of the GNSS would
		 * have enough time to run to get a fix. We also want it to be smaller than
		 * the sampling interval (120s). So, 110s was selected but we take
		 * minimum of sampling interval minus 5 (just some selected number) and 110.
		 * And mode (active or passive) is taken into account.
		 * If the timeout would become smaller than 5s, we want to ensure some time for
		 * the modules so the minimum value for application module timeout is 5s.
		 */
		app_module_event->timeout = (app_cfg.active_mode) ?
			MIN(app_cfg.active_wait_timeout - 5, 110) :
			MIN(app_cfg.movement_resolution - 5, 110);
		app_module_event->timeout = MAX(app_module_event->timeout, 5);
	}

	/* Set list count to number of data types passed in app_module_event. */
	app_module_event->count = count;
	app_module_event->type = APP_EVT_DATA_GET;

	APP_EVENT_SUBMIT(app_module_event);
}

/* Message handler for STATE_INIT. */
static void on_state_init(struct app_msg_data *msg)
{
	if (IS_EVENT(msg, data, DATA_EVT_CONFIG_INIT)) {
		/* Keep a copy of the new configuration. */
		app_cfg = msg->module.data.data.cfg;

		if (app_cfg.active_mode) {
			active_mode_timers_start_all();
		} else {
			passive_mode_timers_start_all();
		}

		state_set(STATE_RUNNING);
		sub_state_set(app_cfg.active_mode ? SUB_STATE_ACTIVE_MODE :
						    SUB_STATE_PASSIVE_MODE);
	}
}

/* Message handler for STATE_RUNNING. */
static void on_state_running(struct app_msg_data *msg)
{
	if (IS_EVENT(msg, cloud, CLOUD_EVT_CONNECTED)) {
		data_get();
	}

	if (IS_EVENT(msg, app, APP_EVT_DATA_GET_ALL)) {
		data_get();
	}
}

/* Message handler for SUB_STATE_PASSIVE_MODE. */
void on_sub_state_passive(struct app_msg_data *msg)
{
	if (IS_EVENT(msg, data, DATA_EVT_CONFIG_READY)) {
		/* Keep a copy of the new configuration. */
		app_cfg = msg->module.data.data.cfg;

		if (app_cfg.active_mode) {
			active_mode_timers_start_all();
			sub_state_set(SUB_STATE_ACTIVE_MODE);
			return;
		}

		passive_mode_timers_start_all();
	}

	if ((IS_EVENT(msg, sensor, SENSOR_EVT_MOVEMENT_ACTIVITY_DETECTED)) ||
	    (IS_EVENT(msg, sensor, SENSOR_EVT_MOVEMENT_INACTIVITY_DETECTED))) {
		activity_event_handle(msg->module.sensor.type);
	}
}

/* Message handler for SUB_STATE_ACTIVE_MODE. */
static void on_sub_state_active(struct app_msg_data *msg)
{
	if (IS_EVENT(msg, data, DATA_EVT_CONFIG_READY)) {
		/* Keep a copy of the new configuration. */
		app_cfg = msg->module.data.data.cfg;

		if (!app_cfg.active_mode) {
			passive_mode_timers_start_all();
			sub_state_set(SUB_STATE_PASSIVE_MODE);
			return;
		}

		active_mode_timers_start_all();
	}
}

/* Message handler for all states. */
static void on_all_events(struct app_msg_data *msg)
{
	if (IS_EVENT(msg, util, UTIL_EVT_SHUTDOWN_REQUEST)) {
		k_timer_stop(&data_sample_timer);
		k_timer_stop(&movement_timeout_timer);
		k_timer_stop(&movement_resolution_timer);

		SEND_SHUTDOWN_ACK(app, APP_EVT_SHUTDOWN_READY, self.id);
		state_set(STATE_SHUTDOWN);
	}

	if (IS_EVENT(msg, modem, MODEM_EVT_MODEM_STATIC_DATA_READY)) {
		modem_static_sampled = true;
	}

	if (IS_EVENT(msg, app, APP_EVT_DATA_GET)) {
		sample_request_ongoing = true;
	}

	if (IS_EVENT(msg, data, DATA_EVT_DATA_READY)) {
		sample_request_ongoing = false;
	}

	if (IS_EVENT(msg, sensor, SENSOR_EVT_MOVEMENT_IMPACT_DETECTED)) {
		SEND_EVENT(app, APP_EVT_DATA_GET_ALL);
	}
}

void main(void)
{
	int err;
	struct app_msg_data msg = { 0 };

	/* The carrier library will initialize the modem if enabled, if not, we initialize the
	 * modem in here, before the rest of the application is started.
	 */
	if (!IS_ENABLED(CONFIG_LWM2M_CARRIER)) {
		modem_init();
	}

	if (app_event_manager_init()) {
		/* Without the Application Event Manager, the application will not work
		 * as intended. A reboot is required in an attempt to recover.
		 */
		LOG_ERR("Application Event Manager could not be initialized, rebooting...");
		k_sleep(K_SECONDS(5));
		sys_reboot(SYS_REBOOT_COLD);
	} else {
		module_set_state(MODULE_STATE_READY);
		SEND_EVENT(app, APP_EVT_START);
	}

	self.thread_id = k_current_get();

	err = module_start(&self);
	if (err) {
		LOG_ERR("Failed starting module, error: %d", err);
		SEND_ERROR(app, APP_EVT_ERROR, err);
	}

	while (true) {
		module_get_next_msg(&self, &msg);

		switch (state) {
		case STATE_INIT:
			on_state_init(&msg);
			break;
		case STATE_RUNNING:
			switch (sub_state) {
			case SUB_STATE_ACTIVE_MODE:
				on_sub_state_active(&msg);
				break;
			case SUB_STATE_PASSIVE_MODE:
				on_sub_state_passive(&msg);
				break;
			default:
				LOG_ERR("Unknown sub state");
				break;
			}

			on_state_running(&msg);
			break;
		case STATE_SHUTDOWN:
			/* The shutdown state has no transition. */
			break;
		default:
			LOG_ERR("Unknown state");
			break;
		}

		on_all_events(&msg);
	}
}

APP_EVENT_LISTENER(MODULE, app_event_handler);
APP_EVENT_SUBSCRIBE_EARLY(MODULE, cloud_module_event);
APP_EVENT_SUBSCRIBE(MODULE, app_module_event);
APP_EVENT_SUBSCRIBE(MODULE, data_module_event);
APP_EVENT_SUBSCRIBE(MODULE, util_module_event);
APP_EVENT_SUBSCRIBE_FINAL(MODULE, sensor_module_event);
APP_EVENT_SUBSCRIBE_FINAL(MODULE, modem_module_event);
```
