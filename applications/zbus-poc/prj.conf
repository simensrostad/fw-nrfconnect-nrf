## CMakeLists.txt
```
#
# Copyright (c) 2021 Nordic Semiconductor ASA
#
# SPDX-License-Identifier: LicenseRef-Nordic-5-Clause
#

cmake_minimum_required(VERSION 3.20.0)

find_package(Zephyr REQUIRED HINTS $ENV{ZEPHYR_BASE})
project(poezbus)

# NORDIC SDK APP START
target_sources(app PRIVATE src/main.c)
# NORDIC SDK APP END

# Include source directory
target_include_directories(app PRIVATE src)
target_include_directories(app PRIVATE include/${BOARD}/)

# Application directories
add_subdirectory(src/modules)
```

## Kconfig
```
#
# Copyright (c) 2021 Nordic Semiconductor ASA
#
# SPDX-License-Identifier: LicenseRef-Nordic-5-Clause
#

menu "Zephyr Kernel"
source "Kconfig.zephyr"
endmenu

module = APPLICATION_MODULE
module-str = Application module
source "subsys/logging/Kconfig.template.log_config"
```

## sample.yaml
```
sample:
  name: Zbus Poc
common:
  integration_platforms:
    - nrf9160dk_nrf9160_ns
    - thingy91_nrf9160_ns
tests:
  applications.asset_tracker_v2.nrf_cloud:
    build_only: true
    build_on_all: true
    platform_allow: nrf9160dk_nrf9160_ns thingy91_nrf9160_ns
    tags: ci_build
```

## prj.conf
```kconfig
#
# Copyright (c) 2021 Nordic Semiconductor ASA
#
# SPDX-License-Identifier: LicenseRef-Nordic-5-Clause
#

# General config
CONFIG_NEWLIB_LIBC=y
CONFIG_NEWLIB_LIBC_NANO=y
CONFIG_NEWLIB_LIBC_FLOAT_PRINTF=y
CONFIG_ZBUS=y

# Heap and stacks
CONFIG_HEAP_MEM_POOL_SIZE=47250
CONFIG_MAIN_STACK_SIZE=2048
CONFIG_SYSTEM_WORKQUEUE_STACK_SIZE=4096
CONFIG_HW_STACK_PROTECTION=y
# # Increase AT monitor heap size to be able to fit both neighbor cell measurement
# # and other AT notifications that may come in rapid succession.
# CONFIG_AT_MONITOR_HEAP_SIZE=1024

# Logging
CONFIG_LOG=y
CONFIG_LOG_MODE_DEFERRED=y

# # nRF modem library
# CONFIG_NRF_MODEM_LIB=y
# CONFIG_NRF_MODEM_LIB_ON_FAULT_APPLICATION_SPECIFIC=y

# # AT Host library - Used to send AT commands directy from an UART terminal and to allow
# #		    integration with nRF Connect for Desktop LTE Link monitor application.
# CONFIG_AT_HOST_LIBRARY=y

# # Network
# CONFIG_NETWORKING=y
# CONFIG_NET_NATIVE=n
# CONFIG_NET_SOCKETS=y
# CONFIG_NET_SOCKETS_OFFLOAD=y
# CONFIG_NET_IPV6=y
# CONFIG_NET_IPV4=y

# # LTE link control
# CONFIG_LTE_AUTO_INIT_AND_CONNECT=n
# CONFIG_LTE_NETWORK_MODE_LTE_M_GPS=y
# ## Power saving timers.
# ### 320 hours PSM.
# CONFIG_LTE_PSM_REQ_RPTAU="11000001"
# ### 20 seconds active time.
# CONFIG_LTE_PSM_REQ_RAT="00001010"

# # Settings - Used to store real-time device configuration to flash.
# CONFIG_SETTINGS=y
# CONFIG_SETTINGS_FCB=y
# CONFIG_FCB=y

# # FOTA
# CONFIG_FOTA_DOWNLOAD=y
# CONFIG_DFU_TARGET=y
# CONFIG_DOWNLOAD_CLIENT=y
# CONFIG_DOWNLOAD_CLIENT_HTTP_FRAG_SIZE_1024=y
# CONFIG_DOWNLOAD_CLIENT_STACK_SIZE=4096
# CONFIG_DOWNLOAD_CLIENT_BUF_SIZE=2300
# CONFIG_DOWNLOAD_CLIENT_MAX_HOSTNAME_SIZE=128

# # Flash - Used in FOTA, settings and storage for P-GPS.
# CONFIG_FLASH=y
# CONFIG_FLASH_PAGE_LAYOUT=y
# CONFIG_FLASH_MAP=y
# CONFIG_STREAM_FLASH=y
# CONFIG_MPU_ALLOW_FLASH_WRITE=y

# # MCUBOOT
# CONFIG_BOOTLOADER_MCUBOOT=y
# CONFIG_IMG_MANAGER=y
# CONFIG_MCUBOOT_IMG_MANAGER=y
# CONFIG_IMG_ERASE_PROGRESSIVELY=y
# CONFIG_SECURE_BOOT=y
# CONFIG_BUILD_S1_VARIANT=y

# # Watchdog
# CONFIG_WATCHDOG_APPLICATION=y

# # Application Event Manager
# CONFIG_APP_EVENT_MANAGER=y
# CONFIG_APP_EVENT_MANAGER_LOG_EVENT_TYPE=n

# # cJSON - Used in cloud data encoding.
# CONFIG_CJSON_LIB=y

# # CAF - Common Application Framework
# CONFIG_CAF=y
# CONFIG_LED=y
# CONFIG_CAF_LEDS=y
# CONFIG_CAF_INIT_LOG_LED_READY_EVENTS=n
# CONFIG_CAF_INIT_LOG_LED_EVENTS=n
# CONFIG_CAF_INIT_LOG_MODULE_STATE_EVENTS=n

# # Location related configuration
# CONFIG_LOCATION=y
# CONFIG_LOCATION_METHOD_GNSS_AGPS_EXTERNAL=y
# CONFIG_LOCATION_METHOD_CELLULAR_EXTERNAL=y
# CONFIG_LOCATION_DATA_DETAILS=y

# # Default cloud transport service
# CONFIG_NRF_CLOUD_MQTT=y
# CONFIG_HW_ID_LIBRARY=y
# CONFIG_HW_ID_LIBRARY_SOURCE_IMEI=y
```

## src/main.c
```c
/*
 * Copyright (c) 2022 Nordic Semiconductor ASA
 *
 * SPDX-License-Identifier: LicenseRef-Nordic-5-Clause
 */

#include <zephyr/kernel.h>
#include <stdio.h>
#include <string.h>
#include <stdlib.h>

/* Module name is used by the Application Event Manager macros in this file */
#define MODULE main

#include "module_common.h"

LOG_MODULE_REGISTER(MODULE, CONFIG_APPLICATION_MODULE_LOG_LEVEL);

void main(void)
{
	k_sleep(K_SECONDS(5));

	while (true) {
		struct module_common message = {.var = 1};

		zbus_chan_pub(&common_channel, &acc1, K_SECONDS(5));
	}
}
```
