## CMakeLists.txt
```
#
# Copyright (c) 2019 Nordic Semiconductor
#
# SPDX-License-Identifier: LicenseRef-Nordic-5-Clause
#

cmake_minimum_required(VERSION 3.13.1)

find_package(Zephyr REQUIRED HINTS $ENV{ZEPHYR_BASE})
project(serial_lte_modem)

# NORDIC SDK APP START
target_sources(app PRIVATE src/main.c)
target_sources(app PRIVATE src/slm_util.c)
target_sources(app PRIVATE src/slm_settings.c)
target_sources(app PRIVATE src/slm_at_host.c)
target_sources(app PRIVATE src/slm_at_commands.c)
target_sources(app PRIVATE src/slm_at_tcpip.c)
target_sources(app PRIVATE src/slm_at_tcp_proxy.c)
target_sources(app PRIVATE src/slm_at_udp_proxy.c)
target_sources(app PRIVATE src/slm_at_icmp.c)
target_sources(app PRIVATE src/slm_at_fota.c)
target_sources(app PRIVATE src/watchdog.c)
# NORDIC SDK APP END
target_sources_ifdef(CONFIG_SLM_SMS app PRIVATE src/slm_at_sms.c)
target_sources_ifdef(CONFIG_SLM_NATIVE_TLS app PRIVATE src/slm_native_tls.c)
target_sources_ifdef(CONFIG_SLM_NATIVE_TLS app PRIVATE src/slm_at_cmng.c)
target_sources_ifdef(CONFIG_SLM_NATIVE_TLS_PS app PRIVATE src/slm_native_tls_ps.c)

add_subdirectory_ifdef(CONFIG_SLM_GPS src/gps)
add_subdirectory_ifdef(CONFIG_SLM_FTPC src/ftp_c)
add_subdirectory_ifdef(CONFIG_SLM_MQTTC src/mqtt_c)
add_subdirectory_ifdef(CONFIG_SLM_HTTPC src/http_c)
add_subdirectory_ifdef(CONFIG_SLM_TWI src/twi)
add_subdirectory_ifdef(CONFIG_SLM_GPIO src/gpio)
add_subdirectory_ifdef(CONFIG_SLM_UI src/ui)
add_subdirectory_ifdef(CONFIG_SLM_HW_REV src/hw_rev)
add_subdirectory_ifdef(CONFIG_SLM_UC src/user_config)

zephyr_include_directories(src)

set_property(TARGET zephyr_property_target
             APPEND PROPERTY TFM_CMAKE_OPTIONS
             -DPS_MAX_ASSET_SIZE=2048
             -DPS_NUM_ASSETS=30
)
```

## Kconfig
```
#
# Copyright (c) 2019 Nordic Semiconductor
#
# SPDX-License-Identifier: LicenseRef-Nordic-5-Clause
#

source "Kconfig.zephyr"

menu "Nordic Serial LTE Modem"

config SLM_CUSTOMIZED
	bool "Flag for customized functionality"
	select SLM_STATS_WATCHDOG
	select SLM_HW_REV
	help
	  Enable this flag to include customized logic.

config SLM_WATCHDOG_SYSTEM_WORKQUEUE_TIMEOUT_MSEC
	int "Watchdog timeout in milliseconds for system workqueue"
	default 60000
	help
	  Timeout for system workqueue watchdog. This is used to monitor the responsiveness
	  of the system workqueue, which in many cases is used by SLM for sending AT commands to the
	  modem. Make sure that this value is higher than the longest expected time for the AT
	  command to be processed by the modem.

config SLM_AT_MODE
	bool "Serial LTE Modem by raw AT mode"
	default y
	select AT_CMD
	select AT_NOTIF
	select AT_CMD_PARSER

config SLM_AT_MAX_PARAM
	int "Maximum number of parameters in AT command"
	default 9

menuconfig SLM_NATIVE_TLS
	bool "Use Zephyr mbedTLS"

config SLM_UART_HWFC_RUNTIME
	bool "Support of UART HWFC runtime configuration"

if SLM_NATIVE_TLS

choice
	prompt "Credential storage backend"
	default SLM_NATIVE_TLS_PS if TFM_PARTITION_PROTECTED_STORAGE
	default SLM_NATIVE_TLS_MODEM
	help
		Select which mechanism is used to store credentials
	config SLM_NATIVE_TLS_MODEM
		bool "Modem storage"
		help
		  Credentials will be stored in the nRF9160 modem's storage.
		  Security tag value will be offset and CA certificate slots are
		  used. For details, see the slm_tls_map_sectag function.
	config SLM_NATIVE_TLS_PS
		bool "Protected Storage (TF-M)"
		depends on TFM_PARTITION_PROTECTED_STORAGE
		help
		  Credentials will be stored using the PSA Protected Storage
		  API. This requires that the application be built with TF-M.
endchoice

if SLM_NATIVE_TLS_PS
config SLM_NATIVE_TLS_PS_WRITE_ONCE
	bool "Write-once credentials"
	default y
	help
		Credentials are written with the "write-once" attribute, meaning
		that they cannot be modified, replaced or deleted by firmware.
endif

endif # SLM_NATIVE_TLS


#
# external XTAL for UART
#
config SLM_EXTERNAL_XTAL
	bool "Use external XTAL for UARTE"
	default y

#
# Inter-Connect
#
choice
	prompt "UART for interconnect"
	default SLM_CONNECT_UART_0
	help
		Selects which UART to use for interconnect:
		-  UART 0
		-  UART 2
	config SLM_CONNECT_UART_0
		bool "UART 0"
	  select UART_0_NRF_HW_ASYNC
	  select SLM_UART_HWFC_RUNTIME if $(dt_node_has_prop,uart0,rts-pin) && \
					  $(dt_node_has_prop,uart0,cts-pin)
	config SLM_CONNECT_UART_2
		bool "UART 2"
	  select UART_2_NRF_UARTE
	  select UART_2_NRF_HW_ASYNC
	  select SLM_UART_HWFC_RUNTIME if $(dt_node_has_prop,uart2,rts-pin) && \
					  $(dt_node_has_prop,uart2,cts-pin)
endchoice

choice
	prompt "Termination mode"
	default SLM_CR_LF_TERMINATION
	help
		Sets the command terminator used by the serial terminal.
		Available options are:
		-  CR termination
		-  LF termination
		-  CR+LF termination
	config SLM_CR_TERMINATION
		bool "CR termination"
	config SLM_LF_TERMINATION
		bool "LF termination"
	config SLM_CR_LF_TERMINATION
		bool "CR+LF termination"
endchoice

#
# GPIO wakeup
#
config SLM_GPIO_WAKEUP
	bool "Support of GPIO wakeup"
	default y
	help
	  Enable GPIO wakeup on nRF9160 side.

if SLM_GPIO_WAKEUP

config SLM_START_SLEEP
	bool "Enter sleep on startup"
	help
	  Put nRF9160 into deep sleep mode after startup.

endif

config SLM_INTERFACE_PIN
	int "Interface GPIO to wake up or exit idle mode"
	default 6 if SLM_CONNECT_UART_0
	default 31 if SLM_CONNECT_UART_2

#
# Socket
#
config SLM_SOCKET_RX_MAX
	int "Maximum RX buffer size for receiving socket data"
	range 576 708
	default 576
	help
	  Default: NET_IPV4_MTU (576)
	  Maximum: MSS setting in modem (708)

#
# TCP/TLS proxy
#
config SLM_TCP_FILTER_SIZE
	int "Size of IPv4/IPv6 address allowlist"
	range 1 6
	default 6

config SLM_TCP_POLL_TIME
	int "Poll time-out in seconds for TCP connection"
	default 10

config SLM_UDP_POLL_TIME
	int "Poll time-out in seconds for UDP connection"
	default 10

config SLM_TCP_CONN_TIME
	int "Connection time-out in seconds for TCP server"
	default 60

config SLM_DATAMODE_HWFC
	bool "UART HWFC for data mode"
	default y
	help
	  Require UART hardware flow control for data mode

config SLM_DATAMODE_TERMINATOR
	string "Pattern string to terminate data mode"
	default "+++"
	help
	  Use a pattern to terminate data mode

config SLM_DATAMODE_SILENCE
	int "Silence time to exit data mode"
	default 1
	help
	  Exit data mode after the specified time (in seconds) of UART silence

#
# Configurable services
#
config SLM_SMS
	bool "SMS support in SLM"
	default y
	select SMS
	help
	  Support SMS send/receive in plain text

rsource "src/gps/Kconfig"
rsource "src/ftp_c/Kconfig"
rsource "src/mqtt_c/Kconfig"
rsource "src/http_c/Kconfig"
rsource "src/twi/Kconfig"
rsource "src/gpio/Kconfig"
rsource "src/ui/Kconfig"
rsource "src/hw_rev/Kconfig"
rsource "src/user_config/Kconfig"

module = SLM
module-str = serial modem
source "${ZEPHYR_BASE}/subsys/logging/Kconfig.template.log_config"

endmenu
```

## prj.conf
```kconfig
#
# Copyright (c) 2020 Nordic Semiconductor ASA
#
# SPDX-License-Identifier: LicenseRef-Nordic-5-Clause
#
# General config
CONFIG_LOG=y
CONFIG_LOG_DEFAULT_LEVEL=3
CONFIG_STACK_SENTINEL=y
CONFIG_NEWLIB_LIBC=y
CONFIG_NEWLIB_LIBC_FLOAT_PRINTF=y
CONFIG_RING_BUFFER=y
CONFIG_FPU=y
CONFIG_NRF_MODEM_LIB_TRACE_ENABLED=y
CONFIG_NRF_MODEM_LIB_TRACE_MEDIUM_RTT=y

# Segger RTT
CONFIG_USE_SEGGER_RTT=y
CONFIG_RTT_CONSOLE=y
CONFIG_UART_CONSOLE=n
CONFIG_LOG_BACKEND_RTT=y
CONFIG_LOG_BACKEND_UART=n

# Network
CONFIG_NETWORKING=y
CONFIG_NET_SOCKETS=y
CONFIG_NET_NATIVE=n

# Modem library
CONFIG_NRF_MODEM_LIB=y
CONFIG_NRF_MODEM_LIB_SYS_INIT=n
CONFIG_AT_CMD_SYS_INIT=n
CONFIG_AT_NOTIF_SYS_INIT=n
# Align the max FD entry to NRF_MODEM_MAX_SOCKET_COUNT(8)
CONFIG_POSIX_MAX_FDS=8
# Enable below for modem trace
#CONFIG_NRF_MODEM_LIB_TRACE_ENABLED=y

# UART interface
CONFIG_SERIAL=y
CONFIG_UART_ASYNC_API=y
CONFIG_NRFX_TIMER2=y

# Stacks and heaps
CONFIG_MAIN_STACK_SIZE=4096
CONFIG_HEAP_MEM_POOL_SIZE=16384
CONFIG_SYSTEM_WORKQUEUE_STACK_SIZE=4096

# AT_CMD
# Enable AT_CMD debug for details
#CONFIG_AT_CMD_LOG_LEVEL_DBG=y

# Device power management
CONFIG_PM_DEVICE=y

# Enable SUPL client support
#CONFIG_SUPL_CLIENT_LIB=y

# FOTA
CONFIG_HTTP_PARSER_URL=y
CONFIG_FOTA_DOWNLOAD=y
CONFIG_FOTA_DOWNLOAD_PROGRESS_EVT=y
CONFIG_DFU_TARGET=y
CONFIG_DOWNLOAD_CLIENT=y
CONFIG_DOWNLOAD_CLIENT_STACK_SIZE=4096
CONFIG_IMG_MANAGER=y
CONFIG_IMG_ERASE_PROGRESSIVELY=y

# Serial DFU
CONFIG_MCUMGR=y
CONFIG_MCUMGR_SMP_UART=y
CONFIG_UART_MCUMGR_RX_BUF_SIZE=512
CONFIG_MCUMGR_BUF_SIZE=512
## Required by the `taskstat` command.
CONFIG_THREAD_MONITOR=y
CONFIG_STATS=y
CONFIG_STATS_NAMES=y
CONFIG_MGMT_FMFU=y
CONFIG_MCUMGR_CMD_OS_MGMT=y
CONFIG_MCUMGR_CMD_STAT_MGMT=y
CONFIG_MCUMGR_CMD_IMG_MGMT=y

# FLASH
CONFIG_FLASH=y
CONFIG_FLASH_PAGE_LAYOUT=y
CONFIG_FLASH_MAP=y

# Watchdog
CONFIG_TASK_WDT=y
CONFIG_TASK_WDT_CHANNELS=2
CONFIG_TASK_WDT_MIN_TIMEOUT=10000


#
# SLM-specific configurations
#
CONFIG_SLM_CUSTOMIZED=y
CONFIG_SLM_LOG_LEVEL_INF=y
CONFIG_SLM_EXTERNAL_XTAL=n
CONFIG_SLM_START_SLEEP=n
CONFIG_SLM_DATAMODE_HWFC=n
# Use UART_0 (when working with PC terminal)
#CONFIG_UART_0_NRF_HW_ASYNC_TIMER=2
# Use UART_2 (when working with external MCU)
CONFIG_SLM_CONNECT_UART_2=y
CONFIG_UART_2_NRF_HW_ASYNC_TIMER=2
CONFIG_UART_2_INTERRUPT_DRIVEN=n

CONFIG_SLM_UI=y
CONFIG_SLM_CUSTOMIZED_RS232=y

# TF-M
CONFIG_BOOTLOADER_MCUBOOT=y
CONFIG_BUILD_WITH_TFM=y
CONFIG_TFM_MCUBOOT_IMAGE_NUMBER=1
CONFIG_PM_PARTITION_SIZE_TFM=0x28000
CONFIG_PM_PARTITION_SIZE_TFM_EXTRA=0x16000
CONFIG_SLM_NATIVE_TLS_PS_WRITE_ONCE=n
CONFIG_SLM_HTTPC=n
CONFIG_SLM_MQTTC=n
CONFIG_SLM_GPS=n
```

## src/main.c
```c
/*
 * Copyright (c) 2019 Nordic Semiconductor ASA
 *
 * SPDX-License-Identifier: LicenseRef-Nordic-5-Clause
 */
#include <logging/log.h>
#include <logging/log_ctrl.h>

#include <zephyr.h>
#include <stdio.h>
#include <drivers/uart.h>
#include <drivers/gpio.h>
#include <string.h>
#include <nrf_modem.h>
#include <hal/nrf_gpio.h>
#include <hal/nrf_power.h>
#include <hal/nrf_regulators.h>
#include <hal/nrf_uarte.h>
#include <modem/nrf_modem_lib.h>
#include <modem/at_notif.h>
#include <dfu/mcuboot.h>
#include <dfu/dfu_target.h>
#include <sys/reboot.h>
#include <drivers/clock_control.h>
#include <drivers/clock_control/nrf_clock_control.h>
#include <mgmt/fmfu_mgmt.h>
#include <mgmt/fmfu_mgmt_stat.h>
#include "os_mgmt/os_mgmt.h"
#include "img_mgmt/img_mgmt.h"
#include "slm_at_host.h"
#include "slm_at_fota.h"

LOG_MODULE_REGISTER(app, CONFIG_SLM_LOG_LEVEL);

#define SLM_DFU_STATUS          0xBC  /* Flag to be saved in GPREGRET[0]*/
#define BUTTONLESS_DFU                /* Flag to support buttonless DFU */

#define SLM_WQ_STACK_SIZE       KB(2)
#define SLM_WQ_PRIORITY         K_LOWEST_APPLICATION_THREAD_PRIO
static K_THREAD_STACK_DEFINE(slm_wq_stack_area, SLM_WQ_STACK_SIZE);

static const struct device *gpio_dev;
static struct gpio_callback gpio_cb;
static struct k_work exit_idle_work;
static bool full_idle_mode;

/* global variable used across different files */
struct k_work_q slm_work_q;

/* global variable defined in different files */
extern uint8_t fota_type;
extern uint8_t fota_stage;
extern uint8_t fota_status;
extern int32_t fota_info;

/* global functions defined in different files */
int poweron_uart(bool sync_str);
int slm_settings_init(void);
int slm_setting_fota_save(void);

/**@brief Recoverable modem library error. */
void nrf_modem_recoverable_error_handler(uint32_t err)
{
	LOG_ERR("Modem library recoverable error: %u", err);
}

static void exit_idle(struct k_work *work)
{
	int err;

	LOG_INF("Exit idle, full mode: %d", full_idle_mode);
	(void)gpio_pin_interrupt_configure(gpio_dev, CONFIG_SLM_INTERFACE_PIN,
				     GPIO_INT_DISABLE);
	gpio_remove_callback(gpio_dev, &gpio_cb);
	/* Do the same as nrf_gpio_cfg_default() */
	(void)gpio_pin_configure(gpio_dev, CONFIG_SLM_INTERFACE_PIN, GPIO_INPUT);

	if (full_idle_mode) {
		/* Restart SLM services */
		err = slm_at_host_init();
		if (err) {
			LOG_ERR("Failed to init at_host: %d", err);
		}
	} else {
		/* Power on UART only */
		err = poweron_uart(true);
		if (err) {
			LOG_ERR("Failed to wake up uart: %d", err);
		}
	}
}

static void gpio_callback(const struct device *dev,
		     struct gpio_callback *gpio_cb, uint32_t pins)
{
	k_work_submit_to_queue(&slm_work_q, &exit_idle_work);
}

void enter_idle(bool full_idle)
{
	int err;

	gpio_dev = device_get_binding(DT_LABEL(DT_NODELABEL(gpio0)));
	if (gpio_dev == NULL) {
		LOG_ERR("GPIO_0 bind error");
		return;
	}
	err = gpio_pin_configure(gpio_dev, CONFIG_SLM_INTERFACE_PIN,
				GPIO_INPUT | GPIO_PULL_UP);
	if (err) {
		LOG_ERR("GPIO_0 config error: %d", err);
		return;
	}
	gpio_init_callback(&gpio_cb, gpio_callback,
			BIT(CONFIG_SLM_INTERFACE_PIN));
	err = gpio_add_callback(gpio_dev, &gpio_cb);
	if (err) {
		LOG_ERR("GPIO_0 add callback error: %d", err);
		return;
	}
	err = gpio_pin_interrupt_configure(gpio_dev, CONFIG_SLM_INTERFACE_PIN,
					   GPIO_INT_LEVEL_LOW);
	if (err) {
		LOG_ERR("GPIO_0 enable callback error: %d", err);
		return;
	}

	full_idle_mode = full_idle;
}

void enter_sleep(void)
{
	//nrf_modem_lib_shutdown();

	/*
	 * Due to errata 4, Always configure PIN_CNF[n].INPUT before PIN_CNF[n].SENSE.
	 */
	nrf_gpio_cfg_input(CONFIG_SLM_INTERFACE_PIN,
		NRF_GPIO_PIN_PULLUP);
	nrf_gpio_cfg_sense_set(CONFIG_SLM_INTERFACE_PIN,
		NRF_GPIO_PIN_SENSE_LOW);

	nrf_regulators_system_off(NRF_REGULATORS_NS);
}

void enter_dfu(void)
{
	//nrf_modem_lib_shutdown();

	nrf_power_gpregret_set(NRF_POWER_NS, SLM_DFU_STATUS);
	sys_reboot(SYS_REBOOT_COLD);
}

void handle_nrf_modem_lib_init_ret(int ret)
{
	/* Handle return values relating to modem firmware update */
	switch (ret) {
	case 0:
		return; /* Initialization successful, no action required. */
	case MODEM_DFU_RESULT_OK:
		LOG_INF("MODEM UPDATE OK. Will run new firmware");
		fota_stage = FOTA_STAGE_COMPLETE;
		fota_status = FOTA_STATUS_OK;
		fota_info = 0;
		break;
	case MODEM_DFU_RESULT_UUID_ERROR:
	case MODEM_DFU_RESULT_AUTH_ERROR:
		LOG_ERR("MODEM UPDATE ERROR %d. Will run old firmware", ret);
		fota_status = FOTA_STATUS_ERROR;
		fota_info = ret;
		break;
	case MODEM_DFU_RESULT_HARDWARE_ERROR:
	case MODEM_DFU_RESULT_INTERNAL_ERROR:
		LOG_ERR("MODEM UPDATE FATAL ERROR %d. Modem failiure", ret);
		fota_status = FOTA_STATUS_ERROR;
		fota_info = ret;
		break;
	default:
		/* All non-zero return codes other than DFU result codes are
		 * considered irrecoverable and a reboot is needed.
		 */
		LOG_ERR("nRF modem lib initialization failed, error: %d", ret);
		fota_status = FOTA_STATUS_ERROR;
		fota_info = ret;
		break;
	}

	slm_setting_fota_save();
	LOG_WRN("Rebooting...");
	LOG_PANIC();
	sys_reboot(SYS_REBOOT_COLD);
}

void start_execute(void)
{
	int err;
#if defined(CONFIG_SLM_EXTERNAL_XTAL)
	struct onoff_manager *clk_mgr;
	struct onoff_client cli = {};
#endif

	LOG_INF("Serial LTE Modem");

#if defined(CONFIG_SLM_EXTERNAL_XTAL)
	/* request external XTAL for UART */
	clk_mgr = z_nrf_clock_control_get_onoff(CLOCK_CONTROL_NRF_SUBSYS_HF);
	sys_notify_init_spinwait(&cli.notify);
	err = onoff_request(clk_mgr, &cli);
	if (err) {
		LOG_ERR("Clock request failed: %d", err);
		return;
	}
#endif

	/* Init and load settings */
	err = slm_settings_init();
	if (err) {
		LOG_ERR("Failed to init slm settings: %d", err);
		return;
	}

	/* Modem Post-FOTA handling */
	err = nrf_modem_lib_init(NORMAL_MODE);
	handle_nrf_modem_lib_init_ret(err);

	/* Init at_cmd and at_notify lib */
	err = at_cmd_init();
	if (err) {
		LOG_ERR("Failed to init at cmd: %d", err);
		return;
	}
	err = at_notif_init();
	if (err) {
		LOG_ERR("Failed to init at notify: %d", err);
		return;
	}

#if defined(CONFIG_NRF_MODEM_LIB_TRACE_ENABLED)
	/* Enable modem trace */
	static const char mdm_trace[] = "AT%XMODEMTRACE=1,2";

	if (at_cmd_write(mdm_trace, NULL, 0, NULL) != 0) {
		LOG_ERR("Failed to enable modem trace");
	}
#endif

	if (fota_type == DFU_TARGET_IMAGE_TYPE_MCUBOOT) {
		/* All initializations were successful mark image as working so that we
		 * will not revert upon reboot.
		 */
		err = boot_write_img_confirmed();
		if (fota_stage != FOTA_STAGE_INIT) {
			if (err) {
				fota_status = FOTA_STATUS_ERROR;
				fota_info = err;
			} else {
				fota_stage = FOTA_STAGE_COMPLETE;
				fota_status = FOTA_STATUS_OK;
				fota_info = 0;
			}
		}
	}

	err = slm_at_host_init();
	if (err) {
		LOG_ERR("Failed to init at_host: %d", err);
		return;
	}

	k_work_queue_start(&slm_work_q, slm_wq_stack_area,
			   K_THREAD_STACK_SIZEOF(slm_wq_stack_area),
			   SLM_WQ_PRIORITY, NULL);
	k_work_init(&exit_idle_work, exit_idle);
}

void start_dfu_execute(void)
{
	int err;

	/* Initialize modem in DFU mode */
	err = nrf_modem_lib_init(FULL_DFU_MODE);
	if (err) {
		LOG_ERR("Error in modem lib init: %d", err);
		return;
	}

	/* Register SMP Communication stats */
	fmfu_mgmt_stat_init();
	/* Registers the OS management command handler group */
	os_mgmt_register_group();
	/* Registers the image management command handler group */
	img_mgmt_register_group();
	/* Initialize MCUMgr handlers for full modem update */
	err = fmfu_mgmt_init();
	if (err) {
		LOG_ERR("Error in fmfu init: %d", err);
		return;
	}
#if MCUMGR_CONFIRM_IMAGE
	/** Need to keep in DFU mode if mcumgr would test then confirm image,
	 *  Which means two Reset by mcumgr to boot back to SLM mode
	 */
	if (boot_is_img_confirmed()) {
		LOG_INF("Current image confirmed");
		nrf_power_gpregret_set(NRF_POWER_NS, 0x00);
	} else {
		LOG_INF("Current image not confirmed yet");
	}
#else
	/** Exit DFU mode directly if mcumgr would confirm image only,
	 *  Which means one final Reset by mcumgr to boot back to SLM mode
	 */
	nrf_power_gpregret_set(NRF_POWER_NS, 0x00);
#endif
	LOG_INF("Enter DFU mode");
}

#if defined(CONFIG_SLM_START_SLEEP)
int main(void)
{
	uint32_t rr = nrf_power_resetreas_get(NRF_POWER_NS);
	uint8_t gp = nrf_power_gpregret_get(NRF_POWER_NS);

	LOG_DBG("RR: 0x%08x", rr);
	if (rr & NRF_POWER_RESETREAS_OFF_MASK) {
		nrf_power_resetreas_clear(NRF_POWER_NS, 0x70017);
		if (gp == SLM_DFU_STATUS) {
			nrf_uarte_disable(NRF_UARTE2);
			start_dfu_execute();
		} else {
			nrf_uarte_disable(NRF_UARTE0);
			nrf_uarte_enable(NRF_UARTE2);
			start_execute();
		}
	} else {
		LOG_INF("Sleep");
		enter_sleep();
	}

	return 0;
}
#else
int main(void)
{
#if defined(BUTTONLESS_DFU)
	uint8_t gp;

	gp = nrf_power_gpregret_get(NRF_POWER_NS);
	LOG_INF("GP: 0x%02x", gp);
	if (gp == SLM_DFU_STATUS) {
		nrf_uarte_disable(NRF_UARTE2);
		start_dfu_execute();
	} else {
		nrf_uarte_disable(NRF_UARTE0);
		nrf_uarte_enable(NRF_UARTE2);
		start_execute();
	}
#else
#define DFU_PIN 6
	int run_dfu;

	gpio_dev = device_get_binding(DT_LABEL(DT_NODELABEL(gpio0)));
	gpio_pin_configure(gpio_dev, DFU_PIN, GPIO_INPUT | GPIO_PULL_UP);
	k_sleep(K_MSEC(100));
	run_dfu = gpio_pin_get(gpio_dev, DFU_PIN);
	LOG_INF("run_slm: %d", run_dfu);
	if (run_dfu == 0) {
		nrf_uarte_disable(NRF_UARTE2);
		start_dfu_execute();
	} else {
		nrf_uarte_disable(NRF_UARTE0);
		nrf_uarte_enable(NRF_UARTE2);
		start_execute();
	}
#endif
	return 0;
}
#endif	/* CONFIG_SLM_GPIO_WAKEUP */
```

## src/slm_at_cmng.c
```c
/*
 * Copyright (c) 2020 Nordic Semiconductor ASA
 *
 * SPDX-License-Identifier: LicenseRef-Nordic-5-Clause
 */
#include <logging/log.h>
#include <zephyr.h>
#include <stdio.h>
#include <string.h>
#include <net/socket.h>
#include <modem/modem_info.h>
#include <modem/modem_key_mgmt.h>
#include "slm_util.h"
#include "slm_native_tls.h"
#include "slm_at_cmng.h"
#include "slm_native_tls_ps.h"

LOG_MODULE_REGISTER(cmng, CONFIG_SLM_LOG_LEVEL);

/**@brief List of supported opcode */
enum slm_xcmng_opcode {
	AT_XCMNG_OP_WRITE,
	AT_XCMNG_OP_LIST,
	AT_XCMNG_OP_READ,
	AT_XCMNG_OP_DELETE
};

/**@brief List of supported type */
enum slm_xcmng_type {
	AT_XCMNG_TYPE_CA_CERT,
	AT_XCMNG_TYPE_CERT,
	AT_XCMNG_TYPE_PRIV,
	AT_XCMNG_TYPE_PSK,
	AT_XCMNG_TYPE_PSK_ID,
	AT_XCMNG_TYPE_ENDORSEMENT_KEY = 8,
	AT_XCMNG_TYPE_NORDIC_ROOT_CA = 10,
	AT_XCMNG_TYPE_NORDIC_BASE_PUBKEY = 11,
};

#define MODEM_KEY_MGMT_OP_LS "AT%CMNG=1"

/* global functions defined in different files */
void rsp_send(const uint8_t *str, size_t len);

/* global variable defined in different files */
extern struct at_param_list at_param_list;
extern char rsp_buf[CONFIG_AT_CMD_RESPONSE_MAX_LEN];

/**@brief handle AT%CMNG commands
 *  AT%CMNG=<opcode>[,<sec_tag>[,<type>[,<content>]]]
 *  AT%CMNG? READ command not supported
 *  AT%CMNG=? READ command not supported
 */
int handle_at_cmng(enum at_cmd_type cmd_type)
{
	int err = -ENOENT;
	uint16_t op;
	nrf_sec_tag_t sec_tag;

	switch (cmd_type) {
	case AT_CMD_TYPE_SET_COMMAND:
		if (at_params_valid_count_get(&at_param_list) >= 3) {
			err = at_params_unsigned_int_get(&at_param_list, 2, &sec_tag);
			if (err < 0) {
				LOG_ERR("Fail to get sec_tag parameter: %d", err);
				return -EINVAL;
			}
			if (sec_tag > MAX_MODEM_TLS_SEC_TAG) {
				LOG_ERR("Invalid security tag: %d", sec_tag);
				return -EINVAL;
			} else {
				return -ENOENT;
			}
		} else if (at_params_valid_count_get(&at_param_list) == 2) {
			err = at_params_unsigned_short_get(&at_param_list, 1, &op);
			if (err < 0) {
				LOG_ERR("Fail to get op parameter: %d", err);
				return err;
			}
			if (op == AT_XCMNG_OP_LIST) {
				int written;
				char cmd[32];
				enum at_cmd_state state;

				written = snprintf(cmd, sizeof(cmd), "%s", MODEM_KEY_MGMT_OP_LS);
				if (written < 0 || written >= sizeof(cmd)) {
					return -ENOBUFS;
				}

				err = at_cmd_write(cmd, rsp_buf, CONFIG_AT_CMD_RESPONSE_MAX_LEN, &state);
				if (err == -EAGAIN) {
					LOG_ERR("AT command timed out, indicating a modem issue");
					slm_util_reboot(3);

					CODE_UNREACHABLE;
					return err;
				} else if (err) {
					return -EINVAL;
				}

				if (strlen(rsp_buf) > 0) {
					char *ch = rsp_buf;

					/* find sub string %CMNG */
					while( (ch = strstr(ch,"%CMNG: ")) != NULL) {
						char xrsp_buf[32];
						unsigned int ctag = 0, ctype = 0;

						/* remap sec_tag and type */
						sscanf(ch, "%*s%u,%u", &ctag, &ctype);
						if (ctag <= MAX_MODEM_TLS_SEC_TAG) {
							sprintf(xrsp_buf, "%%CMNG: %u,%u\r\n", ctag, ctype);
							rsp_send(xrsp_buf, strlen(xrsp_buf));
						}
						ch = ch + strlen("%CMNG: ");
					}
				}
				return 0;
			}
		}
		break;

	default:
		break;
	}

	return err;
}

/**@brief handle AT#XCMNG commands
 *  AT#XCMNG=<opcode>[,<sec_tag>[,<type>[,<content>]]]
 *  AT#XCMNG? READ command not supported
 *  AT#XCMNG=? READ command not supported
 */
int handle_at_xcmng(enum at_cmd_type cmd_type)
{
	int err = -EINVAL;
	uint16_t op, type;
	nrf_sec_tag_t sec_tag;
	uint8_t *content = NULL;
	size_t len = CONFIG_AT_CMD_RESPONSE_MAX_LEN;

	switch (cmd_type) {
	case AT_CMD_TYPE_SET_COMMAND:
		if (at_params_valid_count_get(&at_param_list) < 2) {
			LOG_ERR("Parameter missed");
			return -EINVAL;
		}
		err = at_params_unsigned_short_get(&at_param_list, 1, &op);
		if (err < 0) {
			LOG_ERR("Fail to get op parameter: %d", err);
			return err;
		}
		if (op > AT_XCMNG_OP_DELETE) {
			LOG_ERR("Wrong XCMNG operation: %d", op);
			return -EPERM;
		}
		if (op == AT_XCMNG_OP_LIST) {
			int written;
			char cmd[32];

			written = snprintf(cmd, sizeof(cmd), "%s", MODEM_KEY_MGMT_OP_LS);
			if (written < 0 || written >= sizeof(cmd)) {
				return -ENOBUFS;
			}
#if defined(CONFIG_SLM_NATIVE_TLS_PS)
			slm_tls_tbl_dump();
#else
			enum at_cmd_state state;

			err = at_cmd_write(cmd, rsp_buf, CONFIG_AT_CMD_RESPONSE_MAX_LEN, &state);
			if (err == -EAGAIN) {
				LOG_ERR("AT command timed out, indicating a modem issue");
				slm_util_reboot(3);

				CODE_UNREACHABLE;
				return err;
			} else if (err) {
				return -EINVAL;
			}

			if (strlen(rsp_buf) > 0) {
				char *ch = rsp_buf;

				/* find sub string %CMNG */
				while( (ch = strstr(ch,"%CMNG: ")) != NULL) {
					char xrsp_buf[32];
					unsigned int ctag = 0, ctype = 0;
					/* remap sec_tag and type */
					sscanf(ch, "%*s%u,%u", &ctag, &ctype);
					if ((ctype == AT_XCMNG_TYPE_CA_CERT) && (ctag >= MIN_NATIVE_TLS_SEC_TAG)
						&& (ctag <= (MAX_NATIVE_TLS_SEC_TAG + 1) * 10)) {
						sprintf(xrsp_buf, "#XCMNG: %u,%u\r\n", ctag / 10, ctag % 10);
						rsp_send(xrsp_buf, strlen(xrsp_buf));
					}
					ch = ch + strlen("%CMNG: ");
				}
			}
#endif
			return 0;
		}
		if (at_params_valid_count_get(&at_param_list) < 4) {
			/* READ, WRITE, DELETE requires sec_tag and type */
			LOG_ERR("Parameter missed");
			return -EINVAL;
		}
		err = at_params_unsigned_int_get(&at_param_list, 2, &sec_tag);
		if (err < 0) {
			LOG_ERR("Fail to get sec_tag parameter: %d", err);
			return err;
		};
		if ((sec_tag < MIN_NATIVE_TLS_SEC_TAG) || (sec_tag > MAX_NATIVE_TLS_SEC_TAG)) {
			LOG_ERR("Invalid security tag: %d", sec_tag);
			return -EINVAL;
		}
		err = at_params_unsigned_short_get(&at_param_list, 3, &type);
		if (err < 0) {
			LOG_ERR("Fail to get type parameter: %d", err);
			return err;
		};
		if (op == AT_XCMNG_OP_WRITE) {
			if (at_params_valid_count_get(&at_param_list) < 5) {
				/* WRITE requires sec_tag, type and content */
				LOG_ERR("Parameter missed");
				return -EINVAL;
			}
			content = k_malloc(CONFIG_AT_CMD_RESPONSE_MAX_LEN);
			if (content == NULL) {
				LOG_ERR("Fail to allocate memory");
				return -ENOMEM;
			}
			err = util_string_get(&at_param_list, 4, content,
						   &len);
			if (err != 0) {
				LOG_ERR("Failed to get content");
				k_free(content);
				return err;
			}
			err = slm_tls_storage_set(sec_tag, type, content, len);
			if (err != 0) {
#if defined(CONFIG_SLM_NATIVE_TLS_PS)
				LOG_ERR("FAILED! slm_tls_ps_set() = %d",
					err);
#else
				LOG_ERR("FAILED! modem_key_mgmt_write() = %d",
					err);
#endif
			}
			k_free(content);
		} else if (op == AT_XCMNG_OP_READ) {
			if (type == AT_XCMNG_TYPE_CERT ||
			   type == AT_XCMNG_TYPE_PRIV ||
			   type == AT_XCMNG_TYPE_PSK ||
			   type == AT_XCMNG_TYPE_NORDIC_ROOT_CA) {
				/* Not supported */
				LOG_ERR("Not support READ for type: %d", type);
				return -EPERM;
			}
			content = k_malloc(CONFIG_AT_CMD_RESPONSE_MAX_LEN);
			if (content == NULL) {
				LOG_ERR("Fail to allocate memory");
				return -ENOMEM;
			}
			err = slm_tls_storage_get(sec_tag, type, content,
						CONFIG_AT_CMD_RESPONSE_MAX_LEN,
						&len);
			if (err != 0) {
#if defined(CONFIG_SLM_NATIVE_TLS_PS)
				LOG_ERR("FAILED! slm_tls_ps_get() = %d",
					err);
#else
				LOG_ERR("FAILED! modem_key_mgmt_read() = %d",
					err);
#endif
			} else {
				*(content + len) = '\0';
				sprintf(rsp_buf, "#XCMNG: %d,%d,\"\","
					"\"%s\"\r\n", sec_tag, type, content);
				rsp_send(rsp_buf, strlen(rsp_buf));
			}
			k_free(content);
		} else if (op == AT_XCMNG_OP_DELETE) {
			err = slm_tls_storage_remove(sec_tag, type);
			if (err != 0) {
#if defined(CONFIG_SLM_NATIVE_TLS_PS)
				LOG_ERR("FAILED! slm_tls_ps_remove() = %d",
					err);
#else
				LOG_ERR("FAILED! modem_key_mgmt_delete() = %d",
					err);
#endif
			}
		}
		break;

	default:
		break;
	}

	return err;
}

/**@brief API to initialize CMNG AT commands handler
 */
int slm_at_cmng_init(void)
{
	return 0;
}

/**@brief API to uninitialize CMNG AT commands handler
 */
int slm_at_cmng_uninit(void)
{
	return 0;
}
```

## src/slm_at_commands.c
```c
/*
 * Copyright (c) 2021 Nordic Semiconductor ASA
 *
 * SPDX-License-Identifier: LicenseRef-Nordic-5-Clause
 */
#include <zephyr/types.h>
#include <sys/util.h>
#include <zephyr.h>
#include <stdio.h>
#include <ctype.h>
#include <logging/log.h>
#include <drivers/uart.h>
#include <string.h>
#include <init.h>
#include <modem/at_cmd.h>
#include <modem/at_cmd_parser.h>
#include <sys/reboot.h>
#include "ncs_version.h"

#include "slm_util.h"
#include "slm_at_host.h"
#include "slm_at_tcp_proxy.h"
#include "slm_at_udp_proxy.h"
#include "slm_at_tcpip.h"
#if defined(CONFIG_SLM_NATIVE_TLS)
#include "slm_at_cmng.h"
#endif
#include "slm_at_icmp.h"
#include "slm_at_sms.h"
#include "slm_at_fota.h"
#if defined(CONFIG_SLM_GPS)
#include "slm_at_gps.h"
#endif
#if defined(CONFIG_SLM_FTPC)
#include "slm_at_ftp.h"
#endif
#if defined(CONFIG_SLM_MQTTC)
#include "slm_at_mqtt.h"
#endif
#if defined(CONFIG_SLM_HTTPC)
#include "slm_at_httpc.h"
#endif
#if defined(CONFIG_SLM_UI)
#include "slm_ui.h"
#endif
#if defined(CONFIG_SLM_TWI)
#include "slm_at_twi.h"
#endif
#if defined(CONFIG_SLM_GPIO)
#include "slm_at_gpio.h"
#endif
#if defined(CONFIG_SLM_HW_REV)
#include "slm_at_hw_rev.h"
#endif
#if defined(CONFIG_SLM_UC)
#include "slm_at_uc.h"
#endif

LOG_MODULE_REGISTER(slm_at, CONFIG_SLM_LOG_LEVEL);

/**@brief Shutdown modes. */
enum shutdown_modes {
	SHUTDOWN_MODE_IDLE,
	SHUTDOWN_MODE_SLEEP,
	SHUTDOWN_MODE_UART,
	SHUTDOWN_MODE_INVALID
};

/**@brief AT command handler type. */
typedef int (*slm_at_handler_t) (enum at_cmd_type);

static struct slm_work_info {
	struct k_work_delayable work;
	uint32_t data;
	uint8_t hwfc;
} slm_work;

/* global variable defined in different files */
extern struct at_param_list at_param_list;
extern char rsp_buf[CONFIG_AT_CMD_RESPONSE_MAX_LEN];
extern uint16_t datamode_time_limit;
extern struct uart_config slm_uart;

/* global functions defined in different files */
void enter_idle(bool full_idle);
void enter_sleep(void);
void enter_dfu(void);
int slm_uart_configure(uint32_t baudrate, uint8_t hwfc);
void rsp_send(const uint8_t *str, size_t len);
int poweroff_uart(void);
bool verify_datamode_control(uint16_t time_limit, uint16_t *time_limit_min);
extern int slm_setting_uart_save(void);

static void modem_power_off(void)
{
	int err;

	/*
	 * The LTE modem also needs to be stopped by issuing AT command
	 * through the modem API, before entering System OFF mode.
	 * Once the command is issued, one should wait for the modem
	 * to respond that it actually has stopped as there may be a
	 * delay until modem is disconnected from the network.
	 * Refer to https://infocenter.nordicsemi.com/topic/ps_nrf9160/
	 * pmu.html?cp=2_0_0_4_0_0_1#system_off_mode
	 */
	err = at_cmd_write("AT+CFUN=0", NULL, 0, NULL);
	if (err == -EAGAIN) {
		LOG_ERR("AT command timed out, indicating a modem issue");
		slm_util_reboot(3);

		CODE_UNREACHABLE;
		return;
	} else if (err) {
		LOG_ERR("Failed to power off modem: %d", err);
	}

	k_sleep(K_SECONDS(1));
}

/**@brief handle AT#XSLMVER commands
 *  #XSLMVER
 *  AT#XSLMVER? not supported
 *  AT#XSLMVER=? not supported
 */
static int handle_at_slmver(enum at_cmd_type type)
{
	int ret = -EINVAL;

	if (type == AT_CMD_TYPE_SET_COMMAND) {
#if defined(CONFIG_SLM_CUSTOMIZED)
		sprintf(rsp_buf, "\r\n#XSLMVER: \"Customized v1.0\"\r\n");
#else
		sprintf(rsp_buf, "\r\n#XSLMVER: %s\r\n",
			STRINGIFY(NCS_VERSION_STRING));
#endif
		rsp_send(rsp_buf, strlen(rsp_buf));
		ret = 0;
	}

	return ret;
}

/**@brief handle AT#XSLEEP commands
 *  AT#XSLEEP[=<shutdown_mode>]
 *  AT#XSLEEP? not supported
 *  AT#XSLEEP=?
 */
static int handle_at_sleep(enum at_cmd_type type)
{
	int ret = -EINVAL;

	if (type == AT_CMD_TYPE_SET_COMMAND) {
		uint16_t shutdown_mode = SHUTDOWN_MODE_IDLE;

		if (at_params_valid_count_get(&at_param_list) > 1) {
			ret = at_params_unsigned_short_get(&at_param_list, 1, &shutdown_mode);
			if (ret < 0) {
				return -EINVAL;
			}
		}
		if (shutdown_mode == SHUTDOWN_MODE_IDLE) {
			slm_at_host_uninit();
			enter_idle(true);
			ret = -ESHUTDOWN; /*Will send no "OK"*/
		} else if (shutdown_mode == SHUTDOWN_MODE_SLEEP) {
#if defined(CONFIG_SLM_GPIO_WAKEUP)
			slm_at_host_uninit();
			modem_power_off();
			enter_sleep();
			ret = 0; /* Cannot reach here */
#else
			LOG_ERR("Enter sleep without wakeup");
			ret = -EINVAL;
#endif
		} else if (shutdown_mode == SHUTDOWN_MODE_UART) {
			ret = poweroff_uart();
			if (ret == 0) {
				enter_idle(false);
				ret = -ESHUTDOWN; /*Will send no "OK"*/
			}
		} else {
			LOG_ERR("AT parameter error");
			ret = -EINVAL;
		}
	} else if (type == AT_CMD_TYPE_TEST_COMMAND) {
		sprintf(rsp_buf, "\r\n#XSLEEP: (%d,%d,%d)\r\n", SHUTDOWN_MODE_IDLE,
			SHUTDOWN_MODE_SLEEP, SHUTDOWN_MODE_UART);
		rsp_send(rsp_buf, strlen(rsp_buf));
		ret = 0;
	}

	return ret;
}

/**@brief handle AT#XDFU commands
 *  AT#XDFU
 *  AT#XDFU? not supported
 *  AT#XDFU=? not supported
 */
static int handle_at_dfu(enum at_cmd_type type)
{
	int ret = -EINVAL;
	char ok_str[] = "\r\nOK\r\n";

	if (type == AT_CMD_TYPE_SET_COMMAND) {
		rsp_send(ok_str, strlen(ok_str));
		k_sleep(K_MSEC(50));
		slm_at_host_uninit();
		modem_power_off();
		enter_dfu();
		ret = 0; /* Cannot reach here */
	}

	return ret;
}

/**@brief handle AT#XRESET commands
 *  AT#XRESET
 *  AT#XRESET? not supported
 *  AT#XRESET=? not supported
 */
static int handle_at_reset(enum at_cmd_type type)
{
	int ret = -EINVAL;
	char ok_str[] = "\r\nOK\r\n";

	if (type == AT_CMD_TYPE_SET_COMMAND) {
		rsp_send(ok_str, strlen(ok_str));
		k_sleep(K_MSEC(50));
		slm_at_host_uninit();
		modem_power_off();
		slm_util_reboot(1);
	}

	return ret;
}

static void set_uart_wk(struct k_work *work)
{
	int err = 0;

	slm_uart_configure(slm_work.data, slm_work.hwfc);
	err = slm_setting_uart_save();
	if (err != 0) {
		LOG_ERR("uart_config_get: %d", err);
	}
}

/**@brief handle AT#XSLMUART commands
 *  AT#XSLMUART[=<baud_rate>]
 *  AT#XSLMUART?
 *  AT#XSLMUART=?
 */
static int handle_at_slmuart(enum at_cmd_type type)
{
	int ret = -EINVAL;

	if (type == AT_CMD_TYPE_SET_COMMAND) {
		uint32_t baudrate = 115200;
		uint16_t hwfc = 0;

		if (at_params_valid_count_get(&at_param_list) >= 2) {
			ret = at_params_unsigned_int_get(&at_param_list, 1, &baudrate);
			if (ret) {
				LOG_ERR("AT parameter error");
				return -EINVAL;
			}
		switch (baudrate) {
		case 1200:
		case 2400:
		case 4800:
		case 9600:
		case 14400:
		case 19200:
		case 38400:
		case 57600:
		case 115200:
		case 230400:
		case 460800:
		case 921600:
		case 1000000:
			slm_work.data = baudrate;
			break;
		default:
			LOG_ERR("Invalid uart baud rate provided.");
			return -EINVAL;
		}
#if defined(CONFIG_SLM_UART_HWFC_RUNTIME)
			ret = at_params_unsigned_short_get(&at_param_list, 2, &hwfc);
			if (ret) {
				LOG_ERR("AT parameter error");
				return -EINVAL;
			}
#endif
			if ((hwfc != 1) && (hwfc != 0)) {
				LOG_ERR("Invalid uart hwfc provided.");
				return -EINVAL;
			}
			slm_work.hwfc = (uint8_t)hwfc;
		} else {
			return ret;
		}
		k_work_init_delayable(&slm_work.work, set_uart_wk);
		k_work_reschedule(&slm_work.work, K_MSEC(50));
	}

	if (type == AT_CMD_TYPE_READ_COMMAND) {
		sprintf(rsp_buf, "\r\n#XSLMUART: %d,%d\r\n", slm_uart.baudrate, slm_uart.flow_ctrl);
		rsp_send(rsp_buf, strlen(rsp_buf));
		ret = 0;
	}
#if defined(CONFIG_SLM_UART_HWFC_RUNTIME)
	if (type == AT_CMD_TYPE_TEST_COMMAND) {
		sprintf(rsp_buf, "\r\n#XSLMUART: (1200,2400,4800,9600,14400,19200,38400,57600,"
				 "115200,230400,460800,921600,1000000),(0,1)\r\n");
		rsp_send(rsp_buf, strlen(rsp_buf));
		ret = 0;
	}
#else
	if (type == AT_CMD_TYPE_TEST_COMMAND) {
		sprintf(rsp_buf, "\r\n#XSLMUART: (1200,2400,4800,9600,14400,19200,38400,57600,"
				 "115200,230400,460800,921600,1000000)\r\n");
		rsp_send(rsp_buf, strlen(rsp_buf));
		ret = 0;
	}
#endif
	return ret;
}

/**@brief handle AT#XDATACTRL commands
 *  AT#XDATACTRL=<time_limit>
 *  AT#XDATACTRL?
 *  AT#XDATACTRL=?
 */
static int handle_at_datactrl(enum at_cmd_type cmd_type)
{
	int ret = 0;
	uint16_t time_limit, time_limit_min;

	switch (cmd_type) {
	case AT_CMD_TYPE_SET_COMMAND:
		ret = at_params_unsigned_short_get(&at_param_list, 1, &time_limit);
		if (ret) {
			return ret;
		}
		if (verify_datamode_control(time_limit, NULL)) {
			datamode_time_limit = time_limit;
		} else {
			return -EINVAL;
		}
		break;

	case AT_CMD_TYPE_READ_COMMAND:
		(void)verify_datamode_control(datamode_time_limit, &time_limit_min);
		sprintf(rsp_buf, "\r\n#XDATACTRL: %d,%d\r\n", datamode_time_limit, time_limit_min);
		rsp_send(rsp_buf, strlen(rsp_buf));
		break;

	case AT_CMD_TYPE_TEST_COMMAND:
		sprintf(rsp_buf, "\r\n#XDATACTRL=<time_limit>\r\n");
		rsp_send(rsp_buf, strlen(rsp_buf));
		break;

	default:
		break;
	}

	return ret;
}

/**@brief handle AT#XCLAC commands
 *  AT#XCLAC
 *  AT#XCLAC? not supported
 *  AT#XCLAC=? not supported
 */
int handle_at_clac(enum at_cmd_type cmd_type);

/* TCP proxy commands */
int handle_at_tcp_filter(enum at_cmd_type cmd_type);
int handle_at_tcp_server(enum at_cmd_type cmd_type);
int handle_at_tcp_client(enum at_cmd_type cmd_type);
int handle_at_tcp_send(enum at_cmd_type cmd_type);
int handle_at_tcp_recv(enum at_cmd_type cmd_type);
int handle_at_tcp_server_auto_accept(enum at_cmd_type cmd_type);
int handle_at_tcp_server_accept_reject(enum at_cmd_type cmd_type);

/* UDP proxy commands */
int handle_at_udp_server(enum at_cmd_type cmd_type);
int handle_at_udp_client(enum at_cmd_type cmd_type);
int handle_at_udp_send(enum at_cmd_type cmd_type);

/* Socket-type TCPIP commands */
int handle_at_socket(enum at_cmd_type cmd_type);
int handle_at_socketopt(enum at_cmd_type cmd_type);
int handle_at_secure_socketopt(enum at_cmd_type cmd_type);
int handle_at_bind(enum at_cmd_type cmd_type);
int handle_at_connect(enum at_cmd_type cmd_type);
int handle_at_listen(enum at_cmd_type cmd_type);
int handle_at_accept(enum at_cmd_type cmd_type);
int handle_at_send(enum at_cmd_type cmd_type);
int handle_at_recv(enum at_cmd_type cmd_type);
int handle_at_sendto(enum at_cmd_type cmd_type);
int handle_at_recvfrom(enum at_cmd_type cmd_type);
int handle_at_getaddrinfo(enum at_cmd_type cmd_type);

#if defined(CONFIG_SLM_NATIVE_TLS)
int handle_at_cmng(enum at_cmd_type cmd_type);
int handle_at_xcmng(enum at_cmd_type cmd_type);
#endif

/* ICMP commands */
int handle_at_icmp_ping(enum at_cmd_type cmd_type);

#if defined(CONFIG_SLM_SMS)
/* SMS commands */
int handle_at_sms(enum at_cmd_type cmd_type);
#endif

/* FOTA commands */
int handle_at_fota(enum at_cmd_type cmd_type);

#if defined(CONFIG_SLM_GPS)
int handle_at_gps(enum at_cmd_type cmd_type);
#endif

#if defined(CONFIG_SLM_FTPC)
int handle_at_ftp(enum at_cmd_type cmd_type);
#endif

#if defined(CONFIG_SLM_MQTTC)
int handle_at_mqtt_connect(enum at_cmd_type cmd_type);
int handle_at_mqtt_publish(enum at_cmd_type cmd_type);
int handle_at_mqtt_subscribe(enum at_cmd_type cmd_type);
int handle_at_mqtt_unsubscribe(enum at_cmd_type cmd_type);
#endif

#if defined(CONFIG_SLM_HTTPC)
int handle_at_httpc_connect(enum at_cmd_type cmd_type);
int handle_at_httpc_request(enum at_cmd_type cmd_type);
#endif

#if defined(CONFIG_SLM_TWI)
int handle_at_twi_list(enum at_cmd_type cmd_type);
int handle_at_twi_write(enum at_cmd_type cmd_type);
int handle_at_twi_read(enum at_cmd_type cmd_type);
int handle_at_twi_write_read(enum at_cmd_type cmd_type);
#endif

#if defined(CONFIG_SLM_GPIO)
int handle_at_gpio_configure(enum at_cmd_type cmd_type);
int handle_at_gpio_operate(enum at_cmd_type cmd_type);
#endif

#if defined(CONFIG_SLM_HW_REV)
int handle_at_hw_rev(enum at_cmd_type cmd_type);
#endif
#if defined(CONFIG_SLM_UC)
int handle_at_uc(enum at_cmd_type cmd_type);
#endif

static struct slm_at_cmd {
	char *string;
	slm_at_handler_t handler;
} slm_at_cmd_list[] = {
	/* Generic commands */
	{"AT#XSLMVER", handle_at_slmver},
	{"AT#XSLEEP", handle_at_sleep},
	{"AT#XDFU", handle_at_dfu},
	{"AT#XRESET", handle_at_reset},
	{"AT#XCLAC", handle_at_clac},
	{"AT#XSLMUART", handle_at_slmuart},
	{"AT#XDATACTRL", handle_at_datactrl},

	/* TCP proxy commands */
	{"AT#XTCPFILTER", handle_at_tcp_filter},
	{"AT#XTCPSVR", handle_at_tcp_server},
	{"AT#XTCPCLI", handle_at_tcp_client},
	{"AT#XTCPSEND", handle_at_tcp_send},
	{"AT#XTCPRECV", handle_at_tcp_recv},
	{"AT#XTCPSVRAA", handle_at_tcp_server_auto_accept},
	{"AT#XTCPSVRAR", handle_at_tcp_server_accept_reject},

	/* UDP proxy commands */
	{"AT#XUDPSVR", handle_at_udp_server},
	{"AT#XUDPCLI", handle_at_udp_client},
	{"AT#XUDPSEND", handle_at_udp_send},

	/* Socket-type TCPIP commands */
	{"AT#XSOCKET", handle_at_socket},
	{"AT#XSOCKETOPT", handle_at_socketopt},
	{"AT#XSSOCKETOPT", handle_at_secure_socketopt},
	{"AT#XBIND", handle_at_bind},
	{"AT#XCONNECT", handle_at_connect},
	{"AT#XLISTEN", handle_at_listen},
	{"AT#XACCEPT", handle_at_accept},
	{"AT#XSEND", handle_at_send},
	{"AT#XRECV", handle_at_recv},
	{"AT#XSENDTO", handle_at_sendto},
	{"AT#XRECVFROM", handle_at_recvfrom},
	{"AT#XGETADDRINFO", handle_at_getaddrinfo},

#if defined(CONFIG_SLM_NATIVE_TLS)
	/* Hijacked Modem TLS cmng command */
	{"AT%CMNG", handle_at_cmng},
	/* Native TLS cmng command */
	{"AT#XCMNG", handle_at_xcmng},
#endif
	/* ICMP commands */
	{"AT#XPING", handle_at_icmp_ping},

#if defined(CONFIG_SLM_SMS)
	/* SMS commands */
	{"AT#XSMS", handle_at_sms},
#endif

	/* FOTA commands */
	{"AT#XFOTA", handle_at_fota},

#if defined(CONFIG_SLM_GPS)
	/* GPS commands */
	{"AT#XGPS", handle_at_gps},
#endif

#if defined(CONFIG_SLM_FTPC)
	/* FTP commands */
	{"AT#XFTP", handle_at_ftp},
#endif

#if defined(CONFIG_SLM_MQTTC)
	{"AT#XMQTTCON", handle_at_mqtt_connect},
	{"AT#XMQTTPUB", handle_at_mqtt_publish},
	{"AT#XMQTTSUB", handle_at_mqtt_subscribe},
	{"AT#XMQTTUNSUB", handle_at_mqtt_unsubscribe},
#endif

#if defined(CONFIG_SLM_HTTPC)
	{"AT#XHTTPCCON", handle_at_httpc_connect},
	{"AT#XHTTPCREQ", handle_at_httpc_request},
#endif

#if defined(CONFIG_SLM_TWI)
	{"AT#XTWILS", handle_at_twi_list},
	{"AT#XTWIW", handle_at_twi_write},
	{"AT#XTWIR", handle_at_twi_read},
	{"AT#XTWIWR", handle_at_twi_write_read},
#endif

#if defined(CONFIG_SLM_GPIO)
	{"AT#XGPIOC", handle_at_gpio_configure},
	{"AT#XGPIO", handle_at_gpio_operate},
#endif

#if defined(CONFIG_SLM_HW_REV)
	{"AT#XSLMHWREV", handle_at_hw_rev},
#endif

#if defined(CONFIG_SLM_UC)
	{"AT#XUC", handle_at_uc},
#endif
};

int handle_at_clac(enum at_cmd_type cmd_type)
{
	int ret = -EINVAL;

	if (cmd_type == AT_CMD_TYPE_SET_COMMAND) {
		int total = ARRAY_SIZE(slm_at_cmd_list);

		for (int i = 0; i < total; i++) {
			sprintf(rsp_buf, "%s\r\n", slm_at_cmd_list[i].string);
			rsp_send(rsp_buf, strlen(rsp_buf));
		}
		ret = 0;
	}

	return ret;
}

int slm_at_parse(const char *at_cmd)
{
	int ret = -ENOENT;
	int total = ARRAY_SIZE(slm_at_cmd_list);

	for (int i = 0; i < total; i++) {
		if (slm_util_cmd_casecmp(at_cmd, slm_at_cmd_list[i].string)) {
			enum at_cmd_type type = at_parser_cmd_type_get(at_cmd);

			ret = at_parser_params_from_str(at_cmd, NULL, &at_param_list);
			if (ret) {
				LOG_ERR("Failed to parse AT command %d", ret);
				return -EINVAL;
			}
			ret = slm_at_cmd_list[i].handler(type);
			break;
		}
	}

	return ret;
}

int slm_at_init(void)
{
	int err;

	k_work_init_delayable(&slm_work.work, set_uart_wk);

	err = slm_at_tcp_proxy_init();
	if (err) {
		LOG_ERR("TCP Server could not be initialized: %d", err);
		return -EFAULT;
	}
	err = slm_at_udp_proxy_init();
	if (err) {
		LOG_ERR("UDP Server could not be initialized: %d", err);
		return -EFAULT;
	}
	err = slm_at_tcpip_init();
	if (err) {
		LOG_ERR("TCPIP could not be initialized: %d", err);
		return -EFAULT;
	}
#if defined(CONFIG_SLM_NATIVE_TLS)
	err = slm_at_cmng_init();
	if (err) {
		LOG_ERR("TLS could not be initialized: %d", err);
		return -EFAULT;
	}
#endif
	err = slm_at_icmp_init();
	if (err) {
		LOG_ERR("ICMP could not be initialized: %d", err);
		return -EFAULT;
	}
#if defined(CONFIG_SLM_GPS)
	err = slm_at_sms_init();
	if (err) {
		LOG_ERR("SMS could not be initialized: %d", err);
		return -EFAULT;
	}
#endif
	err = slm_at_fota_init();
	if (err) {
		LOG_ERR("FOTA could not be initialized: %d", err);
		return -EFAULT;
	}
#if defined(CONFIG_SLM_GPS)
	err = slm_at_gps_init();
	if (err) {
		LOG_ERR("GPS could not be initialized: %d", err);
		return -EFAULT;
	}
#endif
#if defined(CONFIG_SLM_FTPC)
	err = slm_at_ftp_init();
	if (err) {
		LOG_ERR("FTP could not be initialized: %d", err);
		return -EFAULT;
	}
#endif
#if defined(CONFIG_SLM_MQTTC)
	err = slm_at_mqtt_init();
	if (err) {
		LOG_ERR("MQTT could not be initialized: %d", err);
		return -EFAULT;
	}
#endif
#if defined(CONFIG_SLM_HTTPC)
	err = slm_at_httpc_init();
	if (err) {
		LOG_ERR("HTTP could not be initialized: %d", err);
		return -EFAULT;
	}
#endif
#if defined(CONFIG_SLM_GPIO)
	err = slm_at_gpio_init();
	if (err) {
		LOG_ERR("GPIO could not be initialized: %d", err);
		return -EFAULT;
	}
#endif
#if defined(CONFIG_SLM_UI)
	err = slm_ui_init();
	if (err) {
		LOG_ERR("Failed to init ui: %d", err);
		return -EFAULT;
	}
#endif
#if defined(CONFIG_SLM_TWI)
	err = slm_at_twi_init();
	if (err) {
		LOG_ERR("TWI could not be initialized: %d", err);
		return -EFAULT;
	}
#endif
#if defined(CONFIG_SLM_HW_REV)
	err = slm_at_hw_rev_init();
	if (err) {
		LOG_ERR("HW revision could not be initialized: %d", err);
		return -EFAULT;
	}
#endif
#if defined(CONFIG_SLM_UC)
	err = slm_at_uc_init();
	if (err) {
		LOG_ERR("User Config could not be initialized: %d", err);
		return -EFAULT;
	}
#endif

	return err;
}

void slm_at_uninit(void)
{
	int err;

	err = slm_at_tcp_proxy_uninit();
	if (err) {
		LOG_WRN("TCP Server could not be uninitialized: %d", err);
	}
	err = slm_at_udp_proxy_uninit();
	if (err) {
		LOG_WRN("UDP Server could not be uninitialized: %d", err);
	}
	err = slm_at_tcpip_uninit();
	if (err) {
		LOG_WRN("TCPIP could not be uninitialized: %d", err);
	}
#if defined(CONFIG_SLM_NATIVE_TLS)
	err = slm_at_cmng_uninit();
	if (err) {
		LOG_WRN("TLS could not be uninitialized: %d", err);
	}
#endif
	err = slm_at_icmp_uninit();
	if (err) {
		LOG_WRN("ICMP could not be uninitialized: %d", err);
	}
#if defined(CONFIG_SLM_GPS)
	err = slm_at_sms_uninit();
	if (err) {
		LOG_WRN("SMS could not be uninitialized: %d", err);
	}
#endif
	err = slm_at_fota_uninit();
	if (err) {
		LOG_WRN("FOTA could not be uninitialized: %d", err);
	}
#if defined(CONFIG_SLM_GPS)
	err = slm_at_gps_uninit();
	if (err) {
		LOG_WRN("GPS could not be uninitialized: %d", err);
	}
#endif
#if defined(CONFIG_SLM_FTPC)
	err = slm_at_ftp_uninit();
	if (err) {
		LOG_WRN("FTP could not be uninitialized: %d", err);
	}
#endif
#if defined(CONFIG_SLM_MQTTC)
	err = slm_at_mqtt_uninit();
	if (err) {
		LOG_WRN("MQTT could not be uninitialized: %d", err);
	}
#endif
#if defined(CONFIG_SLM_HTTPC)
	err = slm_at_httpc_uninit();
	if (err) {
		LOG_WRN("HTTP could not be uninitialized: %d", err);
	}
#endif
#if defined(CONFIG_SLM_UI)
	err = slm_ui_uninit();
	if (err) {
		LOG_ERR("Failed to uninit ui: %d", err);
	}
#endif
#if defined(CONFIG_SLM_TWI)
	err = slm_at_twi_uninit();
	if (err) {
		LOG_ERR("TWI could not be uninit: %d", err);
	}
#endif
#if defined(CONFIG_SLM_GPIO)
	err = slm_at_gpio_uninit();
	if (err) {
		LOG_ERR("GPIO could not be uninit: %d", err);
	}
#endif
#if defined(CONFIG_SLM_HW_REV)
	err = slm_at_hw_rev_uninit();
	if (err) {
		LOG_ERR("HW revision could not be uninit: %d", err);
	}
#endif
#if defined(CONFIG_SLM_UC)
	err = slm_at_uc_uninit();
	if (err) {
		LOG_ERR("User Config could not be uninit: %d", err);
	}
#endif
}
```

## src/watchdog.c
```c
/*
 * Copyright (c) 2025 Nordic Semiconductor ASA
 *
 * SPDX-License-Identifier: LicenseRef-Nordic-5-Clause
 */

#include <zephyr.h>
#include <device.h>
#include <drivers/watchdog.h>
#include <sys/reboot.h>
#include <task_wdt/task_wdt.h>
#include <logging/log.h>

#include "slm_util.h"
#include "watchdog.h"

LOG_MODULE_REGISTER(watchdog, CONFIG_SLM_LOG_LEVEL);

/* Create a delayed work that continuously feeds the watchdog on the system work queue.
 * The system work queue is also used for sending AT commands to the modem, so a watchdog
 * timeout will be triggered if the modem is unresponsive.
 */
static void feed_watchdog_work_fn(struct k_work *work);
static K_WORK_DELAYABLE_DEFINE(feed_watchdog_work, feed_watchdog_work_fn);
static int sys_workqueue_wd_channel_id;

static void sys_workqueue_watchdog_callback(int channel_id, void *user_data)
{
	ARG_UNUSED(channel_id);
	ARG_UNUSED(user_data);

	LOG_ERR("System workqueue watchdog triggered");

	slm_util_reboot(3);
}

static void feed_watchdog_work_fn(struct k_work *work)
{
	int err;

	ARG_UNUSED(work);

	LOG_DBG("Feeding watchdog");

	err = task_wdt_feed(sys_workqueue_wd_channel_id);
	if (err) {
		LOG_ERR("Cannot feed watchdog. Error: %d", err);
	}

	/* Feed the watchdog */
	k_work_reschedule(&feed_watchdog_work,
			  K_MSEC(WATCHDOG_SYSTEM_WORKQUEUE_FEED_INTERVAL_MSEC));
}

static int init_task_watchdog(const struct device *unused)
{
	int err;

	ARG_UNUSED(unused);

	const struct device *dev = device_get_binding(DT_LABEL(DT_NODELABEL(wdt)));
	if (!dev) {
		LOG_ERR("Cannot bind watchdog driver, hardware fallback not available");
	}

	err = task_wdt_init(dev);

	if (err) {
		LOG_ERR("Cannot start task watchdog! Error code: %d", err);
	} else {
		LOG_INF("Task watchdog initialized");
	}

	/* Initialize and start feeding the watchdog on the system workqueue */
	sys_workqueue_wd_channel_id =
		task_wdt_add(CONFIG_SLM_WATCHDOG_SYSTEM_WORKQUEUE_TIMEOUT_MSEC,
			     sys_workqueue_watchdog_callback, NULL);
	if (sys_workqueue_wd_channel_id < 0) {
		LOG_ERR("Failed to add system workqueue watchdog");
		return -ENXIO;
	}

	k_work_reschedule(&feed_watchdog_work, K_NO_WAIT);

	return 0;
}

SYS_INIT(init_task_watchdog, POST_KERNEL, CONFIG_APPLICATION_INIT_PRIORITY);
```

## src/watchdog.h
```c
/*
 * Copyright (c) 2025 Nordic Semiconductor ASA
 *
 * SPDX-License-Identifier: LicenseRef-Nordic-5-Clause
 */

#define WATCHDOG_SYSTEM_WORKQUEUE_FEED_INTERVAL_MSEC	\
	(CONFIG_SLM_WATCHDOG_SYSTEM_WORKQUEUE_TIMEOUT_MSEC / 2)
#define WATCHDOG_STATS_FEED_INTERVAL_MSEC	(CONFIG_SLM_STATS_WATCHDOG_TIMEOUT_MSEC / 2)
```
