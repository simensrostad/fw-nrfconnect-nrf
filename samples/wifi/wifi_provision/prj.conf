## Kconfig
```
#
# Copyright (c) 2024 Nordic Semiconductor ASA
#
# SPDX-License-Identifier: LicenseRef-Nordic-5-Clause
#

menu "Wi-Fi provision sample"

config WIFI_PROVISION_SAMPLE_PSM_DISABLED_SECONDS
	int "Wi-Fi power saving mode disabled seconds"
	default 120
	help
	  Time in seconds that Wi-Fi power saving mode is disabled after completed provisioning.
	  Disabling Power Saving mode is needed to make the device discoverable reliably via
	  mDNS post provisioning.
	  Service Discovery has proven to be unstable in power saving mode. (DTIM)

menu "Zephyr Kernel"
source "Kconfig.zephyr"
endmenu

module = WIFI_PROVISION_SAMPLE
module-str = Wi-Fi provision sample
source "${ZEPHYR_BASE}/subsys/logging/Kconfig.template.log_config"

endmenu
```

## prj.conf
```kconfig
#
# Copyright (c) 2024 Nordic Semiconductor ASA
#
# SPDX-License-Identifier: LicenseRef-Nordic-5-Clause
#

# Optimize TF-M
CONFIG_TFM_PROFILE_TYPE_SMALL=y
CONFIG_PM_PARTITION_SIZE_TFM_SRAM=0xa000
CONFIG_PM_PARTITION_SIZE_TFM=0x1c000

# Optimize Wi-Fi stack to save some memory.
CONFIG_HEAP_MEM_POOL_SIZE=81920
CONFIG_NRF700X_RX_NUM_BUFS=16
CONFIG_NRF700X_MAX_TX_AGGREGATION=4

# Wi-Fi
CONFIG_WIFI=y
CONFIG_WIFI_NRF700X=y
CONFIG_NRF700X_AP_MODE=y
CONFIG_WPA_SUPP=y
CONFIG_WPA_SUPP_AP=y
CONFIG_NET_L2_ETHERNET=y
CONFIG_WIFI_CREDENTIALS=y

# General
CONFIG_LOG=y
CONFIG_LOG_MODE_IMMEDIATE=y
CONFIG_ASSERT=y
CONFIG_ASSERT_VERBOSE=n

# Link-time optimizations
CONFIG_LTO=y
CONFIG_ISR_TABLES_LOCAL_DECLARATION=y

# Temporarily enable FS support so that linking succeeds.
CONFIG_FILE_SYSTEM=y
CONFIG_MAIN_STACK_SIZE=6144
CONFIG_NANOPB=y
CONFIG_SMF=y

# HTTP parser
CONFIG_HTTP_PARSER=y
CONFIG_HTTP_PARSER_URL=y

# DK Butons and LEDs
CONFIG_DK_LIBRARY=y

# Networking config
CONFIG_NETWORKING=y
CONFIG_NET_CONNECTION_MANAGER=y
CONFIG_NET_IPV4=y
# Disable IPv6 to save memory
CONFIG_NET_IPV6=n
CONFIG_NET_TCP=y
CONFIG_NET_UDP=y
CONFIG_NET_SOCKETS=y
CONFIG_NET_MAX_CONN=6
CONFIG_POSIX_MAX_FDS=20
CONFIG_NET_SOCKETS_TLS_MAX_CONTEXTS=2
CONFIG_NET_SOCKETS_SOCKOPT_TLS=y

# Zephyr NET Connection Manager connectivity layer
CONFIG_L2_WIFI_CONNECTIVITY=y
CONFIG_L2_WIFI_CONNECTIVITY_AUTO_CONNECT=n
CONFIG_L2_WIFI_CONNECTIVITY_AUTO_DOWN=n

# Wi-Fi Provisioning
CONFIG_WIFI_PROVISION=y
# Disable socket close on completed provisioning to keep mDNS SD running.
# SD depends on the socket being open for a specified port.
CONFIG_WIFI_PROVISION_SOCKET_CLOSE_ON_COMPLETION=n
CONFIG_WIFI_PROVISION_LOG_LEVEL_DBG=y

# (M)DNS
CONFIG_MDNS_RESPONDER=y
CONFIG_DNS_SD=y
CONFIG_MDNS_RESPONDER_DNS_SD=y
CONFIG_NET_HOSTNAME_ENABLE=y
CONFIG_NET_HOSTNAME="wifiprov"
# Disable POSIX uname support to suppress build warning that hostname is too long.
CONFIG_POSIX_UNAME=n

# DHCPv4 client and server
CONFIG_NET_DHCPV4=y
CONFIG_NET_DHCPV4_SERVER=y

# MBed TLS heap size, required by WPA supplicant and MBed TLS.
CONFIG_MBEDTLS_HEAP_SIZE=81920
CONFIG_MBEDTLS_RSA_C=y

# Store TLS credentials to protected storage.
CONFIG_TLS_CREDENTIALS=y
CONFIG_TLS_CREDENTIALS_BACKEND_PROTECTED_STORAGE=y

# Disable auto init of NET config as the Wi-Fi provisioning library will manually set its
# own IP configuration.
CONFIG_NET_CONFIG_AUTO_INIT=n
```

## boards/nrf7002dk_nrf5340_cpuapp_ns.conf
```kconfig
#
# Copyright (c) 2024 Nordic Semiconductor ASA
#
# SPDX-License-Identifier: LicenseRef-Nordic-5-Clause
#

# Optimize TF-M
CONFIG_TFM_PROFILE_TYPE_SMALL=y
CONFIG_PM_PARTITION_SIZE_TFM_SRAM=0xc000
CONFIG_PM_PARTITION_SIZE_TFM=0x20000

# Optimize Wi-Fi stack to save some memory
CONFIG_HEAP_MEM_POOL_SIZE=81920
CONFIG_NRF700X_RX_NUM_BUFS=16
CONFIG_NRF700X_MAX_TX_AGGREGATION=4

# Wi-Fi
CONFIG_WIFI=y
CONFIG_WIFI_NRF700X=y
CONFIG_WPA_SUPP=y
CONFIG_NET_L2_ETHERNET=y

# General
CONFIG_LOG=y
CONFIG_LOG_MODE_IMMEDIATE=y
CONFIG_ASSERT=y
CONFIG_NEWLIB_LIBC=y
CONFIG_MAIN_STACK_SIZE=8192

# DK Butons and LEDs
CONFIG_DK_LIBRARY=y

# Link time optimization
CONFIG_LTO=y
CONFIG_ISR_TABLES_LOCAL_DECLARATION=y

# Networking config
CONFIG_NETWORKING=y
CONFIG_NET_CONNECTION_MANAGER=y
CONFIG_NET_IPV4=y
CONFIG_NET_IPV6=y
CONFIG_NET_TCP=y
CONFIG_NET_UDP=y
CONFIG_NET_SOCKETS=y
CONFIG_NET_SOCKETS_POSIX_NAMES=y
CONFIG_NET_SOCKETS_TLS_MAX_CONTEXTS=2

# Zephyr NET Connection Manager connectivity layer
CONFIG_L2_WIFI_CONNECTIVITY=y
CONFIG_L2_WIFI_CONNECTIVITY_AUTO_CONNECT=n
CONFIG_L2_WIFI_CONNECTIVITY_AUTO_DOWN=n

# Wi-Fi Provisioning
CONFIG_WIFI_PROVISION=y
CONFIG_WIFI_PROVISION_LOG_LEVEL_DBG=y

# IP address configuration - Initial IP address used by DHCPv4 server
CONFIG_NET_CONFIG_INIT_TIMEOUT=0
CONFIG_NET_CONFIG_MY_IPV4_ADDR="192.0.2.1"

# (M)DNS
CONFIG_MDNS_RESPONDER=y
CONFIG_DNS_SD=y
CONFIG_MDNS_RESPONDER_DNS_SD=y
CONFIG_NET_HOSTNAME_ENABLE=y
CONFIG_NET_HOSTNAME_UNIQUE=n
CONFIG_NET_HOSTNAME="wifiprov"

# DHCPv4 client - used during assignment of dynamic IP post provisioning to Access Point
CONFIG_NET_DHCPV4=y

# MBed TLS heap size, required by WPA supplicant and MBed TLS
CONFIG_MBEDTLS_HEAP_SIZE=81920
CONFIG_MBEDTLS_RSA_C=y

# Store TLS credentials to protected storage
CONFIG_TLS_CREDENTIALS_BACKEND_PROTECTED_STORAGE=y

# # Extras
# CONFIG_THREAD_NAME=y
# CONFIG_LTO=n
# CONFIG_ISR_TABLES_LOCAL_DECLARATION=n
# # Shell and Wi-fi Credentials
# CONFIG_SHELL=y
# CONFIG_NET_SHELL=y
# CONFIG_SHELL_STACK_SIZE=6144
# CONFIG_NET_L2_WIFI_SHELL=y
# CONFIG_ASSERT=n
```

## src/main.c
```c
/*
 * Copyright (c) 2024 Nordic Semiconductor ASA
 *
 * SPDX-License-Identifier: LicenseRef-Nordic-5-Clause
 */

#include <stdio.h>
#include <errno.h>
#include <zephyr/kernel.h>
#include <zephyr/logging/log.h>
#include <zephyr/logging/log_ctrl.h>
#include <zephyr/sys/reboot.h>
#include <zephyr/net/wifi_mgmt.h>
#include <zephyr/net/net_mgmt.h>
#include <zephyr/net/net_event.h>
#include <zephyr/net/conn_mgr_monitor.h>
#include <zephyr/net/conn_mgr_connectivity.h>
#include <dk_buttons_and_leds.h>
#include <net/wifi_provision.h>
#include <net/wifi_credentials.h>
#include <zephyr/net/dhcpv4.h>

LOG_MODULE_REGISTER(wifi_provision_sample, CONFIG_WIFI_PROVISION_SAMPLE_LOG_LEVEL);

/* Macro used to subscribe to specific Zephyr NET management events. */
#define L4_EVENT_MASK (NET_EVENT_L4_CONNECTED | NET_EVENT_L4_DISCONNECTED)
#define CONN_LAYER_EVENT_MASK (NET_EVENT_CONN_IF_FATAL_ERROR)

/* Macro called upon a fatal error, reboots the device. */
#define FATAL_ERROR()								\
	LOG_ERR("Fatal error!%s", IS_ENABLED(CONFIG_RESET_ON_FATAL_ERROR) ?	\
				  " Rebooting the device" : "");		\
	LOG_PANIC();								\
	IF_ENABLED(CONFIG_REBOOT, (sys_reboot(0)))

/* Callbacks for Zephyr NET management events. */
static struct net_mgmt_event_callback l4_cb;
static struct net_mgmt_event_callback conn_cb;

/* Semaphore given when the user pushes button 1, used to start provisioning. */
static K_SEM_DEFINE(provision_start_sem, 0, 1);

static void l4_event_handler(struct net_mgmt_event_callback *cb,
			     uint32_t event,
			     struct net_if *iface)
{
	switch (event) {
	case NET_EVENT_L4_CONNECTED:
		LOG_INF("Network connected");

		int ret = dk_set_led_on(DK_LED2);

		if (ret) {
			LOG_ERR("dk_set_led_on, error: %d", ret);
			FATAL_ERROR();
		}

		/* Start DHCPv4 client after provisioned to a network. */
		net_dhcpv4_start(iface);
		break;
	case NET_EVENT_L4_DISCONNECTED:
		LOG_INF("Network disconnected");
		break;
	default:
		/* Don't care */
		return;
	}
}

static void connectivity_event_handler(struct net_mgmt_event_callback *cb,
				       uint32_t event,
				       struct net_if *iface)
{
	if (event == NET_EVENT_CONN_IF_FATAL_ERROR) {
		LOG_ERR("NET_EVENT_CONN_IF_FATAL_ERROR");
		FATAL_ERROR();
		return;
	}
}

/* Callback for Wi-Fi provisioning events. */
static void wifi_provision_handler(const struct wifi_provision_evt *evt)
{
	int ret;

	switch (evt->type) {
	case WIFI_PROVISION_EVT_STARTED:
		LOG_INF("Provisioning started");

		ret = dk_set_led_on(DK_LED1);
		if (ret) {
			LOG_ERR("dk_set_led_on, error: %d", ret);
			FATAL_ERROR();
		}

		break;
	case WIFI_PROVISION_EVT_CLIENT_CONNECTED:
		LOG_INF("Client connected");
		break;
	case WIFI_PROVISION_EVT_CLIENT_DISCONNECTED:
		LOG_INF("Client disconnected");
		break;
	case WIFI_PROVISION_EVT_CLIENT_ACCESS_DENIED:
		LOG_INF("Client access denied, press button 1 to grant access.");
		break;
	case WIFI_PROVISION_EVT_CREDENTIALS_RECEIVED:
		LOG_INF("Wi-Fi credentials received");
		break;
	case WIFI_PROVISION_EVT_COMPLETED:
		LOG_INF("Provisioning completed");
		break;
	case WIFI_PROVISION_EVT_RESET_REBOOT_REQUEST:
		LOG_INF("Reboot request received, rebooting...");

		LOG_PANIC();
		IF_ENABLED(CONFIG_REBOOT, (sys_reboot(0)));
		break;
	case WIFI_PROVISION_EVT_FATAL_ERROR:
		LOG_ERR("Provisioning failed");
		FATAL_ERROR();
		break;
	default:
		/* Don't care */
		return;
	}
}

static void button_handler(uint32_t button_states, uint32_t has_changed)
{
	int ret;

	if ((has_changed & DK_BTN1_MSK) && (button_states & DK_BTN1_MSK)) {
		LOG_INF("Button 1 pressed");

		static uint32_t counter;

		if (counter % 2 == 0) {
			ret = wifi_provision_client_access_grant();
			if (ret) {
				LOG_ERR("wifi_provision_client_access_grant, error: %d", ret);
				FATAL_ERROR();
				return;
			}
		} else {
			ret = wifi_provision_client_access_deny();
			if (ret) {
				LOG_ERR("wifi_provision_client_access_deny, error: %d", ret);
				FATAL_ERROR();
				return;
			}
		}

		counter++;
	}

	if ((has_changed & DK_BTN2_MSK) && (button_states & DK_BTN2_MSK)) {
		LOG_INF("Button 2 pressed, resetting provisioning library");

		int ret = wifi_provision_reset();

		if (ret) {
			LOG_ERR("wifi_provision_reset, error: %d", ret);
			FATAL_ERROR();
			return;
		}
	}
}

static int wifi_power_saving_disable(void)
{
	int ret;
	struct net_if *iface = net_if_get_first_wifi();
		struct wifi_ps_params params = {
		.enabled = WIFI_PS_DISABLED
	};

	ret = net_mgmt(NET_REQUEST_WIFI_PS, iface, &params, sizeof(params));
	if (ret) {
		LOG_ERR("Failed to disable PSM, error: %d", ret);
		FATAL_ERROR();
		return ret;
	}

	return 0;
}

static int wifi_power_saving_enable(void)
{
	int ret;
	struct net_if *iface = net_if_get_first_wifi();
	struct wifi_ps_params params = {
		.enabled = WIFI_PS_ENABLED
	};

	ret = net_mgmt(NET_REQUEST_WIFI_PS, iface, &params, sizeof(params));
	if (ret) {
		LOG_ERR("Failed to enable PSM, error: %d", ret);
		FATAL_ERROR();
		return ret;
	}

	return 0;
}

/* Function used to disable and re-enable PSM after a configured amount of time post provisioning.
 * This is to ensure that the device is discoverable via mDNS so that clients can
 * confirm that provisioning succeeded. This is needed due to m(DNS) SD being unstable
 * in power saving mode.
 */
void psm_set(void)
{
	int ret;

	ret = wifi_power_saving_disable();
	if (ret) {
		LOG_ERR("wifi_power_saving_disable, error: %d", ret);
		FATAL_ERROR();
		return;
	}

	LOG_INF("PSM disabled");

	k_sleep(K_SECONDS(CONFIG_WIFI_PROVISION_SAMPLE_PSM_DISABLED_SECONDS));

	ret = wifi_power_saving_enable();
	if (ret) {
		LOG_ERR("wifi_power_saving_enable, error: %d", ret);
		FATAL_ERROR();
		return;
	}

	LOG_INF("PSM enabled");
}

int main(void)
{
	int ret;
	bool provisioning_completed = false;

	LOG_INF("Wi-Fi provision sample started");

	ret = dk_buttons_init(button_handler);
	if (ret) {
		LOG_ERR("dk_buttons_init, error: %d", ret);
		FATAL_ERROR();
		return ret;
	}

	ret = dk_leds_init();
	if (ret) {
		LOG_ERR("dk_leds_init, error: %d", ret);
		FATAL_ERROR();
		return ret;
	}

	ret = wifi_provision_init(wifi_provision_handler);
	if (ret) {
		LOG_ERR("wifi_provision_init, error: %d", ret);
		FATAL_ERROR();
		return ret;
	}

	ret = conn_mgr_all_if_up(true);
	if (ret) {
		LOG_ERR("conn_mgr_all_if_up, error: %d", ret);
		FATAL_ERROR();
		return ret;
	}

	LOG_INF("Network interface brought up");

	ret = wifi_provision_start();
	switch (ret) {
	case 0:
		provisioning_completed = true;
		break;
	case -EALREADY:
		LOG_INF("Wi-Fi credentials found, skipping provisioning");
		break;
	default:
		LOG_ERR("wifi_provision_start, error: %d", ret);
		FATAL_ERROR();
		return ret;
	}

	/* Register NET mgmt handlers for Connection Manager events after provisioning
	 * has completed. This is to avoid receiving events during provisioning when the device is
	 * in softAP (server) mode and gets assigned an IP,
	 * which triggers the NET_EVENT_L4_CONNECTED.
	 */

	/* Setup handler for Zephyr NET Connection Manager events. */
	net_mgmt_init_event_callback(&l4_cb, l4_event_handler, L4_EVENT_MASK);
	net_mgmt_add_event_callback(&l4_cb);

	/* Setup handler for Zephyr NET Connection Manager Connectivity layer. */
	net_mgmt_init_event_callback(&conn_cb, connectivity_event_handler, CONN_LAYER_EVENT_MASK);
	net_mgmt_add_event_callback(&conn_cb);

	ret = conn_mgr_all_if_connect(true);
	if (ret) {
		LOG_ERR("conn_mgr_all_if_connect, error: %d", ret);
		FATAL_ERROR();
		return ret;
	}

	if (provisioning_completed) {
		psm_set();
	}

	return 0;
}
```
