## CMakeLists.txt
```
#
# Copyright (c) 2023 Nordic Semiconductor ASA
#
# SPDX-License-Identifier: LicenseRef-Nordic-5-Clause
#

cmake_minimum_required(VERSION 3.20.0)

find_package(Zephyr REQUIRED HINTS $ENV{ZEPHYR_BASE})
project(mqtt)

# Include files that are common for all modules
add_subdirectory(src/common)

# Include mandatory module source folders
add_subdirectory(src/modules/trigger)
add_subdirectory(src/modules/sampler)
add_subdirectory(src/modules/network)
add_subdirectory(src/modules/transport)
add_subdirectory(src/modules/error)

# Optional modules
add_subdirectory_ifdef(CONFIG_MQTT_SAMPLE_LED src/modules/led)
add_subdirectory_ifdef(CONFIG_MQTT_SAMPLE_ENCODER src/modules/encoder)

if (CONFIG_MQTT_SAMPLE_ENCODER)
# Note that here, we're adding CMAKE_SOURCE_DIR to the include path for nanopb.
# This is needed because the below call to nanopb_generate_cpp() is using
# 'RELPATH .'
set(NANOPB_OPTIONS "-I${CMAKE_SOURCE_DIR}")
nanopb_generate_cpp(proto_sources proto_headers RELPATH . src/modules/encoder/protobuf/simple.proto
)

# We need to be able to include generated header files
zephyr_library_include_directories(${CMAKE_CURRENT_BINARY_DIR})

target_sources(app PRIVATE ${proto_sources})

endif()
```

## Kconfig
```
#
# Copyright (c) 2023 Nordic Semiconductor ASA
#
# SPDX-License-Identifier: LicenseRef-Nordic-5-Clause
#

menu "MQTT sample"

config MQTT_SAMPLE_PAYLOAD_CHANNEL_BUFFER_MAX_SIZE
	int "Payload maximum string size"
	default 100
	help
	  Maximum size of the string included messages that are sent over the payload channel.

rsource "src/modules/trigger/Kconfig.trigger"
rsource "src/modules/sampler/Kconfig.sampler"
rsource "src/modules/network/Kconfig.network"
rsource "src/modules/transport/Kconfig.transport"
rsource "src/modules/error/Kconfig.error"
rsource "src/modules/led/Kconfig.led"
rsource "src/modules/encoder/Kconfig.encoder"

endmenu

menu "Zephyr Kernel"
source "Kconfig.zephyr"
endmenu
```

## sample.yaml
```
sample:
  name: mqtt
tests:
  sample.net.mqtt:
    build_only: true
    integration_platforms:
      - nrf9160dk_nrf9160_ns
      - nrf7002dk_nrf5340_cpuapp
    platform_allow: nrf9160dk_nrf9160_ns nrf7002dk_nrf5340_cpuapp
    tags: ci_build
```

## prj.conf
```kconfig
#
# Copyright (c) 2023 Nordic Semiconductor ASA
#
# SPDX-License-Identifier: LicenseRef-Nordic-5-Clause
#

# Common configurations for all boards

# General
CONFIG_HW_ID_LIBRARY=y
CONFIG_ASSERT=y
CONFIG_HEAP_MEM_POOL_SIZE=4096

# Logging
CONFIG_LOG=y

# Networking
CONFIG_NETWORKING=y
CONFIG_NET_SOCKETS_OFFLOAD=y
CONFIG_NET_SOCKETS=y
CONFIG_NET_SOCKETS_POSIX_NAMES=y
CONFIG_NET_IPV4=y
CONFIG_NET_TCP=y
CONFIG_NET_NATIVE=y

# ZBus
CONFIG_ZBUS=y

# Zephyr state framework
CONFIG_SMF=y

CONFIG_FPU=y
CONFIG_CBPRINTF_FP_SUPPORT=y

CONFIG_COAP_CLIENT=y
CONFIG_COAP_CLIENT_BLOCK_SIZE=1024
CONFIG_COAP_CLIENT_STACK_SIZE=6144
CONFIG_COAP_CLIENT_THREAD_PRIORITY=0
CONFIG_COAP_EXTENDED_OPTIONS_LEN=y
CONFIG_COAP_EXTENDED_OPTIONS_LEN_VALUE=22

CONFIG_NRF_CLOUD_COAP=y
CONFIG_NRF_CLOUD_COAP_LOG_LEVEL_DBG=y
CONFIG_MODEM_JWT=y

CONFIG_MAIN_STACK_SIZE=8192
CONFIG_RESET_ON_FATAL_ERROR=n
CONFIG_MODEM_INFO=y
CONFIG_MODEM_INFO_ADD_SIM=y

# Location related configuration
CONFIG_LOCATION=y
CONFIG_LOCATION_LOG_LEVEL_DBG=y
CONFIG_LOCATION_SERVICE_EXTERNAL=y
CONFIG_LOCATION_METHOD_GNSS=n

# Stuff
CONFIG_THREAD_NAME=y
CONFIG_LOG_MODE_IMMEDIATE=y
CONFIG_NRF_MODEM_LIB_TRACE=y
CONFIG_AT_HOST_LIBRARY=y
```

## overlay-tls-native_sim.conf
```kconfig
#
# Copyright (c) 2023 Nordic Semiconductor ASA
#
# SPDX-License-Identifier: LicenseRef-Nordic-5-Clause
#

# Overlay file that enables TLS for native simulator builds

# TLS
CONFIG_MQTT_LIB_TLS=y
CONFIG_MQTT_HELPER_PORT=8883
CONFIG_MQTT_KEEPALIVE=30

# Credentials located under <sample-dir>/src/modules/transport/credentials/ will be automatically
# provisioned prior to connecting to the server by the MQTT helper library.
CONFIG_MQTT_HELPER_SEC_TAG=955
CONFIG_MQTT_HELPER_PROVISION_CERTIFICATES=y
CONFIG_MQTT_HELPER_CERTIFICATES_FOLDER="src/modules/transport/credentials"

# Native network stack
CONFIG_MBEDTLS=y
CONFIG_MBEDTLS_BUILTIN=y
CONFIG_MBEDTLS_ENABLE_HEAP=y
CONFIG_MBEDTLS_HEAP_SIZE=120000
CONFIG_MBEDTLS_SSL_MAX_CONTENT_LEN=16384
CONFIG_MBEDTLS_PEM_CERTIFICATE_FORMAT=y
CONFIG_MBEDTLS_KEY_EXCHANGE_RSA_ENABLED=y
CONFIG_MBEDTLS_MAC_SHA256_ENABLED=y
CONFIG_MBEDTLS_PSA_CRYPTO_C=y

# NET Sockets
CONFIG_NET_SOCKETS_SOCKOPT_TLS=y
```

## boards/native_posix.conf
```kconfig
#
# Copyright (c) 2023 Nordic Semiconductor ASA
#
# SPDX-License-Identifier: LicenseRef-Nordic-5-Clause
#

# Networking
CONFIG_NET_SOCKETS_OFFLOAD=n

CONFIG_DNS_RESOLVER=y
CONFIG_DNS_SERVER_IP_ADDRESSES=y
CONFIG_DNS_SERVER1="8.8.8.8"

# Network address config
CONFIG_NET_CONFIG_SETTINGS=y
CONFIG_NET_CONFIG_NEED_IPV4=y
CONFIG_NET_CONFIG_MY_IPV4_ADDR="192.0.2.1"
CONFIG_NET_CONFIG_PEER_IPV4_ADDR="192.0.2.2"
CONFIG_NET_CONFIG_MY_IPV4_GW="192.0.2.2"
CONFIG_NET_CONTEXT_SNDTIMEO=y

# Memory
CONFIG_HEAP_MEM_POOL_SIZE=16384
CONFIG_MAIN_STACK_SIZE=16384
```

## boards/nrf7002dk_nrf5340_cpuapp.conf
```kconfig
#
# Copyright (c) 2023 Nordic Semiconductor ASA
#
# SPDX-License-Identifier: LicenseRef-Nordic-5-Clause
#

# Configuration file for nRF7002 DK
# This file is merged with prj.conf in the application folder, and options
# set here will take precedence if they are present in both files.

# General
CONFIG_POSIX_CLOCK=y
CONFIG_POSIX_MAX_FDS=8
CONFIG_SYSTEM_WORKQUEUE_STACK_SIZE=4096
CONFIG_LOG_BUFFER_SIZE=3072
CONFIG_HEAP_MEM_POOL_SIZE=153600
CONFIG_HW_STACK_PROTECTION=y
CONFIG_HW_ID_LIBRARY_SOURCE_NET_MAC=y
CONFIG_DK_LIBRARY=y

# Set newlib C to prevent build error complaining that string.h is not supported
CONFIG_NEWLIB_LIBC=y
CONFIG_NEWLIB_LIBC_FLOAT_PRINTF=y

# Wi-Fi
CONFIG_WIFI=y
CONFIG_WIFI_NRF700X=y
CONFIG_WIFI_LOG_LEVEL_ERR=y
CONFIG_WIFI_MGMT_EXT=y
CONFIG_WIFI_CREDENTIALS=y
CONFIG_WIFI_CREDENTIALS_BACKEND_SETTINGS=y
CONFIG_WIFI_CREDENTIALS_STATIC=y
CONFIG_FLASH=y
CONFIG_FLASH_PAGE_LAYOUT=y
CONFIG_FLASH_MAP=y
CONFIG_NVS=y
CONFIG_SETTINGS=y
CONFIG_SETTINGS_NVS=y

# WPA
CONFIG_WPA_SUPP=y
CONFIG_WPA_SUPP_LOG_LEVEL_ERR=y

# NET sockets
CONFIG_NET_L2_ETHERNET=y
CONFIG_NET_TCP_WORKQ_STACK_SIZE=2048
CONFIG_NET_UDP=y
CONFIG_NET_SOCKETS_OFFLOAD=n
CONFIG_NET_DHCPV4=y
CONFIG_NET_CONTEXT_SNDTIMEO=y
CONFIG_NET_MGMT_EVENT_STACK_SIZE=4096

# DNS
CONFIG_DNS_RESOLVER=y
```

## boards/nrf9160dk_nrf9160_ns.conf
```kconfig
#
# Copyright (c) 2023 Nordic Semiconductor ASA
#
# SPDX-License-Identifier: LicenseRef-Nordic-5-Clause
#

# Configuration file for nRF9160 DK
# This file is merged with prj.conf in the application folder, and options
# set here will take precedence if they are present in both files.

# General
CONFIG_NRF_MODEM_LIB_SYS_INIT=n
CONFIG_NRF_MODEM_LIB_ON_FAULT_APPLICATION_SPECIFIC=y
CONFIG_HW_STACK_PROTECTION=y
CONFIG_HW_ID_LIBRARY_SOURCE_IMEI=y
CONFIG_PICOLIBC=y
CONFIG_DK_LIBRARY=y
CONFIG_NET_CONNECTION_MANAGER=y
CONFIG_NET_CONNECTION_MANAGER_STACK_SIZE=1024

# Some text here
CONFIG_NRF91_CONNECTIVITY=y
```

## boards/thingy91_nrf9160_ns.conf
```kconfig
#
# Copyright (c) 2023 Nordic Semiconductor ASA
#
# SPDX-License-Identifier: LicenseRef-Nordic-5-Clause
#

# Configuration file for Thingy:91
# This file is merged with prj.conf in the application folder, and options
# set here will take precedence if they are present in both files.

# General
CONFIG_NRF_MODEM_LIB_SYS_INIT=n
CONFIG_NRF_MODEM_LIB_ON_FAULT_APPLICATION_SPECIFIC=y
CONFIG_HW_STACK_PROTECTION=y
CONFIG_HW_ID_LIBRARY_SOURCE_IMEI=y
CONFIG_PICOLIBC=y
CONFIG_DK_LIBRARY=y
CONFIG_NET_CONNECTION_MANAGER=y
CONFIG_NET_CONNECTION_MANAGER_STACK_SIZE=1024

# Some text here
CONFIG_NRF91_CONNECTIVITY=y
```

## src/main.c
```c
/*
 * Copyright (c) 2022 Nordic Semiconductor ASA
 *
 * SPDX-License-Identifier: LicenseRef-Nordic-5-Clause
 */

#include <zephyr/kernel.h>
#include <zephyr/logging/log.h>

LOG_MODULE_REGISTER(mqtt, CONFIG_MQTT_SAMPLE_LOG_LEVEL);

void main(void)
{
	/* Start system */
	return;
}
```
