## CMakeLists.txt
```
# SPDX-License-Identifier: Apache-2.0

cmake_minimum_required(VERSION 3.8.2)

find_package(Zephyr REQUIRED HINTS $ENV{ZEPHYR_BASE})

project(customer)

zephyr_include_directories(src)

target_sources(
    app PRIVATE
    src/main.c
    src/watch.c
    src/UART.c
    src/modem.c
    src/https.c
    src/cloud.c
    src/aws.c
    src/scheduler.c)
```

## prj.conf
```kconfig
#CONFIG_TRUSTED_EXECUTION_NONSECURE=y
#
# Copyright (c) 2020 Circle Consult ApS. All rights reserved.
#

# Logging interface
CONFIG_LOG=y
CONFIG_NET_LOG=y
CONFIG_MQTT_LOG_LEVEL_DBG=y

# Stacks and heaps
CONFIG_HEAP_MEM_POOL_SIZE=16384
CONFIG_MAIN_STACK_SIZE=16384
CONFIG_SYSTEM_WORKQUEUE_STACK_SIZE=4096

# UART interface
CONFIG_SERIAL=y
CONFIG_UART_INTERRUPT_DRIVEN=y

# cJSON interface
CONFIG_CJSON_LIB=y

# AT host interface
CONFIG_AT_HOST_LIBRARY=y

# Date time interface
CONFIG_DATE_TIME=y

# Use GPIO
CONFIG_GPIO=y
CONFIG_GPIO_NRFX=y
CONFIG_NRFX_GPIOTE=y

# MQTT interface
CONFIG_MQTT_LIB=y
CONFIG_MQTT_LIB_TLS=y
CONFIG_MQTT_CLEAN_SESSION=y

# Network interface
CONFIG_NETWORKING=y
CONFIG_NET_SOCKETS=y
CONFIG_NET_NATIVE=n

# Library for the LTE network
CONFIG_LTE_LINK_CONTROL=y
CONFIG_LTE_AUTO_INIT_AND_CONNECT=n
CONFIG_LTE_NETWORK_MODE_LTE_M=y
CONFIG_MODEM_KEY_MGMT=y
CONFIG_NRF_MODEM_LIB=y

#Enable reboot from software
CONFIG_REBOOT=y

# newlibc
CONFIG_NEWLIB_LIBC=y
CONFIG_NEWLIB_LIBC_FLOAT_PRINTF=y

# Use PWM
CONFIG_PWM=y
CONFIG_PWM_NRFX=y

# use ADC
CONFIG_ADC=y
CONFIG_ADC_NRFX_SAADC=y

# USE I2C
CONFIG_I2C=y
CONFIG_I2C_NRFX=y

# WatchDog interface
CONFIG_WATCHDOG=y
CONFIG_WDT_DISABLE_AT_BOOT=n

# Pin control
CONFIG_PINCTRL=y
CONFIG_NRF_MODEM_LIB_TRACE_ENABLED=y
```

## src/main.c
```c
/**
 * Circle Consult ApS
 *
 * Rundforbivej 271A, DK-2850 Naerum
 * Inge Lehmanns Gade 10, DK-8000 Aarhus C
 * Alsion 2, DK-6400 Soenderborg
 *
 * Denmark
 *
 * Phone: +45 45 56 10 56
 * Fax: +45 45 56 11 56
 * Website: http://www.circleconsult.dk
 *
 *  Circle Consult ApS has Intellectual Property Rights.
 *
 *  All rights reserved.
 *
 *  Redistribution and use in source and binary forms, with or without
 *  modification, are not permitted.
 *
 *  Circle Consult's name may not be used to endorse or promote products derived
 *  from this software without specific prior written permission.
 *
 *
 * DISCLAIMER: THIS SOFTWARE IS PROVIDED BY CIRCLE CONSULT APS "AS IS" AND ANY
 * EXPRESS OR IMPLIED WARRANTIES, INCLUDING, BUT NOT LIMITED TO, THE IMPLIED
 * WARRANTIES OF MERCHANTABILITY, FITNESS FOR A PARTICULAR PURPOSE AND NON-
 * INFRINGEMENT ARE DISCLAIMED. IN NO EVENT SHALL CIRCLE CONSULT APS BE LIABLE
 * FOR ANY DIRECT, INDIRECT, INCIDENTAL, SPECIAL, EXEMPLARY, OR CONSEQUENTIAL
 * DAMAGES (INCLUDING, BUT NOT LIMITED TO, PROCUREMENT OF SUBSTITUTE GOODS OR
 * SERVICES; LOSS OF USE, DATA, OR PROFITS; OR BUSINESS INTERRUPTION) HOWEVER
 * CAUSED AND ON ANY THEORY OF LIABILITY, WHETHER IN CONTRACT, STRICT LIABILITY,
 * OR TORT (INCLUDING NEGLIGENCE OR OTHERWISE) ARISING IN ANY WAY OUT OF THE USE
 * OF THIS SOFTWARE, EVEN IF ADVISED OF THE POSSIBILITY OF SUCH DAMAGE.
 */

/**
 * @file        main.c
 *
 * @details     The main module.
 *
 * @copyright   Copyright (c) 2021 Circle Consult ApS. All rights reserved.
 *
 * @date        16/09/2020
 * @author      Anton Vigen Smolarz, Circle Consult ApS
 */

#include <zephyr.h>
#include <sys/printk.h>
#include <kernel.h>
#include <stdio.h>

#include "cli.h"
#include "software_settings.h"
#include "modem.h"
#include "scheduler.h"
#include "https.h"
#include "cloud.h"
#include "aws.h"
#include "watch.h"
#include "time.h"

/* Still a work in progress. Restructured. */

//! Set up the number of outlets.
outlet_t number_of_outlets = OUTLET_ONE;

/**
 * @brief Setting up the initializing functions.
 */
void configure_system_on_start_up(void) {

    // Initialize client.
    INIT_CLI();

    // Set the modem client id.
    modem_set_client_id();

    // Initialize modem module.
    modem_init();

    // Initialize the cloud.
    cloud_init(modem_get_client_id());

    // Initialize the watch.
    watch_init();

    // Set time offset.
    watch_set_offset(1);

    // Initialize the scheduler.
    scheduler_init();

    // Connect the modem to LTE network.
    modem_connect();

    // Connect to AWS.
    aws_connect();

    // Synchronize the watch.
    watch_update();
    k_sleep(K_MSEC(500));
}

/**
 * @brief The application main entry.
 */
void main(void) {

    // Initialize system.
    configure_system_on_start_up();

    k_sleep(K_FOREVER);

    // // Enter main loop.
    // while(1) {


    // }
}
```

## src/UART.c
```c
/**
 * @file        UART.c
 *
 * @details     A module handling the uart.
 *
 * @copyright   Copyright (c) 2021 Circle Consult ApS. All rights reserved.
 *
 * @date        16/09/2020.
 * @author      Anton Vigen Smolarz, Circle Consult ApS.
 */

#include "UART.h"
#include "software_settings.h"

// cppcheck-suppress    unusedFunction
void init_uart(uart_irq_callback_user_data_t a_uart_handler) {

    // Get device binding
    const struct device* uart = device_get_binding(CC_UART_LABEL);

    // Did the device not setup?
    if(NULL == uart) {

        // Inform user.
        printk("Could not set up uart_0\n");
    }

    // Link interrupt requests from the uart to the interrupt handler.
    uart_irq_callback_set(uart, a_uart_handler);

    // Enable RX interrupt requests.
    uart_irq_rx_enable(uart);
}
```

## src/UART.h
```c
/**
 * @file        UART.h
 *
 * @details     A module handling the uart.
 *
 * @copyright   Copyright (c) 2021 Circle Consult ApS. All rights reserved.
 *
 * @date        16/09/2020.
 * @author      Anton Vigen Smolarz, Circle Consult ApS.
 */

#ifndef UART_H
#define UART_H
#include <drivers/uart.h>

/**
 * @brief   Initializes uart.
 *
 * @param   a_uart_handler  The function that should handle the uart.
 */
void init_uart(uart_irq_callback_user_data_t a_uart_handler);

#endif /* UART_H */
```

## src/aws.c
```c
/**
 * @file        aws.c
 *
 * @details     A module handling the AWS & MQTT communication.
 *
 * @copyright   Copyright (c) 2021 Circle Consult ApS. All rights reserved.
 *
 * @date        12-11-2021
 * @author      Christian Friedrichsen, Circle Consult ApS
 */

#include <stdio.h>

#include <zephyr.h>
#include <logging/log.h>
#include <net/mqtt.h>
#include <net/socket.h>
#include <random/rand32.h>

#include "software_settings.h"
#include "aws.h"
#include "watch.h"

//! Register the AWS module to the logging system.
LOG_MODULE_REGISTER(AWS, CC_LOG_LEVEL);

//! The MQTT broker address details structure.
static struct sockaddr_storage mqtt_broker;

//! The MQTT polling file descriptor structure.
static struct pollfd mqtt_pollfd;

//! The MQTT client structure.
static struct mqtt_client client;

//! The MQTT publish mutex structure.
static struct k_mutex aws_publish_mutex;

//! The MQTT publish worker structure.
static struct k_work aws_publish_work;

//! The AWS callback function.
static aws_event_callback_t aws_callback = NULL;

//! The MQTT status when data is published on AWS.
static aws_mqtt_status_t aws_mqtt_status;

//! The MQTT client RX buffer.
static uint8_t mqtt_rx_buffer[CC_AWS_MQTT_MESSAGE_BUFFER_SIZE];

//! The MQTT client TX buffer.
static uint8_t mqtt_tx_buffer[CC_AWS_MQTT_MESSAGE_BUFFER_SIZE];

//! The MQTT payload buffer.
static uint8_t mqtt_payload_buffer[CC_AWS_MQTT_PAYLOAD_BUFFER_SIZE];

//! The MQTT broker connection requested flag.
static atomic_t is_connect_requested;

//! The AWS publish information.
static aws_publish_info_t aws_publish_info;

/**
 * @brief   Publish data to the AWS (Work).
 *
 * @param   work     The k_work structure.
 */
static void aws_publish_work_handler(struct k_work* work) {

    ARG_UNUSED(work);

    // Lock the AWS publish mutex and has it succeeded?
    if(0 != k_mutex_lock(&aws_publish_mutex, K_MSEC(CC_WORK_MUTEX_LOCK_TIMEOUT_MS))) {

        LOG_ERR("AWS publish mutex cannot be locked.");

        return;
    }

    // The parameters for the published message.
    struct mqtt_publish_param mqtt_param;
    memset(&mqtt_param, 0, sizeof(mqtt_param));

    // Fill out the parameters.
    mqtt_param.message.topic.qos = MQTT_QOS_1_AT_LEAST_ONCE;
    mqtt_param.message.topic.topic.utf8 = aws_publish_info.topic;
    mqtt_param.message.topic.topic.size = strlen(aws_publish_info.topic);
    mqtt_param.message.payload.data = aws_publish_info.data;
    mqtt_param.message.payload.len = strlen(aws_publish_info.data);
    mqtt_param.message_id = sys_rand32_get();
    mqtt_param.dup_flag = 0;
    mqtt_param.retain_flag = 0;

    LOG_INF("MQTT published to topic: %s, length: %u.", log_strdup(aws_publish_info.topic), strlen(aws_publish_info.data));

    // Publish the message to the topic.
    int16_t error = mqtt_publish(&client, &mqtt_param);

    if(0 > error) {

        LOG_ERR("Publish data failed: %d.", error);
    }

    // Unlock the AWS publish mutex.
    (void)k_mutex_unlock(&aws_publish_mutex);
}

/**
 * @brief   Get the published MQTT payload.
 *
 * @param   _c          The MQTT client.
 * @param   _length     The length of the payload.
 *
 * @retval  0           Success.
 * @retval  Negative    Error.
 */
static int16_t aws_mqtt_publish_get_payload(struct mqtt_client* const _c, const size_t _length) {

    // Is the published payload too long?
    if(sizeof(mqtt_payload_buffer) < _length) {

        return -EMSGSIZE;
    }

    // Read all the published payload.
    return mqtt_readall_publish_payload(_c, mqtt_payload_buffer, _length);
}

/**
 * @brief   Handle the MQTT client events (Callback).
 *
 * @param   c       The MQTT client.
 * @param   evt     The MQTT event data.
 */
static void aws_mqtt_event_handler(struct mqtt_client* const c, const struct mqtt_evt* evt) {

    int16_t error;

    // Reset the AWS event.
    uint8_t event = AWS_EVENT_NONE;

    // Go through the event type.
    switch(evt->type) {

        // Acknowledgement of connection request.
        case MQTT_EVT_CONNACK:

            // Has an error occurred?
            if(0 != evt->result) {

                LOG_ERR("MQTT connection failed: %d.", evt->result);

                break;
            }

            LOG_INF("MQTT client is connected.");

            // Subscribe the status topic to AWS.
            error = aws_subscribe(aws_mqtt_status.topic);

            // Has an error occurred?
            if(0 > error) {

                LOG_ERR("Subscribe Status failed: %d.", error);
            }

            // Or has it succeeded?
            else {

                LOG_INF("Subscribe Status succeeded.");
            }

            break;

        // Disconnection event.
        case MQTT_EVT_DISCONNECT:

            LOG_INF("MQTT client is disconnected.");

            atomic_set(&is_connect_requested, 0);

            break;

        // Publish event received when message is published on a topic client is subscribed to.
        case MQTT_EVT_PUBLISH: {

            // Read the parameters for the publish message.
            const struct mqtt_publish_param* p = &evt->param.publish;

            LOG_INF("MQTT PUBLISH result = %d, length = %d.", evt->result, p->message.payload.len);

            // Is QoS set to MQTT_QOS_1_AT_LEAST_ONCE?
            if(MQTT_QOS_1_AT_LEAST_ONCE == p->message.topic.qos) {

                // Prepare the QoS1 ack message.
                const struct mqtt_puback_param ack = {

                    .message_id = p->message_id
                };

                // Send the ack message.
                error = mqtt_publish_qos1_ack(&client, &ack);

                // Has an error occurred?
                if(0 != error) {

                    LOG_ERR("MQTT publish QoS1 ack failed: %d.", error);
                }
            }

            // Is QoS set to MQTT_QOS_2_EXACTLY_ONCE?
            else if(MQTT_QOS_2_EXACTLY_ONCE == p->message.topic.qos) {

                // Prepare the QoS2 receive message.
                const struct mqtt_pubrec_param receive = {

                    .message_id = p->message_id
                };

                // Send the receive message.
                error = mqtt_publish_qos2_receive(&client, &receive);

                // Has an error occurred?
                if(0 != error) {

                    LOG_ERR("MQTT publish QoS2 receive failed: %d.", error);
                }
            }

            // Read the published MQTT payload.
            error = aws_mqtt_publish_get_payload(c, p->message.payload.len);

            // Has an error occurred?
            if(0 != error) {

                LOG_ERR("MQTT PUBLISH payload failed: %d.", error);

                break;
            }

            // Has the payload been read successfully?
            LOG_INF("MQTT PUBLISH topic: %s.", log_strdup(p->message.topic.topic.utf8));

            // Has an AWS status topic occurred?
            if(0 == strcmp(p->message.topic.topic.utf8, aws_mqtt_status.topic)) {

                // Set the AWS response ready event.
                event = AWS_EVENT_RESPONSE_READY;
            }

            // Or is the response unknown?
            else {

                LOG_INF("MQTT PUBLISH response is unknown.");
            }

            break;
        }

        // Acknowledgement for published message with QoS 1.
        case MQTT_EVT_PUBACK:

            // Has an error occurred?
            if(0 != evt->result) {

                LOG_ERR("MQTT PUBACK received error: %d.", evt->result);

                break;
            }

            LOG_INF("MQTT PUBACK received with id: %u.", evt->param.puback.message_id);

            break;

        // Reception confirmation for published message with QoS 2.
        case MQTT_EVT_PUBREC: {

            // Has an error occurred?
            if(0 != evt->result) {

                LOG_ERR("MQTT QoS2 PUBREC received error: %d.", evt->result);

                break;
            }

            // Read the parameters for the pubrec message.
            const struct mqtt_pubrec_param* p = &evt->param.pubrec;

            // Prepare the release message.
            const struct mqtt_pubrel_param release = {

                .message_id = p->message_id
            };

            // Send the release message.
            error = mqtt_publish_qos2_release(&client, &release);

            // Has an error occurred?
            if(0 != error) {

                LOG_ERR("MQTT publish QoS2 release failed: %d.", error);

                break;
            }

            LOG_INF("MQTT PUBREC received with id: %u.", p->message_id);

            break;
        }

        // Release of published message with QoS 2.
        case MQTT_EVT_PUBREL: {

            // Has an error occurred?
            if(0 != evt->result) {

                LOG_ERR("MQTT QoS2 PUBREL received error: %d.", evt->result);

                break;
            }

            // Read the parameters for the pubrel message.
            const struct mqtt_pubrel_param* p = &evt->param.pubrel;

            // Prepare the complete message.
            const struct mqtt_pubcomp_param complete = {

                .message_id = p->message_id
            };

            // Send the complete message.
            error = mqtt_publish_qos2_complete(&client, &complete);

            // Has an error occurred?
            if(0 != error) {

                LOG_ERR("MQTT publish QoS2 complete failed: %d.", error);

                break;
            }

            LOG_INF("MQTT PUBREL received with id: %u.", p->message_id);

            break;
        }

        // Confirmation to a publish release message with QoS 2.
        case MQTT_EVT_PUBCOMP: {

            // Has an error occurred?
            if(0 != evt->result) {

                LOG_ERR("MQTT PUBCOMP received error: %d.", evt->result);

                break;
            }

            LOG_INF("MQTT PUBCOMP received with id: %u.", evt->param.pubcomp.message_id);

            break;
        }

        // Acknowledgement to a subscribe request.
        case MQTT_EVT_SUBACK:

            // Has an error occurred?
            if(0 != evt->result) {

                LOG_ERR("MQTT SUBACK received error: %d.", evt->result);

                break;
            }

            LOG_INF("MQTT SUBACK received with id: %u.", evt->param.suback.message_id);

            aws_mqtt_status.is_subscribed = true;

            break;

        // Acknowledgment to a unsubscribe request.
        case MQTT_EVT_UNSUBACK:

            // Has an error occurred?
            if(0 != evt->result) {

                LOG_ERR("MQTT UNSUBACK received error: %d.", evt->result);

                break;
            }

            LOG_INF("MQTT UNSUBACK received with id: %u.", evt->param.unsuback.message_id);

            aws_mqtt_status.is_subscribed = false;

            break;

        // Ping Response from server.
        case MQTT_EVT_PINGRESP:

            break;

        default:

            break;
    }

    // Has a AWS callback been set?
    if((AWS_EVENT_NONE != event) && (NULL != aws_callback)) {

        // Set the callback function.
        aws_callback(event, mqtt_payload_buffer);
    }
}

/**
 * @brief   Initialize the MQTT broker structure.
 */
static void aws_broker_init(void) {

    // Fill out the initial address info struct.
    struct addrinfo hints = {

        .ai_flags = 0,
        .ai_family = AF_INET,
        .ai_socktype = SOCK_STREAM,
        .ai_protocol = 0,
    };

    // The resulting address info struct.
    struct addrinfo* result;
    struct addrinfo* address;

    // Convert text strings representing hostnames/IP addresses into a linked list of struct addrinfo structure.
    int error = getaddrinfo(CC_AWS_MQTT_BROKER_HOSTNAME, NULL, &hints, &result);

    // Did an error occur?
    if(0 != error) {

        LOG_ERR("Getaddrinfo failed, error: %d.", errno);

        return;
    }

    // Store the resulting address info.
    address = result;

    // Look for the IPv4 Address of the broker.
    while(NULL != address) {

        // Is it an IPv4 Address?
        if(sizeof(struct sockaddr_in) == address->ai_addrlen) {

            // Initialize the broker structure.
            struct sockaddr_in* broker = ((struct sockaddr_in*)&mqtt_broker);

            // Fill out the socket IPv4 address for the broker.
            broker->sin_addr.s_addr = ((struct sockaddr_in*)address->ai_addr)->sin_addr.s_addr;
            broker->sin_family = AF_INET;
            broker->sin_port = htons(CC_AWS_MQTT_BROKER_PORT);

            // An array holding the IP address.
            char ipv4_address[NET_IPV4_ADDR_LEN];

            // Convert the IP address from internal to numeric ASCII form.
            inet_ntop(AF_INET, &broker->sin_addr.s_addr, ipv4_address, sizeof(ipv4_address));

            LOG_INF("MQTT broker is connected with IP address: %s.", log_strdup(ipv4_address));

            break;
        }

        // Increment the address pointer.
        address = address->ai_next;
    }

    // Free the resulting memory struct.
    freeaddrinfo(result);
}

void aws_init(const uint8_t* const _client_id, const aws_event_callback_t _callback) {

    // Set the callback function.
    aws_callback = _callback;

    // Initialize the MQTT client instance.
    mqtt_client_init(&client);

    // MQTT client configuration.
    client.broker = &mqtt_broker;
    client.evt_cb = aws_mqtt_event_handler;
    client.client_id.utf8 = _client_id;
    client.client_id.size = strlen(client.client_id.utf8);
    client.password = NULL;
    client.user_name = NULL;
    client.protocol_version = MQTT_VERSION_3_1_1;

    // MQTT buffers configuration.
    client.rx_buf = mqtt_rx_buffer;
    client.rx_buf_size = sizeof(mqtt_rx_buffer);
    client.tx_buf = mqtt_tx_buffer;
    client.tx_buf_size = sizeof(mqtt_tx_buffer);

    // MQTT transport configuration.
    client.transport.type = MQTT_TRANSPORT_SECURE;

    // The security tag.
    static sec_tag_t sec_tag_list[] = { 128 };

    // TLS configuration for secure MQTT transports.
    struct mqtt_sec_config* tls_config = &(client.transport).tls.config;
    tls_config->peer_verify = CC_AWS_MQTT_TLS_PEER_VERIFY;
    tls_config->cipher_count = 0;
    tls_config->cipher_list = NULL;
    tls_config->sec_tag_count = ARRAY_SIZE(sec_tag_list);
    tls_config->sec_tag_list = sec_tag_list;
    tls_config->hostname = CC_AWS_MQTT_BROKER_HOSTNAME;
    tls_config->session_cache = TLS_SESSION_CACHE_DISABLED;

    // Fill out the MQTT status topic struct.
    aws_mqtt_status.is_subscribed = false;
    aws_mqtt_status.topic = (uint8_t*)_client_id;
    aws_mqtt_status.failure_message = CC_AWS_MQTT_PUB_SUB_STATUS_FAILURE_MESSAGE;
    aws_mqtt_status.success_message = CC_AWS_MQTT_PUB_SUB_STATUS_SUCCESS_MESSAGE;
    aws_mqtt_status.qos = CC_AWS_MQTT_PUB_SUB_STATUS_QOS;

    // Initialize a mutex.
    k_mutex_init(&aws_publish_mutex);

    // Initialize a work queue.
    k_work_init(&aws_publish_work, aws_publish_work_handler);
}

void aws_connect(void) {

    // Is the connection already requested?
    if(1 == atomic_get(&is_connect_requested)) {

        return;
    }

    // Initialize the MQTT broker.
    aws_broker_init();

    // Connect to the MQTT broker.
    int error = mqtt_connect(&client);

    // Has an error occurred?
    if(0 != error) {

        LOG_ERR("MQTT connection failed: %d.", error);

        return;
    }

    // Set the MQTT transport to secure.
    mqtt_pollfd.fd = client.transport.tls.sock;
    mqtt_pollfd.events = POLLIN;

    // The connection is now requested.
    atomic_set(&is_connect_requested, 1);
}

// cppcheck-suppress    unusedFunction
void aws_disconnect(void) {

    // Is the connection not requested?
    if(0 == atomic_get(&is_connect_requested)) {

        return;
    }

    // Disconnect from the MQTT broker.
    int error = mqtt_disconnect(&client);

    // Has an error occurred?
    if(0 != error) {

        LOG_ERR("MQTT disconnection failed: %d.", error);
    }
}

bool aws_is_connection_requested(void) {

    return (bool)atomic_get(&is_connect_requested);
}

void aws_run(void) {

    // Wait on an event on the file descriptor.
    int error = poll(&mqtt_pollfd, 1,  mqtt_keepalive_time_left(&client));

    // Has an error occurred?
    if(0 > error) {

        LOG_ERR("MQTT poll failed: %d.", errno);

        return;
    }

    // Keep the connection alive by sending a ping request.
    error = mqtt_live(&client);

    // Has an error occurred?
    if((0 != error) && (-EAGAIN != error)) {

        LOG_ERR("MQTT live failed: %d.", error);

        return;
    }

    // Is there data to read (returned event)?
    if(POLLIN == (mqtt_pollfd.revents & POLLIN)) {

        // Receive an incoming MQTT packet. The registered callback will be called with the packet content.
        error = mqtt_input(&client);

        // Has an error occurred?
        if(0 != error) {

            LOG_ERR("MQTT input failed: %d.", error);

            return;
        }
    }

    // Does the returned event contain an error condition?
    if(POLLERR == (mqtt_pollfd.revents & POLLERR)) {

        LOG_ERR("MQTT failed with POLLERR.");

        return;
    }

    // Does the returned event contain an invalid request?
    if(POLLNVAL == (mqtt_pollfd.revents & POLLNVAL)) {

        LOG_ERR("MQTT failed with POLLNVAL.");

        return;
    }
}

int16_t aws_subscribe(const char* const _subscribe_topic) {

    // Is the topic already subscribed?
    if(true == aws_mqtt_status.is_subscribed) {

        return 0;
    }

    // Create the subscribed topic.
    struct mqtt_topic topic = {

        .topic = {

            .utf8 = _subscribe_topic,
            .size = strlen(_subscribe_topic)
        },

        .qos = MQTT_QOS_1_AT_LEAST_ONCE
    };

    // Add the topic to the subscription request.
    const struct mqtt_subscription_list subscription_list = {

        .list = &topic,
        .list_count = 1,
        .message_id = sys_rand32_get()
    };

    LOG_INF("MQTT subscribed to topic: %s", log_strdup(_subscribe_topic));

    // Subscribe to the topic.
    return mqtt_subscribe(&client, &subscription_list);
}

void aws_publish(const char* const _topic, const uint8_t* const _data) {

    // Lock the AWS publish mutex and has it succeeded?
    if(0 != k_mutex_lock(&aws_publish_mutex, K_MSEC(CC_WORK_MUTEX_LOCK_TIMEOUT_MS))) {

        LOG_ERR("AWS publish mutex cannot be locked.");

        return;
    }

    // Store the AWS publish information.
    aws_publish_info.topic = (char*)_topic;
    aws_publish_info.data = (uint8_t*)_data;

    // Unlock the AWS publish mutex.
    (void)k_mutex_unlock(&aws_publish_mutex);

    // Submit a work item to the system work queue.
    (void)k_work_submit(&aws_publish_work);
}

void aws_get_status(aws_mqtt_status_t* _aws_mqtt_status) {

    // Get the AWS MQTT status struct.
    memcpy(_aws_mqtt_status, &aws_mqtt_status, sizeof(aws_mqtt_status));
}
```

## src/aws.h
```c
/**
 * @file        aws.h
 *
 * @details     A module handling the AWS & MQTT communication.
 *
 * @copyright   Copyright (c) 2021 Circle Consult ApS. All rights reserved.
 *
 * @date        12-11-2021
 * @author      Christian Friedrichsen, Circle Consult ApS
 */

#ifndef AWS_H_
#define AWS_H_

#include <stdint.h>
#include <stdbool.h>

#include "software_settings.h"

/**
 * @brief   Subscribe data used when packets are published on AWS.
 */
typedef struct {

    bool is_subscribed;             //!< Flag indicating if the topic is subscribed.
    char* topic;                    //!< The subscribe/publish topic.
    char* failure_message;          //!< The payload message when failed on AWS.
    char* success_message;          //!< The payload message when succeeded on AWS.
    char* qos;                      //!< The Quality of Service.

} aws_mqtt_status_t;

//! Event identifiers used by the @ref aws_event_callback_t.
typedef enum  {

    AWS_EVENT_NONE,                 //!< This ID is never used. Dummy value for completeness.
    AWS_EVENT_RESPONSE_READY,       //!< A complete AWS response packet is ready.

} aws_event_t;

/**
 * @brief   AWS publish information.
 */
typedef struct {

    char* topic;                    //!< The topic that is published to.
    uint8_t* data;                  //!< The data to publish.

} aws_publish_info_t;

//! Cloud event callback function type.
typedef void (*aws_event_callback_t)(const aws_event_t, const uint8_t* const);

/**
 * @brief   Initialize the AWS and MQTT broker.
 *
 * @param   _client_id  The client id.
 * @param   _callback   Function to be called when a aws event is detected.
 */
void aws_init(const uint8_t* const _client_id, const aws_event_callback_t _callback);

/**
 * @brief   Connect to the AWS MQTT broker.
 */
void aws_connect(void);

/**
 * @brief   Disconnect from the AWS MQTT broker.
 */
void aws_disconnect(void);

/**
 * @brief   Verify if the AWS MQTT broker connection is requested.
 *
 * @retval  false   MQTT broker connection is not requested.
 * @retval  true    MQTT broker connection is requested.
 */
bool aws_is_connection_requested(void);

/**
 * @brief   Run for the AWS MQTT broker events and inputs.
 *          This function shall only be called inside a thread.
 */
void aws_run(void);

/**
 * @brief   Subscribe to the configured topic.
 *
 * @param   _subscribe_topic    The topic that shall be subscribed to.
 *
 * @retval  0           Success.
 * @retval  Negative    Error.
 */
int16_t aws_subscribe(const char* const _subscribe_topic);

/**
 * @brief   Publish data on the configured topic.
 *
 * @note    The functionality is handled through a work queue.
 *
 * @param   _topic      The topic that the data shall be published to.
 * @param   _data       The data that shall be published.
 */
void aws_publish(const char* const _topic, const uint8_t* const _data);

/**
 * @brief   Get the MQTT status.
 *
 * @param   _aws_mqtt_status    The MQTT status.
 */
void aws_get_status(aws_mqtt_status_t* _aws_mqtt_status);

#endif /* AWS_H_ */
```

## src/cli.c
```c
/**
 * @file      cli.c
 *
 * @details   A module handling the command line interface.
 *
 * @copyright Copyright (c) 2021 Circle Consult ApS. All rights reserved.
 *
 * @date      16/09/2020
 * @author    Anton Vigen Smolarz, Circle Consult ApS.
 */

#ifdef USE_CLI

#include <string.h>
#include <ctype.h>
#include <kernel.h>
#include <sys/reboot.h>
#include <sys/printk.h>
#include <stdbool.h>

#include "cli.h"
#include "uart.h"
#include "software_settings.h"

//! Input buffer.
static uint8_t g_input_buf[CC_CLI_BUFFER_SIZE];

//! Line buffer.
static uint8_t g_linebuf_buf[CC_CLI_BUFFER_SIZE];

//! Set command line interface enable.
static bool g_cli_enabled = false;

//! Set line length.
static uint16_t g_line_length = 0;

//! Set the pointer to the command line interface command.
static CLI_command_t** g_CLI_command_array;

//! Set the number of command line interface commands.
static uint8_t g_CLI_command_num = 0;

//! Set the command line interface command length.
static uint8_t g_CLI_command_length = CC_CLI_INITIAL_NUMBER_OF_COMMANDS;

//! Set the commands added to run.
static bool cmd_is_added_to_run = false;

//! Set the command to run.
static CLI_run_t cmd_to_run;

/**
 * @brief   Command line interface help command, that lists all available commands with there discriptions.
 *
 * @param   argc    Number of arguments. (Not used)
 * @param   argv    value of arguments. (Not used)
 */
CLI_CREATE_COMMAND(help, "Lists all available commands.") {

    // Print header.
    printk("In Circle Consult APS nRF9160 CLI environment\nthe following list of commands are avaliable:");

    // Run through all commands.
    for(uint8_t i = 0; i < g_CLI_command_num; i++) {

        // Print the command name and description.
        printk("\n%s: %s", (*g_CLI_command_array[i]).name, (*g_CLI_command_array[i]).description);
    }
}

/**
 * @brief   Reboot command line interface command, that reboots the system.
 *
 * @param   argc    Number of arguments. (Not used)
 * @param   argv    value of arguments. (Not used)
 */
CLI_CREATE_COMMAND(reboot, "Reboots the devices.") {

    // Call system reboot.
    sys_reboot(0);
}

/**
 * @brief   Gets the number of white space. Double white space is counted only once. Ignores whitespace in quotes.
 *
 * @param   a_string    String witch contains the whitespace.
 *
 * @return              The number of white space.
 */
static uint32_t find_number_of_w_space(const char* a_string) {

    // Initialize the char index.
    uint8_t i = 0;

    // Initialize the return value.
    uint32_t r = 0;

    // Initialize the container that hold whether or not last char was whitespace.
    bool w_space_found = false;

    // Is the character in the string a quote?
    if('"' == a_string[i]) {

        // Increment i.
        i++;

        // While the letters in string is not the end quote.
        while('"' != a_string[i]) {

            // Increment i.
            i++;
        }
    }

    // Run through until end of string.
    while(0 != a_string[i]) {

        // Is the character a whitespace?
        if(0 != isspace((unsigned char)a_string[i])) {

            // Set white space found to true.
            w_space_found = true;
        }

        // If first char of next word is quote, handle as string.
        else if(true == w_space_found && '"' == a_string[i]) {

            // Add one to return value.
            r++;

            // Go to next character.
            i++;

            // Set white space found to false.
            w_space_found = false;

            // Ignore whitespace until next quote or end of string.
            while('"' != a_string[i] && 0 != a_string[i]) {

                // Increment i.
                i++;
            }

            // Is the character the end of the string?
            if(0 == a_string[i]) {
                break;
            }
        }

        // Is there a whitespace found and the next character is not a whitespace to?
        else if(true == w_space_found && 0 == isspace((unsigned char)a_string[i])) {

            // Add one to return value.
            r++;

            // White space found is set to false.
            w_space_found = false;
        }

        // Increment i.
        i++;
    }

    return r;
}

/**
 * @brief   Get the index of the next whitespace.
 *
 * @param   string  The string to find whitespace in.
 * @param   start   The index of where in the string to begin searching.
 *
 * @return          The index of the next whitespace in the string or end of string.
 */
static uint32_t find_white_space(const char* string, const uint32_t start) {

    // Set i as start value.
    uint32_t i = start;

    // While the string is not at the end.
    while(0 != string[i]) {

        // Is there a white space?
        if(0 != isspace((unsigned char)string[i])) {

            return i;
        }

        // Increment i.
        i++;
    }

    return i;
}

/**
 * @brief   Get the index of the next double quote.
 *
 * @param   string  The string to find a quote in.
 * @param   start   The index of where in the string to begin searching.
 *
 * @return          The index of the next whitespace in the string or end of string.
 */
static uint32_t find_quote(const char* string, const uint32_t start) {

    // Set i as the start value.
    uint32_t i = start;

    // While the character is not at the end and carriage return.
    while(0 != string[i] && '\r' != string[i]) {

        // Is the string quotes?
        if('"' == string[i]) {

            return i;
        }

        // Increment i.
        i++;
    }

    return i;
}

/**
 * @brief   Function for handling UART RX interrupts.
 *
 * @param   uart_device     The device that triggered the interrupt.
 * @param   user_data       NA.
 */
static void uart_rx_handler(const struct device* uart_device, void* user_data) {

    // Is command line interface enabled?
    if(true == g_cli_enabled) {

        // Update interrupt request for UART.
        uart_irq_update(uart_device);

        // Is interrupt request for UART RX ready?
        if(uart_irq_rx_ready(uart_device)) {

            // Initialize object for data length.
            uint16_t data_length = 0;

            // Get UART rx data.
            data_length = uart_fifo_read(uart_device, g_input_buf, sizeof(g_input_buf));

            // Ignore control caracters (except carriage return and backspace) and higher values than ascii.
            if(((' ' > g_input_buf[0] && '\r' != g_input_buf[0])) || CC_CLI_ASCII_UPPER_LIMIT < g_input_buf[0]) {

                return;
            }

            // Is the input backspace?
            if(CC_CLI_ASCII_UPPER_LIMIT == g_input_buf[0]) {

                // Does the line have characters?
                if(0 < g_line_length) {

                    // decrement line length.
                    g_line_length--;

                    // Echo backspace back to the sender.
                    printk("%s", g_input_buf);
                }

                return;
            }

            // Run through the input buffer.
            for(uint8_t i = 0; i < data_length; i++) {

                // Add character to line buffer.
                g_linebuf_buf[g_line_length + i] =  g_input_buf[i];
            }

            // Increment line length with the length of the added data.
            g_line_length += data_length;

            // Is the inputbuffer's last character carriage return?
            if('\r' == g_input_buf[data_length - 1]) {

                // Replace carriage return with end of string.
                g_input_buf[data_length - 1] = 0;

                // Replace carriage return with end of string.
                g_linebuf_buf[g_line_length] = 0;

                // Echo received data to user with newline.
                printk("%s\n", g_input_buf);

                // Parse and handle command.
                cli_parse(g_linebuf_buf);

            } else {

                // Add end of string.
                g_input_buf[data_length] = 0;

                // Echo received data to user.
                printk("%s", g_input_buf);
            }
        }
    }
}

void init_cli() {

    // Set command line interface to enabled.
    g_cli_enabled = true;

    // Allocate array space for commands.
    g_CLI_command_array = (CLI_command_t**) k_malloc(sizeof(CLI_command_t*) * g_CLI_command_length);

    // Initialize UART.
    init_uart(uart_rx_handler);

    // Add help command to command line interface.
    CLI_ADD_COMMAND(help);

    // Add reboot command to command line interface.
    CLI_ADD_COMMAND(reboot);

    // Print command line interface header.
    printk("CLI environment started!\nWrite \"help\" for more information.\n> ");
}

void cli_parse(const char* line) {

    // Is the line empty?
    if(1 >= g_line_length) {

        //Reset line to being empty.
        g_line_length = 0;

        // Print indicator to user.
        printk("> ");
        return;
    }

    // Get argument count.
    uint8_t argc = find_number_of_w_space(line) + 1;

    // Allocate argument value list.
    char* argv[argc];

    // Set the start variable.
    uint8_t start = 0;

    // Run through all arguments.
    for(uint8_t i = 0; i < argc; i++) {

        // Allocate indexes for splitting up the line to the arguments.
        static uint8_t stop;
        static uint8_t len;

        // Find next whitespace.
        stop = find_white_space(line, start);

        // Calculate length of argument.
        len = stop - start;

        // Is the length not 0?
        if(0 != len) {

            // Is the character a quote?
            if('"' == line[start]) {

                // Increment start.
                start++;

                // Recalculate length to fit the whole quoted string.
                len = find_quote(line, start) - (start);

                // Recalculated stop.
                stop = start + len;
            }

            // Allocated the correct length of argument.
            argv[i] = (char*) k_malloc(len + 1);

            // Is the argument null?
            if(NULL == argv[i]) {

                // Inform user an error ocurred.
                printk("Error in parsing command\n> ");

                return;
            }

            // Copy value to argument.
            memcpy(argv[i], &(line[start]), len);

            // Terminate the string.
            argv[i][len] = 0;
        }

        // If len is zero then 2 will be added to start on the line below, while only one is wanted in the case of an empty trying. Therefore i--.
        else {

            // Decrement i.
            i--;
        }

        // Set next start to the end + 1.
        start = stop + 1;
    }

    // Initiate variable to check if function ran.
    bool func_ran = false;

    // Do for all command line interface functions.
    for(uint8_t i = 0; i < g_CLI_command_num; i++) {

        // Does the first argument matches command line interface function name?
        if(0 == strcmp((*g_CLI_command_array[i]).name, argv[0])) {

            // Run command line interface function.
            (*g_CLI_command_array[i]).run_cmd(argc, argv);

            // Indicate the function was found and executed.
            func_ran = true;
            break;
        }
    }

    // Has the function been run?
    if(false == func_ran) {

        // Inform user.
        printk("Function not found!");
    }

    // Run through the arguments.
    for(uint8_t i = 0; i < argc; i++) {

        // Free argument.
        k_free(argv[i]);
    }

    // Reset line to being empty.
    g_line_length = 0;

    // Is the command line interface enabled?
    if(true == g_cli_enabled) {

        // Print indicator to user.
        printk("\n> ");
    }
}

void cli_add_command(CLI_command_t* command) {

    // Is the array out of space?
    if(g_CLI_command_num >= g_CLI_command_length) {

        // New array length is calculated.
        uint8_t new_length = CC_CLI_RESIZE_CMD_ARRAY_BY + g_CLI_command_length;

        // Allocate new array with new length.
        CLI_command_t** temp = (CLI_command_t**) k_malloc(sizeof(CLI_command_t*) * new_length);

        // Run through the command array.
        for(uint8_t i = 0; i < g_CLI_command_length; i++) {

            // Move old array to new array.
            temp[i] = g_CLI_command_array[i];
        }

        // Set CLI command length to new length.
        g_CLI_command_length = new_length;

        // Free old array.
        k_free(g_CLI_command_array);

        // Move new pointer to command line interface command array.
        g_CLI_command_array = temp;
    }

    // Is the command array empty?
    if(NULL == g_CLI_command_array) {

        // Inform user.
        printk("CLI not initialized!\n");
    }

    // The command array is not empty.
    else {

        // Add command to array and increment number of commands.
        g_CLI_command_array[g_CLI_command_num++] = command;
    }

}

void cli_disable() {

    // Indicate that command line interface is disabled.
    g_cli_enabled = false;
}

void cli_enable() {

    // Indicate that command line interface is enabled.
    g_cli_enabled = true;
}

void cli_print_line(void) {

    // Set end of string
    g_linebuf_buf[g_line_length] = 0;

    // Print indicator to user.
    printk("\n> %s", g_linebuf_buf);
}

void cli_run(void) {

    // Is a command added to run?
    if(true == cmd_is_added_to_run) {

        // Run command.
        cmd_to_run();

        // Set command added to run to false.
        cmd_is_added_to_run = false;

        // Print command line interface line.
        CLI_PRINT_LINE();
    }
}

void cli_add_run_cmd(CLI_run_t cmd) {

    // Set cmd to run as cmd.
    cmd_to_run = cmd;

    // Set command added to run to true.
    cmd_is_added_to_run = true;
}
#endif
```

## src/cli.h
```c
/**
 * @file      cli.h
 *
 * @details   A module handling the command line interface.
 *
 * @copyright Copyright (c) 2021 Circle Consult ApS. All rights reserved.
 *
 * @date      16/09/2020
 * @author    Anton Vigen Smolarz, Circle Consult ApS.
 */

#ifndef CLI_H
#define CLI_H

#ifdef USE_CLI

//! Set up the command line interface run type.
typedef void (*CLI_run_t)(void);

/**
 * @brief   Creates a command with its struct to be added later by CLI_ADD_COMMAND.
 *
 * @note    This is a define macro. The internal parts of the macro uses functions and structs already documented.
 *
 * @param   NAME        Name of the command without quotes.
 * @param   DESCRPTION  The commands description as a string in quotes.
 */
#define CLI_CREATE_COMMAND(NAME,DESCRPTION)             \
    void NAME ## _run_cmd_CLI(int argc, char* argv[]);  \
    CLI_command_t NAME ## _cmd_CLI = {                  \
                                                        .name = #NAME,                                  \
                                                        .description = DESCRPTION,                      \
                                                        .run_cmd = & NAME ## _run_cmd_CLI,              \
                                     };                                                  \
    void NAME ## _run_cmd_CLI(int argc, char* argv[])

/**
 * @brief   Adds command to list of available commands.
 *
 * @param   NAME    Name of the command without quotes. Same name as given in CLI_CREATE_COMMAND
 */
#define CLI_ADD_COMMAND(NAME) cli_add_command(& NAME ## _cmd_CLI)

/**
 * @brief Initializes the command line interface.
 */
#define INIT_CLI(void) init_cli()

//! Set up the command line interface command handler type.
typedef void (*CLI_command_handle_t)(int argc, char* argv[]);

//! Set the struct for the command line interface command.
typedef struct CLI_command_t {
    char* name;                     //!< Name of the command.
    char* description;              //!< Description of the command.
    CLI_command_handle_t run_cmd;   //!< command line interface command handler.
} CLI_command_t;

/**
 * @brief   Disables the CLI momentarily.
 */
#define CLI_DISABLE(void) cli_disable()

/**
 * @brief   Enables the CLI after it has been disabled.
 */
#define CLI_ENABLE(void) cli_enable()

/**
 * @brief   Prints the line for writing.
 */
#define CLI_PRINT_LINE(void) cli_print_line()

/**
 * @brief   Function to run command later.
 */
#define CLI_RUN(void) cli_run()

/**
 * @brief   Function to add run command for later run.
 */
#define CLI_ADD_RUN_CMD(CMD) cli_add_run_cmd(CMD)

/**
 * @brief   Initializes the commandline interface.
 */
void init_cli(void);

/**
 * @brief   Take a string and translates it into arguments and runs the matching command.
 *
 * @param   a_line  Pointer to the argument.
 */
void cli_parse(const char* a_line);

/**
 * @brief   Adds command to list of available commands.
 *
 * @param   a_command   Pointer to the command struct.
 */
void cli_add_command(CLI_command_t* a_command);

/**
 * @brief   Disables the CLI momentarily.
 */
void cli_disable(void);

/**
 * @brief   Enables the CLI after it has been disabled.
 */
void cli_enable(void);

/**
 * @brief   Prints the line for writing.
 */
void cli_print_line(void);

/**
 * @brief   Function to run command later.
 */
void cli_run(void);

/**
 * @brief   Function to add run command for later run.
 *
 * @param   cmd     The command to add to run.
 */
void cli_add_run_cmd(CLI_run_t cmd);

#else

/**
 * @brief   This will still create the CLI command, but not its struct since CLI is disabled.
 *
 * @param   NAME        Name of the command without quotes.
 * @param   DESCRPTION  Not used when CLI is disabled.
 */
#define CLI_CREATE_COMMAND(NAME,DESCRPTION) void NAME ## _run_cmd(int argc, char* argv[])

/**
 * @brief   Foo macro that ensures that CLI can be disabled without code change.
 *
 * @param   NAME    Name of the command without quotes.
 */
#define CLI_ADD_COMMAND(NAME)

/**
 * @brief   Foo macro that ensures that CLI can be disabled without code change.
 */
#define INIT_CLI(void)

/**
 * @brief   Foo macro that ensures that CLI can be disabled without code change.
 */
#define CLI_DISABLE(void)

/**
 * @brief   Foo macro that ensures that CLI can be disabled without code change.
 */
#define CLI_ENABLE(void)

/**
 * @brief   Foo macro that ensures that CLI can be disabled without code change.
 */
#define CLI_PRINT_LINE(void)

/**
 * @brief   Function to run command later.
 */
#define CLI_RUN(void)


/**
 * @brief   Function to add run command for later run.
 *
 * @param   CMD     The command to add to run.
 */
#define CLI_ADD_RUN_CMD(CMD)

#endif

#endif /* CLI_H */
```

## src/cloud.h
```c
/**
 * @file        cloud.h
 *
 * @details     A module handling the Cloud (AWS) communication.
 *
 * @copyright   Copyright (c) 2021 Circle Consult ApS. All rights reserved.
 *
 * @date        22-11-2021
 * @author      Christian Friedrichsen, Circle Consult ApS
 */

#ifndef CLOUD_H_
#define CLOUD_H_

//! Cloud topic types.
typedef enum  {

    CLOUD_TOPIC_TYPE_GET_PCC_LOAD,                  //!< The "Get PCC load" type.
    CLOUD_TOPIC_NUMBER_OF_TYPES                     //!< The number of types.

} cloud_topic_type_t;

//! Event identifiers used by the @ref cloud_event_callback_t.
typedef enum  {

    CLOUD_EVENT_NONE,                               //!< This ID is never used. Dummy value for completeness.
    CLOUD_EVENT_GET_PCC_LOAD_PACKET_SUCCEEDED,      //!< A complete "Get PCC Load" packet has succeeded.
    CLOUD_EVENT_GET_PCC_LOAD_PACKET_FAILED          //!< A complete "Get PCC load" packet has failed.

} cloud_event_t;

/**
 * @brief   Cloud publish information.
 */
typedef struct {

    char* topic;                                    //!< The topic that is published to.
    uint8_t* data;                                  //!< The data to publish.

} cloud_publish_info_t;

//! Event callback function type.
typedef void (*cloud_event_callback_t)(const cloud_event_t);

/**
 * @brief   Initialize the cloud.
 *
 * @param   _client_id      The client id.
 */
void cloud_init(const uint8_t* const _client_id);

/**
 * @brief   Set the callback function.
 *
 * @param   _callback   Function to be called when an event is detected.
 */
void cloud_set_callback(const cloud_event_callback_t _callback);

/**
 * @brief   Create a JSON object so it is ready for publishing.
 *
 * @note    The function acts as an interface handling all different object types defined by @ref cloud_topic_type_t.
 *          The data parameters consist of different data depending of the type (2 set of data arrays are needed for some types).
 *
 * @param   _type                   The packet type.
 * @param   _primary_data           The generic primary data. (Unused = NULL).
 * @param   _primary_data_length    The length of the primary data. (Unused = NULL).
 * @param   _secondary_data         The generic secondary data. (Unused = NULL).
 * @param   _secondary_data_length  The length of the secondary data. (Unused = NULL).
 */
void cloud_create_object(const uint8_t _type,
                         const uint8_t** const _primary_data,
                         const uint16_t* const _primary_data_length,
                         const uint8_t** const _secondary_data,
                         const uint16_t* const _secondary_data_length);

/**
 * @brief   Publish the stored data to the AWS topic.
 */
void cloud_publish(void);

#endif /* CLOUD_H_ */
```

## src/modem.h
```c
/**
 * @file        modem.h
 *
 * @details     A module handling the modem.
 *
 * @copyright   Copyright (c) 2021 Circle Consult ApS. All rights reserved.
 *
 * @date        14-09-2021
 * @author      Christian Friedrichsen, Circle Consult ApS
 */

#ifndef MODEM_H_
#define MODEM_H_

/**
 * @brief   Initialize the modem.
 */
void modem_init(void);

/**
 * @brief   Connect the modem to the LTE network.
 */
void modem_connect(void);

/**
 * @brief   Disconnect the modem from the LTE network.
 */
void modem_disconnect(void);

/**
 * @brief   Set the client id.
 */
void modem_set_client_id(void);

/**
 * @brief   Get the client ID.
 *
 * @return  The client ID.
 */
const uint8_t* modem_get_client_id(void);

#endif /* MODEM_H_ */
```
