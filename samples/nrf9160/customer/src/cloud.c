/**
 * @file        cloud.c
 *
 * @details     A module handling the Cloud (AWS) communication.
 *
 * @copyright   Copyright (c) 2021 Circle Consult ApS. All rights reserved.
 *
 * @date        22-11-2021
 * @author      Christian Friedrichsen, Circle Consult ApS
 */

#include <string.h>
#include <stdio.h>
#include <stdlib.h>

#include <zephyr.h>
#include <logging/log.h>
#include <cJSON.h>

#include "cloud.h"
#include "software_settings.h"
#include "watch.h"
#include "aws.h"

//! Register the cloud module to the logging system.
LOG_MODULE_REGISTER(CLOUD, CC_LOG_LEVEL);

//! The callback function.
static cloud_event_callback_t cloud_callback = NULL;

//! A list of the topics that can be published to AWS MQTT.
static const char* const topics[CLOUD_TOPIC_NUMBER_OF_TYPES] = { "acdc/get_pcc_load" };

//! A list of the response types from AWS MQTT.
static const char* const response_types[CLOUD_TOPIC_NUMBER_OF_TYPES] = { "getPCCLoad" };

//! The cloud publish information.
static cloud_publish_info_t cloud_publish_info;

/**
 * @brief   Find the response type index from the type string.
 *
 * @param   _type       The type in string.
 *
 * @retval  0x00-0xFE   The type index.
 * @retval  0xFF        No type is found.
 */
static uint8_t cloud_find_response_type_index(const char* const _type) {

    // Loop through the response types.
    for(uint16_t i = 0; i < sizeof(response_types); i++) {

        // Has the response type been found, then return the index.
        if(0 == strcmp(response_types[i], _type)) {

            return i;
        }
    }

    // If the response type is not found, return 0xFF.
    return 0xFF;
}

/**
 * @brief   Handle the PCC load result from AWS.
 *
 * @param   _aws_mqtt_status    The AWS MQTT status parameters.
 * @param   _results            The JSON object containing the results.
 *
 * @retval  false               An error has occurred.
 * @retval  true                No error has occurred.
 */
static bool cloud_handle_pcc_load_result(const aws_mqtt_status_t _aws_mqtt_status, const cJSON* const _results) {

    // Loop through the results array.
    for(uint16_t i = 0; i < cJSON_GetArraySize(_results); i++) {

        // Get the next array item.
        cJSON* result = cJSON_GetArrayItem(_results, i);

        // Get the status code.
        cJSON* status_code = cJSON_GetObjectItem(result, "statusCode");

        // Has a success message been received?
        if(0 == strcmp(status_code->valuestring, _aws_mqtt_status.success_message)) {

            // Get the id and PCC Load.
            cJSON* id = cJSON_GetObjectItem(result, "id");
            cJSON* pcc_load = cJSON_GetObjectItem(result, "pccLoad");

            LOG_INF("PCC load Result(%s): %s.", log_strdup(id->valuestring), log_strdup(pcc_load->valuestring));

        }

        // Has a failure message been received?
        else {

            // Get the id and message.
            cJSON* id = cJSON_GetObjectItem(result, "id");
            cJSON* message = cJSON_GetObjectItem(result, "message");

            LOG_INF("PCC load Result(%s): %s", log_strdup(id->valuestring),
                    log_strdup(message->valuestring));

            return false;
        }
    }

    return true;
}

/**
 * @brief       Handle events from the AWS.
 *
 * @param       _aws_event      Event generated by AWS.
 * @param       _data           Received data.
 */
static void cloud_event_handler(const aws_event_t _aws_event, const uint8_t* const _data) {

    // Reset the event.
    uint8_t event = CLOUD_EVENT_NONE;

    // Go through the event.
    switch(_aws_event) {

        case AWS_EVENT_RESPONSE_READY: {

            // Get the AWS MQTT status parameters.
            aws_mqtt_status_t aws_mqtt_status;
            aws_get_status(&aws_mqtt_status);

            // Create the JSON object from the received data.
            cJSON* response = cJSON_Parse(_data);

            // Fetch the packet type object from the response.
            cJSON* type = cJSON_GetObjectItem(response, "type");

            LOG_INF("AWS response type: %s.", log_strdup(type->valuestring));

            // Go through the response type.
            switch(cloud_find_response_type_index(type->valuestring)) {

                case CLOUD_TOPIC_TYPE_GET_PCC_LOAD: {

                    // A "Get PCC load" packet has been received.
                    event = CLOUD_EVENT_GET_PCC_LOAD_PACKET_SUCCEEDED;

                    // Fetch the pccLoadResults from the response.
                    cJSON* pcc_load_results = cJSON_GetObjectItem(response, "pccLoadResults");

                    // Handle the PCC load result.
                    if(false == cloud_handle_pcc_load_result(aws_mqtt_status, pcc_load_results)) {

                        // An error has occurred.
                        event = CLOUD_EVENT_GET_PCC_LOAD_PACKET_FAILED;
                    }

                    break;
                }

                default:

                    break;
            }

            // Remove the cJSON object.
            cJSON_Delete(response);

            break;
        }

        default:

            break;
    }

    // Has a Cloud callback been set?
    if((CLOUD_EVENT_NONE != event) && (NULL != cloud_callback)) {

        // Set the callback function.
        cloud_callback(event);
    }
}

/**
 * @brief       Create "Add Response" JSON object.
 *
 * @param       _response       The final JSON object.
 */
static void cloud_create_add_response(cJSON* _response) {

    // Get the AWS MQTT status parameters.
    aws_mqtt_status_t aws_mqtt_status;
    aws_get_status(&aws_mqtt_status);

    // Add the elements to the response object.
    cJSON_AddItemToObject(_response, "topic", cJSON_CreateString(aws_mqtt_status.topic));
    cJSON_AddItemToObject(_response, "failureMessage", cJSON_CreateString(aws_mqtt_status.failure_message));
    cJSON_AddItemToObject(_response, "successMessage", cJSON_CreateString(aws_mqtt_status.success_message));
    cJSON_AddItemToObject(_response, "qos", cJSON_CreateString(aws_mqtt_status.qos));
}

/**
 * @brief   Run the cloud functionality.
 *          This function shall only be called inside a thread.
 */
static void cloud_run(void) {

    while(1) {

        // Wait until connection is requested.
        if(false == aws_is_connection_requested()) {

            k_sleep(K_MSEC(10));

            continue;
        }

        // Keep the AWS MQTT broker connection alive and polling for new events.
        aws_run();
    }
}

//! Statically define and initialize the cloud thread.
K_THREAD_DEFINE(cloud_thread, CC_CLOUD_THREAD_STACK_SIZE,
                cloud_run, NULL, NULL, NULL,
                K_LOWEST_APPLICATION_THREAD_PRIO, 0, 0);

void cloud_init(const uint8_t* const _client_id) {

    // Initialize the AWS.
    aws_init(_client_id, cloud_event_handler);
}

// cppcheck-suppress    unusedFunction
void cloud_set_callback(const cloud_event_callback_t _callback) {

    // Set the callback function.
    cloud_callback = _callback;
}

void cloud_create_object(const uint8_t _type,
                         const uint8_t** const _primary_data,
                         const uint16_t* const _primary_data_length,
                         const uint8_t** const _secondary_data,
                         const uint16_t* const _secondary_data_length) {

    // Get the current date and time.
    watch_t watch;
    bool watch_status = watch_get(&watch);

    // Is the watch valid?
    if(false == watch_status) {
        LOG_ERR("Watch is invalid.");
        return;
    }

    // Create a JSON object holding the complete event.
    cJSON* event_data = cJSON_CreateObject();

    // Go through the type of the cloud publish.
    switch(_type) {

        case CLOUD_TOPIC_TYPE_GET_PCC_LOAD: {

            // Add the Charging load id string to the final event object.
            cJSON_AddItemToObject(event_data, "chargingLoadId", cJSON_CreateString("9b605eca-b857-42d3-a824-ef5ca15e8a74"));

            break;
        }

        default:

            break;
    }

    // Create an object holding the response.
    cJSON* response = cJSON_CreateObject();

    // Add the response to the object.
    cloud_create_add_response(response);

    // Add the response object to the final event object.
    cJSON_AddItemToObject(event_data, "response", response);

    // Store the AWS publish data.
    cloud_publish_info.topic = (char*)topics[_type];
    cloud_publish_info.data = cJSON_Print(event_data);

    // Free the cJSON object.
    cJSON_free(event_data);

    // Remove the cJSON object.
    cJSON_Delete(event_data);
}

void cloud_publish(void) {

    // Publish the data to the AWS.
    aws_publish(cloud_publish_info.topic, cloud_publish_info.data);
}